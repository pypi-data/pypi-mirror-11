/* Generated by Cython 0.22.1 */

/* BEGIN: Cython Metadata
{
    "distutils": {
        "depends": []
    }
}
END: Cython Metadata */

#define PY_SSIZE_T_CLEAN
#ifndef CYTHON_USE_PYLONG_INTERNALS
#ifdef PYLONG_BITS_IN_DIGIT
#define CYTHON_USE_PYLONG_INTERNALS 0
#else
#include "pyconfig.h"
#ifdef PYLONG_BITS_IN_DIGIT
#define CYTHON_USE_PYLONG_INTERNALS 1
#else
#define CYTHON_USE_PYLONG_INTERNALS 0
#endif
#endif
#endif
#include "Python.h"
#ifndef Py_PYTHON_H
    #error Python headers needed to compile C extensions, please install development version of Python.
#elif PY_VERSION_HEX < 0x02060000 || (0x03000000 <= PY_VERSION_HEX && PY_VERSION_HEX < 0x03020000)
    #error Cython requires Python 2.6+ or Python 3.2+.
#else
#define CYTHON_ABI "0_22_1"
#include <stddef.h>
#ifndef offsetof
#define offsetof(type, member) ( (size_t) & ((type*)0) -> member )
#endif
#if !defined(WIN32) && !defined(MS_WINDOWS)
  #ifndef __stdcall
    #define __stdcall
  #endif
  #ifndef __cdecl
    #define __cdecl
  #endif
  #ifndef __fastcall
    #define __fastcall
  #endif
#endif
#ifndef DL_IMPORT
  #define DL_IMPORT(t) t
#endif
#ifndef DL_EXPORT
  #define DL_EXPORT(t) t
#endif
#ifndef PY_LONG_LONG
  #define PY_LONG_LONG LONG_LONG
#endif
#ifndef Py_HUGE_VAL
  #define Py_HUGE_VAL HUGE_VAL
#endif
#ifdef PYPY_VERSION
#define CYTHON_COMPILING_IN_PYPY 1
#define CYTHON_COMPILING_IN_CPYTHON 0
#else
#define CYTHON_COMPILING_IN_PYPY 0
#define CYTHON_COMPILING_IN_CPYTHON 1
#endif
#if CYTHON_COMPILING_IN_PYPY && PY_VERSION_HEX < 0x02070600 && !defined(Py_OptimizeFlag)
#define Py_OptimizeFlag 0
#endif
#define __PYX_BUILD_PY_SSIZE_T "n"
#define CYTHON_FORMAT_SSIZE_T "z"
#if PY_MAJOR_VERSION < 3
  #define __Pyx_BUILTIN_MODULE_NAME "__builtin__"
  #define __Pyx_PyCode_New(a, k, l, s, f, code, c, n, v, fv, cell, fn, name, fline, lnos) \
          PyCode_New(a+k, l, s, f, code, c, n, v, fv, cell, fn, name, fline, lnos)
  #define __Pyx_DefaultClassType PyClass_Type
#else
  #define __Pyx_BUILTIN_MODULE_NAME "builtins"
  #define __Pyx_PyCode_New(a, k, l, s, f, code, c, n, v, fv, cell, fn, name, fline, lnos) \
          PyCode_New(a, k, l, s, f, code, c, n, v, fv, cell, fn, name, fline, lnos)
  #define __Pyx_DefaultClassType PyType_Type
#endif
#ifndef Py_TPFLAGS_CHECKTYPES
  #define Py_TPFLAGS_CHECKTYPES 0
#endif
#ifndef Py_TPFLAGS_HAVE_INDEX
  #define Py_TPFLAGS_HAVE_INDEX 0
#endif
#ifndef Py_TPFLAGS_HAVE_NEWBUFFER
  #define Py_TPFLAGS_HAVE_NEWBUFFER 0
#endif
#ifndef Py_TPFLAGS_HAVE_FINALIZE
  #define Py_TPFLAGS_HAVE_FINALIZE 0
#endif
#if PY_VERSION_HEX > 0x03030000 && defined(PyUnicode_KIND)
  #define CYTHON_PEP393_ENABLED 1
  #define __Pyx_PyUnicode_READY(op)       (likely(PyUnicode_IS_READY(op)) ? \
                                              0 : _PyUnicode_Ready((PyObject *)(op)))
  #define __Pyx_PyUnicode_GET_LENGTH(u)   PyUnicode_GET_LENGTH(u)
  #define __Pyx_PyUnicode_READ_CHAR(u, i) PyUnicode_READ_CHAR(u, i)
  #define __Pyx_PyUnicode_KIND(u)         PyUnicode_KIND(u)
  #define __Pyx_PyUnicode_DATA(u)         PyUnicode_DATA(u)
  #define __Pyx_PyUnicode_READ(k, d, i)   PyUnicode_READ(k, d, i)
#else
  #define CYTHON_PEP393_ENABLED 0
  #define __Pyx_PyUnicode_READY(op)       (0)
  #define __Pyx_PyUnicode_GET_LENGTH(u)   PyUnicode_GET_SIZE(u)
  #define __Pyx_PyUnicode_READ_CHAR(u, i) ((Py_UCS4)(PyUnicode_AS_UNICODE(u)[i]))
  #define __Pyx_PyUnicode_KIND(u)         (sizeof(Py_UNICODE))
  #define __Pyx_PyUnicode_DATA(u)         ((void*)PyUnicode_AS_UNICODE(u))
  #define __Pyx_PyUnicode_READ(k, d, i)   ((void)(k), (Py_UCS4)(((Py_UNICODE*)d)[i]))
#endif
#if CYTHON_COMPILING_IN_PYPY
  #define __Pyx_PyUnicode_Concat(a, b)      PyNumber_Add(a, b)
  #define __Pyx_PyUnicode_ConcatSafe(a, b)  PyNumber_Add(a, b)
  #define __Pyx_PyFrozenSet_Size(s)         PyObject_Size(s)
#else
  #define __Pyx_PyUnicode_Concat(a, b)      PyUnicode_Concat(a, b)
  #define __Pyx_PyUnicode_ConcatSafe(a, b)  ((unlikely((a) == Py_None) || unlikely((b) == Py_None)) ? \
      PyNumber_Add(a, b) : __Pyx_PyUnicode_Concat(a, b))
  #define __Pyx_PyFrozenSet_Size(s)         PySet_Size(s)
#endif
#if CYTHON_COMPILING_IN_PYPY && !defined(PyUnicode_Contains)
  #define PyUnicode_Contains(u, s)  PySequence_Contains(u, s)
#endif
#define __Pyx_PyString_FormatSafe(a, b)   ((unlikely((a) == Py_None)) ? PyNumber_Remainder(a, b) : __Pyx_PyString_Format(a, b))
#define __Pyx_PyUnicode_FormatSafe(a, b)  ((unlikely((a) == Py_None)) ? PyNumber_Remainder(a, b) : PyUnicode_Format(a, b))
#if PY_MAJOR_VERSION >= 3
  #define __Pyx_PyString_Format(a, b)  PyUnicode_Format(a, b)
#else
  #define __Pyx_PyString_Format(a, b)  PyString_Format(a, b)
#endif
#if PY_MAJOR_VERSION >= 3
  #define PyBaseString_Type            PyUnicode_Type
  #define PyStringObject               PyUnicodeObject
  #define PyString_Type                PyUnicode_Type
  #define PyString_Check               PyUnicode_Check
  #define PyString_CheckExact          PyUnicode_CheckExact
#endif
#if PY_MAJOR_VERSION >= 3
  #define __Pyx_PyBaseString_Check(obj) PyUnicode_Check(obj)
  #define __Pyx_PyBaseString_CheckExact(obj) PyUnicode_CheckExact(obj)
#else
  #define __Pyx_PyBaseString_Check(obj) (PyString_Check(obj) || PyUnicode_Check(obj))
  #define __Pyx_PyBaseString_CheckExact(obj) (PyString_CheckExact(obj) || PyUnicode_CheckExact(obj))
#endif
#ifndef PySet_CheckExact
  #define PySet_CheckExact(obj)        (Py_TYPE(obj) == &PySet_Type)
#endif
#define __Pyx_TypeCheck(obj, type) PyObject_TypeCheck(obj, (PyTypeObject *)type)
#if PY_MAJOR_VERSION >= 3
  #define PyIntObject                  PyLongObject
  #define PyInt_Type                   PyLong_Type
  #define PyInt_Check(op)              PyLong_Check(op)
  #define PyInt_CheckExact(op)         PyLong_CheckExact(op)
  #define PyInt_FromString             PyLong_FromString
  #define PyInt_FromUnicode            PyLong_FromUnicode
  #define PyInt_FromLong               PyLong_FromLong
  #define PyInt_FromSize_t             PyLong_FromSize_t
  #define PyInt_FromSsize_t            PyLong_FromSsize_t
  #define PyInt_AsLong                 PyLong_AsLong
  #define PyInt_AS_LONG                PyLong_AS_LONG
  #define PyInt_AsSsize_t              PyLong_AsSsize_t
  #define PyInt_AsUnsignedLongMask     PyLong_AsUnsignedLongMask
  #define PyInt_AsUnsignedLongLongMask PyLong_AsUnsignedLongLongMask
  #define PyNumber_Int                 PyNumber_Long
#endif
#if PY_MAJOR_VERSION >= 3
  #define PyBoolObject                 PyLongObject
#endif
#if PY_MAJOR_VERSION >= 3 && CYTHON_COMPILING_IN_PYPY
  #ifndef PyUnicode_InternFromString
    #define PyUnicode_InternFromString(s) PyUnicode_FromString(s)
  #endif
#endif
#if PY_VERSION_HEX < 0x030200A4
  typedef long Py_hash_t;
  #define __Pyx_PyInt_FromHash_t PyInt_FromLong
  #define __Pyx_PyInt_AsHash_t   PyInt_AsLong
#else
  #define __Pyx_PyInt_FromHash_t PyInt_FromSsize_t
  #define __Pyx_PyInt_AsHash_t   PyInt_AsSsize_t
#endif
#if PY_MAJOR_VERSION >= 3
  #define __Pyx_PyMethod_New(func, self, klass) ((self) ? PyMethod_New(func, self) : PyInstanceMethod_New(func))
#else
  #define __Pyx_PyMethod_New(func, self, klass) PyMethod_New(func, self, klass)
#endif
#ifndef CYTHON_INLINE
  #if defined(__GNUC__)
    #define CYTHON_INLINE __inline__
  #elif defined(_MSC_VER)
    #define CYTHON_INLINE __inline
  #elif defined (__STDC_VERSION__) && __STDC_VERSION__ >= 199901L
    #define CYTHON_INLINE inline
  #else
    #define CYTHON_INLINE
  #endif
#endif
#ifndef CYTHON_RESTRICT
  #if defined(__GNUC__)
    #define CYTHON_RESTRICT __restrict__
  #elif defined(_MSC_VER) && _MSC_VER >= 1400
    #define CYTHON_RESTRICT __restrict
  #elif defined (__STDC_VERSION__) && __STDC_VERSION__ >= 199901L
    #define CYTHON_RESTRICT restrict
  #else
    #define CYTHON_RESTRICT
  #endif
#endif
#ifdef NAN
#define __PYX_NAN() ((float) NAN)
#else
static CYTHON_INLINE float __PYX_NAN() {
  /* Initialize NaN. The sign is irrelevant, an exponent with all bits 1 and
   a nonzero mantissa means NaN. If the first bit in the mantissa is 1, it is
   a quiet NaN. */
  float value;
  memset(&value, 0xFF, sizeof(value));
  return value;
}
#endif
#define __Pyx_void_to_None(void_result) (void_result, Py_INCREF(Py_None), Py_None)
#ifdef __cplusplus
template<typename T>
void __Pyx_call_destructor(T* x) {
    x->~T();
}
template<typename T>
class __Pyx_FakeReference {
  public:
    __Pyx_FakeReference() : ptr(NULL) { }
    __Pyx_FakeReference(T& ref) : ptr(&ref) { }
    T *operator->() { return ptr; }
    operator T&() { return *ptr; }
  private:
    T *ptr;
};
#endif


#if PY_MAJOR_VERSION >= 3
  #define __Pyx_PyNumber_Divide(x,y)         PyNumber_TrueDivide(x,y)
  #define __Pyx_PyNumber_InPlaceDivide(x,y)  PyNumber_InPlaceTrueDivide(x,y)
#else
  #define __Pyx_PyNumber_Divide(x,y)         PyNumber_Divide(x,y)
  #define __Pyx_PyNumber_InPlaceDivide(x,y)  PyNumber_InPlaceDivide(x,y)
#endif

#ifndef __PYX_EXTERN_C
  #ifdef __cplusplus
    #define __PYX_EXTERN_C extern "C"
  #else
    #define __PYX_EXTERN_C extern
  #endif
#endif

#if defined(WIN32) || defined(MS_WINDOWS)
#define _USE_MATH_DEFINES
#endif
#include <math.h>
#define __PYX_HAVE__eval7__equity
#define __PYX_HAVE_API__eval7__equity
#include "stdlib.h"
#ifdef _OPENMP
#include <omp.h>
#endif /* _OPENMP */

#ifdef PYREX_WITHOUT_ASSERTIONS
#define CYTHON_WITHOUT_ASSERTIONS
#endif

#ifndef CYTHON_UNUSED
# if defined(__GNUC__)
#   if !(defined(__cplusplus)) || (__GNUC__ > 3 || (__GNUC__ == 3 && __GNUC_MINOR__ >= 4))
#     define CYTHON_UNUSED __attribute__ ((__unused__))
#   else
#     define CYTHON_UNUSED
#   endif
# elif defined(__ICC) || (defined(__INTEL_COMPILER) && !defined(_MSC_VER))
#   define CYTHON_UNUSED __attribute__ ((__unused__))
# else
#   define CYTHON_UNUSED
# endif
#endif
#ifndef CYTHON_NCP_UNUSED
# if CYTHON_COMPILING_IN_CPYTHON
#  define CYTHON_NCP_UNUSED
# else
#  define CYTHON_NCP_UNUSED CYTHON_UNUSED
# endif
#endif
typedef struct {PyObject **p; char *s; const Py_ssize_t n; const char* encoding;
                const char is_unicode; const char is_str; const char intern; } __Pyx_StringTabEntry;

#define __PYX_DEFAULT_STRING_ENCODING_IS_ASCII 0
#define __PYX_DEFAULT_STRING_ENCODING_IS_DEFAULT 0
#define __PYX_DEFAULT_STRING_ENCODING ""
#define __Pyx_PyObject_FromString __Pyx_PyBytes_FromString
#define __Pyx_PyObject_FromStringAndSize __Pyx_PyBytes_FromStringAndSize
#define __Pyx_fits_Py_ssize_t(v, type, is_signed)  (    \
    (sizeof(type) < sizeof(Py_ssize_t))  ||             \
    (sizeof(type) > sizeof(Py_ssize_t) &&               \
          likely(v < (type)PY_SSIZE_T_MAX ||            \
                 v == (type)PY_SSIZE_T_MAX)  &&         \
          (!is_signed || likely(v > (type)PY_SSIZE_T_MIN ||       \
                                v == (type)PY_SSIZE_T_MIN)))  ||  \
    (sizeof(type) == sizeof(Py_ssize_t) &&              \
          (is_signed || likely(v < (type)PY_SSIZE_T_MAX ||        \
                               v == (type)PY_SSIZE_T_MAX)))  )
static CYTHON_INLINE char* __Pyx_PyObject_AsString(PyObject*);
static CYTHON_INLINE char* __Pyx_PyObject_AsStringAndSize(PyObject*, Py_ssize_t* length);
#define __Pyx_PyByteArray_FromString(s) PyByteArray_FromStringAndSize((const char*)s, strlen((const char*)s))
#define __Pyx_PyByteArray_FromStringAndSize(s, l) PyByteArray_FromStringAndSize((const char*)s, l)
#define __Pyx_PyBytes_FromString        PyBytes_FromString
#define __Pyx_PyBytes_FromStringAndSize PyBytes_FromStringAndSize
static CYTHON_INLINE PyObject* __Pyx_PyUnicode_FromString(const char*);
#if PY_MAJOR_VERSION < 3
    #define __Pyx_PyStr_FromString        __Pyx_PyBytes_FromString
    #define __Pyx_PyStr_FromStringAndSize __Pyx_PyBytes_FromStringAndSize
#else
    #define __Pyx_PyStr_FromString        __Pyx_PyUnicode_FromString
    #define __Pyx_PyStr_FromStringAndSize __Pyx_PyUnicode_FromStringAndSize
#endif
#define __Pyx_PyObject_AsSString(s)    ((signed char*) __Pyx_PyObject_AsString(s))
#define __Pyx_PyObject_AsUString(s)    ((unsigned char*) __Pyx_PyObject_AsString(s))
#define __Pyx_PyObject_FromCString(s)  __Pyx_PyObject_FromString((const char*)s)
#define __Pyx_PyBytes_FromCString(s)   __Pyx_PyBytes_FromString((const char*)s)
#define __Pyx_PyByteArray_FromCString(s)   __Pyx_PyByteArray_FromString((const char*)s)
#define __Pyx_PyStr_FromCString(s)     __Pyx_PyStr_FromString((const char*)s)
#define __Pyx_PyUnicode_FromCString(s) __Pyx_PyUnicode_FromString((const char*)s)
#if PY_MAJOR_VERSION < 3
static CYTHON_INLINE size_t __Pyx_Py_UNICODE_strlen(const Py_UNICODE *u)
{
    const Py_UNICODE *u_end = u;
    while (*u_end++) ;
    return (size_t)(u_end - u - 1);
}
#else
#define __Pyx_Py_UNICODE_strlen Py_UNICODE_strlen
#endif
#define __Pyx_PyUnicode_FromUnicode(u)       PyUnicode_FromUnicode(u, __Pyx_Py_UNICODE_strlen(u))
#define __Pyx_PyUnicode_FromUnicodeAndLength PyUnicode_FromUnicode
#define __Pyx_PyUnicode_AsUnicode            PyUnicode_AsUnicode
#define __Pyx_Owned_Py_None(b) (Py_INCREF(Py_None), Py_None)
#define __Pyx_PyBool_FromLong(b) ((b) ? (Py_INCREF(Py_True), Py_True) : (Py_INCREF(Py_False), Py_False))
static CYTHON_INLINE int __Pyx_PyObject_IsTrue(PyObject*);
static CYTHON_INLINE PyObject* __Pyx_PyNumber_Int(PyObject* x);
static CYTHON_INLINE Py_ssize_t __Pyx_PyIndex_AsSsize_t(PyObject*);
static CYTHON_INLINE PyObject * __Pyx_PyInt_FromSize_t(size_t);
#if CYTHON_COMPILING_IN_CPYTHON
#define __pyx_PyFloat_AsDouble(x) (PyFloat_CheckExact(x) ? PyFloat_AS_DOUBLE(x) : PyFloat_AsDouble(x))
#else
#define __pyx_PyFloat_AsDouble(x) PyFloat_AsDouble(x)
#endif
#define __pyx_PyFloat_AsFloat(x) ((float) __pyx_PyFloat_AsDouble(x))
#if PY_MAJOR_VERSION < 3 && __PYX_DEFAULT_STRING_ENCODING_IS_ASCII
static int __Pyx_sys_getdefaultencoding_not_ascii;
static int __Pyx_init_sys_getdefaultencoding_params(void) {
    PyObject* sys;
    PyObject* default_encoding = NULL;
    PyObject* ascii_chars_u = NULL;
    PyObject* ascii_chars_b = NULL;
    const char* default_encoding_c;
    sys = PyImport_ImportModule("sys");
    if (!sys) goto bad;
    default_encoding = PyObject_CallMethod(sys, (char*) "getdefaultencoding", NULL);
    Py_DECREF(sys);
    if (!default_encoding) goto bad;
    default_encoding_c = PyBytes_AsString(default_encoding);
    if (!default_encoding_c) goto bad;
    if (strcmp(default_encoding_c, "ascii") == 0) {
        __Pyx_sys_getdefaultencoding_not_ascii = 0;
    } else {
        char ascii_chars[128];
        int c;
        for (c = 0; c < 128; c++) {
            ascii_chars[c] = c;
        }
        __Pyx_sys_getdefaultencoding_not_ascii = 1;
        ascii_chars_u = PyUnicode_DecodeASCII(ascii_chars, 128, NULL);
        if (!ascii_chars_u) goto bad;
        ascii_chars_b = PyUnicode_AsEncodedString(ascii_chars_u, default_encoding_c, NULL);
        if (!ascii_chars_b || !PyBytes_Check(ascii_chars_b) || memcmp(ascii_chars, PyBytes_AS_STRING(ascii_chars_b), 128) != 0) {
            PyErr_Format(
                PyExc_ValueError,
                "This module compiled with c_string_encoding=ascii, but default encoding '%.200s' is not a superset of ascii.",
                default_encoding_c);
            goto bad;
        }
        Py_DECREF(ascii_chars_u);
        Py_DECREF(ascii_chars_b);
    }
    Py_DECREF(default_encoding);
    return 0;
bad:
    Py_XDECREF(default_encoding);
    Py_XDECREF(ascii_chars_u);
    Py_XDECREF(ascii_chars_b);
    return -1;
}
#endif
#if __PYX_DEFAULT_STRING_ENCODING_IS_DEFAULT && PY_MAJOR_VERSION >= 3
#define __Pyx_PyUnicode_FromStringAndSize(c_str, size) PyUnicode_DecodeUTF8(c_str, size, NULL)
#else
#define __Pyx_PyUnicode_FromStringAndSize(c_str, size) PyUnicode_Decode(c_str, size, __PYX_DEFAULT_STRING_ENCODING, NULL)
#if __PYX_DEFAULT_STRING_ENCODING_IS_DEFAULT
static char* __PYX_DEFAULT_STRING_ENCODING;
static int __Pyx_init_sys_getdefaultencoding_params(void) {
    PyObject* sys;
    PyObject* default_encoding = NULL;
    char* default_encoding_c;
    sys = PyImport_ImportModule("sys");
    if (!sys) goto bad;
    default_encoding = PyObject_CallMethod(sys, (char*) (const char*) "getdefaultencoding", NULL);
    Py_DECREF(sys);
    if (!default_encoding) goto bad;
    default_encoding_c = PyBytes_AsString(default_encoding);
    if (!default_encoding_c) goto bad;
    __PYX_DEFAULT_STRING_ENCODING = (char*) malloc(strlen(default_encoding_c));
    if (!__PYX_DEFAULT_STRING_ENCODING) goto bad;
    strcpy(__PYX_DEFAULT_STRING_ENCODING, default_encoding_c);
    Py_DECREF(default_encoding);
    return 0;
bad:
    Py_XDECREF(default_encoding);
    return -1;
}
#endif
#endif


/* Test for GCC > 2.95 */
#if defined(__GNUC__)     && (__GNUC__ > 2 || (__GNUC__ == 2 && (__GNUC_MINOR__ > 95)))
  #define likely(x)   __builtin_expect(!!(x), 1)
  #define unlikely(x) __builtin_expect(!!(x), 0)
#else /* !__GNUC__ or GCC < 2.95 */
  #define likely(x)   (x)
  #define unlikely(x) (x)
#endif /* __GNUC__ */

static PyObject *__pyx_m;
static PyObject *__pyx_d;
static PyObject *__pyx_b;
static PyObject *__pyx_empty_tuple;
static PyObject *__pyx_empty_bytes;
static int __pyx_lineno;
static int __pyx_clineno = 0;
static const char * __pyx_cfilenm= __FILE__;
static const char *__pyx_filename;


static const char *__pyx_f[] = {
  "eval7/equity.pyx",
  "eval7/cards.pxd",
};

/*--- Type declarations ---*/
struct __pyx_obj_5eval7_5cards_Card;

/* "cards.pxd":8
 * import cython
 * 
 * cdef class Card:             # <<<<<<<<<<<<<<
 *     cdef public cython.ulonglong mask
 *     cdef public cython.ushort rank, suit
 */
struct __pyx_obj_5eval7_5cards_Card {
  PyObject_HEAD
  unsigned PY_LONG_LONG mask;
  unsigned short rank;
  unsigned short suit;
};


/* --- Runtime support code (head) --- */
#ifndef CYTHON_REFNANNY
  #define CYTHON_REFNANNY 0
#endif
#if CYTHON_REFNANNY
  typedef struct {
    void (*INCREF)(void*, PyObject*, int);
    void (*DECREF)(void*, PyObject*, int);
    void (*GOTREF)(void*, PyObject*, int);
    void (*GIVEREF)(void*, PyObject*, int);
    void* (*SetupContext)(const char*, int, const char*);
    void (*FinishContext)(void**);
  } __Pyx_RefNannyAPIStruct;
  static __Pyx_RefNannyAPIStruct *__Pyx_RefNanny = NULL;
  static __Pyx_RefNannyAPIStruct *__Pyx_RefNannyImportAPI(const char *modname);
  #define __Pyx_RefNannyDeclarations void *__pyx_refnanny = NULL;
#ifdef WITH_THREAD
  #define __Pyx_RefNannySetupContext(name, acquire_gil) \
          if (acquire_gil) { \
              PyGILState_STATE __pyx_gilstate_save = PyGILState_Ensure(); \
              __pyx_refnanny = __Pyx_RefNanny->SetupContext((name), __LINE__, __FILE__); \
              PyGILState_Release(__pyx_gilstate_save); \
          } else { \
              __pyx_refnanny = __Pyx_RefNanny->SetupContext((name), __LINE__, __FILE__); \
          }
#else
  #define __Pyx_RefNannySetupContext(name, acquire_gil) \
          __pyx_refnanny = __Pyx_RefNanny->SetupContext((name), __LINE__, __FILE__)
#endif
  #define __Pyx_RefNannyFinishContext() \
          __Pyx_RefNanny->FinishContext(&__pyx_refnanny)
  #define __Pyx_INCREF(r)  __Pyx_RefNanny->INCREF(__pyx_refnanny, (PyObject *)(r), __LINE__)
  #define __Pyx_DECREF(r)  __Pyx_RefNanny->DECREF(__pyx_refnanny, (PyObject *)(r), __LINE__)
  #define __Pyx_GOTREF(r)  __Pyx_RefNanny->GOTREF(__pyx_refnanny, (PyObject *)(r), __LINE__)
  #define __Pyx_GIVEREF(r) __Pyx_RefNanny->GIVEREF(__pyx_refnanny, (PyObject *)(r), __LINE__)
  #define __Pyx_XINCREF(r)  do { if((r) != NULL) {__Pyx_INCREF(r); }} while(0)
  #define __Pyx_XDECREF(r)  do { if((r) != NULL) {__Pyx_DECREF(r); }} while(0)
  #define __Pyx_XGOTREF(r)  do { if((r) != NULL) {__Pyx_GOTREF(r); }} while(0)
  #define __Pyx_XGIVEREF(r) do { if((r) != NULL) {__Pyx_GIVEREF(r);}} while(0)
#else
  #define __Pyx_RefNannyDeclarations
  #define __Pyx_RefNannySetupContext(name, acquire_gil)
  #define __Pyx_RefNannyFinishContext()
  #define __Pyx_INCREF(r) Py_INCREF(r)
  #define __Pyx_DECREF(r) Py_DECREF(r)
  #define __Pyx_GOTREF(r)
  #define __Pyx_GIVEREF(r)
  #define __Pyx_XINCREF(r) Py_XINCREF(r)
  #define __Pyx_XDECREF(r) Py_XDECREF(r)
  #define __Pyx_XGOTREF(r)
  #define __Pyx_XGIVEREF(r)
#endif
#define __Pyx_XDECREF_SET(r, v) do {                            \
        PyObject *tmp = (PyObject *) r;                         \
        r = v; __Pyx_XDECREF(tmp);                              \
    } while (0)
#define __Pyx_DECREF_SET(r, v) do {                             \
        PyObject *tmp = (PyObject *) r;                         \
        r = v; __Pyx_DECREF(tmp);                               \
    } while (0)
#define __Pyx_CLEAR(r)    do { PyObject* tmp = ((PyObject*)(r)); r = NULL; __Pyx_DECREF(tmp);} while(0)
#define __Pyx_XCLEAR(r)   do { if((r) != NULL) {PyObject* tmp = ((PyObject*)(r)); r = NULL; __Pyx_DECREF(tmp);}} while(0)

#if CYTHON_COMPILING_IN_CPYTHON
static CYTHON_INLINE PyObject* __Pyx_PyObject_GetAttrStr(PyObject* obj, PyObject* attr_name) {
    PyTypeObject* tp = Py_TYPE(obj);
    if (likely(tp->tp_getattro))
        return tp->tp_getattro(obj, attr_name);
#if PY_MAJOR_VERSION < 3
    if (likely(tp->tp_getattr))
        return tp->tp_getattr(obj, PyString_AS_STRING(attr_name));
#endif
    return PyObject_GetAttr(obj, attr_name);
}
#else
#define __Pyx_PyObject_GetAttrStr(o,n) PyObject_GetAttr(o,n)
#endif

static PyObject *__Pyx_GetBuiltinName(PyObject *name);

#if CYTHON_COMPILING_IN_CPYTHON
static CYTHON_INLINE PyObject* __Pyx_PyObject_Call(PyObject *func, PyObject *arg, PyObject *kw);
#else
#define __Pyx_PyObject_Call(func, arg, kw) PyObject_Call(func, arg, kw)
#endif

static CYTHON_INLINE void __Pyx_ErrRestore(PyObject *type, PyObject *value, PyObject *tb);
static CYTHON_INLINE void __Pyx_ErrFetch(PyObject **type, PyObject **value, PyObject **tb);

static void __Pyx_WriteUnraisable(const char *name, int clineno,
                                  int lineno, const char *filename,
                                  int full_traceback, int nogil);

#ifndef __PYX_FORCE_INIT_THREADS
  #define __PYX_FORCE_INIT_THREADS 0
#endif

static void __Pyx_RaiseArgtupleInvalid(const char* func_name, int exact,
    Py_ssize_t num_min, Py_ssize_t num_max, Py_ssize_t num_found);

static void __Pyx_RaiseDoubleKeywordsError(const char* func_name, PyObject* kw_name);

static int __Pyx_ParseOptionalKeywords(PyObject *kwds, PyObject **argnames[], \
    PyObject *kwds2, PyObject *values[], Py_ssize_t num_pos_args, \
    const char* function_name);

#define __Pyx_GetItemInt(o, i, type, is_signed, to_py_func, is_list, wraparound, boundscheck) \
    (__Pyx_fits_Py_ssize_t(i, type, is_signed) ? \
    __Pyx_GetItemInt_Fast(o, (Py_ssize_t)i, is_list, wraparound, boundscheck) : \
    (is_list ? (PyErr_SetString(PyExc_IndexError, "list index out of range"), (PyObject*)NULL) : \
               __Pyx_GetItemInt_Generic(o, to_py_func(i))))
#define __Pyx_GetItemInt_List(o, i, type, is_signed, to_py_func, is_list, wraparound, boundscheck) \
    (__Pyx_fits_Py_ssize_t(i, type, is_signed) ? \
    __Pyx_GetItemInt_List_Fast(o, (Py_ssize_t)i, wraparound, boundscheck) : \
    (PyErr_SetString(PyExc_IndexError, "list index out of range"), (PyObject*)NULL))
static CYTHON_INLINE PyObject *__Pyx_GetItemInt_List_Fast(PyObject *o, Py_ssize_t i,
                                                              int wraparound, int boundscheck);
#define __Pyx_GetItemInt_Tuple(o, i, type, is_signed, to_py_func, is_list, wraparound, boundscheck) \
    (__Pyx_fits_Py_ssize_t(i, type, is_signed) ? \
    __Pyx_GetItemInt_Tuple_Fast(o, (Py_ssize_t)i, wraparound, boundscheck) : \
    (PyErr_SetString(PyExc_IndexError, "tuple index out of range"), (PyObject*)NULL))
static CYTHON_INLINE PyObject *__Pyx_GetItemInt_Tuple_Fast(PyObject *o, Py_ssize_t i,
                                                              int wraparound, int boundscheck);
static CYTHON_INLINE PyObject *__Pyx_GetItemInt_Generic(PyObject *o, PyObject* j);
static CYTHON_INLINE PyObject *__Pyx_GetItemInt_Fast(PyObject *o, Py_ssize_t i,
                                                     int is_list, int wraparound, int boundscheck);

static CYTHON_INLINE void __Pyx_RaiseTooManyValuesError(Py_ssize_t expected);

static CYTHON_INLINE void __Pyx_RaiseNeedMoreValuesError(Py_ssize_t index);

static CYTHON_INLINE int __Pyx_IterFinish(void);

static int __Pyx_IternextUnpackEndCheck(PyObject *retval, Py_ssize_t expected);

typedef struct {
    int code_line;
    PyCodeObject* code_object;
} __Pyx_CodeObjectCacheEntry;
struct __Pyx_CodeObjectCache {
    int count;
    int max_count;
    __Pyx_CodeObjectCacheEntry* entries;
};
static struct __Pyx_CodeObjectCache __pyx_code_cache = {0,0,NULL};
static int __pyx_bisect_code_objects(__Pyx_CodeObjectCacheEntry* entries, int count, int code_line);
static PyCodeObject *__pyx_find_code_object(int code_line);
static void __pyx_insert_code_object(int code_line, PyCodeObject* code_object);

static void __Pyx_AddTraceback(const char *funcname, int c_line,
                               int py_line, const char *filename);

static CYTHON_INLINE unsigned PY_LONG_LONG __Pyx_PyInt_As_unsigned_PY_LONG_LONG(PyObject *);

static CYTHON_INLINE PyObject* __Pyx_PyInt_From_long(long value);

static CYTHON_INLINE long __Pyx_PyInt_As_long(PyObject *);

static CYTHON_INLINE int __Pyx_PyInt_As_int(PyObject *);

static CYTHON_INLINE PyObject* __Pyx_PyInt_From_int(int value);

static int __Pyx_check_binary_version(void);

#if !defined(__Pyx_PyIdentifier_FromString)
#if PY_MAJOR_VERSION < 3
  #define __Pyx_PyIdentifier_FromString(s) PyString_FromString(s)
#else
  #define __Pyx_PyIdentifier_FromString(s) PyUnicode_FromString(s)
#endif
#endif

static PyObject *__Pyx_ImportModule(const char *name);

static PyTypeObject *__Pyx_ImportType(const char *module_name, const char *class_name, size_t size, int strict);

static int __Pyx_ImportFunction(PyObject *module, const char *funcname, void (**f)(void), const char *sig);

static int __Pyx_InitStrings(__Pyx_StringTabEntry *t);


/* Module declarations from 'cython' */

/* Module declarations from 'eval7.wh_rand' */
static int (*__pyx_f_5eval7_7wh_rand_wh_randint)(int); /*proto*/

/* Module declarations from 'eval7.eval7' */
static unsigned int (*__pyx_f_5eval7_5eval7_cy_evaluate)(unsigned PY_LONG_LONG, unsigned int); /*proto*/

/* Module declarations from 'eval7.cards' */
static PyTypeObject *__pyx_ptype_5eval7_5cards_Card = 0;
static unsigned PY_LONG_LONG (*__pyx_f_5eval7_5cards_cards_to_mask)(PyObject *); /*proto*/

/* Module declarations from 'eval7.equity' */
static unsigned PY_LONG_LONG __pyx_v_5eval7_6equity_card_masks_table[52];
static unsigned int __pyx_f_5eval7_6equity_load_card_masks(void); /*proto*/
static unsigned int __pyx_f_5eval7_6equity_filter_options(unsigned PY_LONG_LONG *, unsigned PY_LONG_LONG *, unsigned int, unsigned PY_LONG_LONG); /*proto*/
static unsigned PY_LONG_LONG __pyx_f_5eval7_6equity_deal_card(unsigned PY_LONG_LONG); /*proto*/
static float __pyx_f_5eval7_6equity_hand_vs_range_monte_carlo(unsigned PY_LONG_LONG, unsigned PY_LONG_LONG *, int, unsigned PY_LONG_LONG, int, int); /*proto*/
static float __pyx_f_5eval7_6equity_hand_vs_range_exact(unsigned PY_LONG_LONG, unsigned PY_LONG_LONG *, int, unsigned PY_LONG_LONG); /*proto*/
static void __pyx_f_5eval7_6equity_all_hands_vs_range(unsigned PY_LONG_LONG *, unsigned int, unsigned PY_LONG_LONG *, unsigned int, unsigned PY_LONG_LONG, unsigned int, long, float *); /*proto*/
#define __Pyx_MODULE_NAME "eval7.equity"
int __pyx_module_is_main_eval7__equity = 0;

/* Implementation of 'eval7.equity' */
static PyObject *__pyx_builtin_range;
static PyObject *__pyx_builtin_enumerate;
static PyObject *__pyx_pf_5eval7_6equity_py_hand_vs_range_monte_carlo(CYTHON_UNUSED PyObject *__pyx_self, PyObject *__pyx_v_py_hand, PyObject *__pyx_v_py_villain, PyObject *__pyx_v_py_board, PyObject *__pyx_v_py_iterations); /* proto */
static PyObject *__pyx_pf_5eval7_6equity_2py_hand_vs_range_exact(CYTHON_UNUSED PyObject *__pyx_self, PyObject *__pyx_v_py_hand, PyObject *__pyx_v_py_villain, PyObject *__pyx_v_py_board); /* proto */
static PyObject *__pyx_pf_5eval7_6equity_4py_all_hands_vs_range(CYTHON_UNUSED PyObject *__pyx_self, PyObject *__pyx_v_py_hero, PyObject *__pyx_v_py_villain, PyObject *__pyx_v_py_board, PyObject *__pyx_v_py_iterations); /* proto */
static char __pyx_k_i[] = "i";
static char __pyx_k_dead[] = "dead";
static char __pyx_k_hand[] = "hand";
static char __pyx_k_main[] = "__main__";
static char __pyx_k_mask[] = "mask";
static char __pyx_k_test[] = "__test__";
static char __pyx_k_board[] = "board";
static char __pyx_k_hands[] = "hands";
static char __pyx_k_index[] = "index";
static char __pyx_k_range[] = "range";
static char __pyx_k_equity[] = "equity";
static char __pyx_k_option[] = "option";
static char __pyx_k_result[] = "result";
static char __pyx_k_weight[] = "weight";
static char __pyx_k_options[] = "options";
static char __pyx_k_py_hand[] = "py_hand";
static char __pyx_k_py_hero[] = "py_hero";
static char __pyx_k_py_board[] = "py_board";
static char __pyx_k_enumerate[] = "enumerate";
static char __pyx_k_num_board[] = "num_board";
static char __pyx_k_num_hands[] = "num_hands";
static char __pyx_k_py_result[] = "py_result";
static char __pyx_k_iterations[] = "iterations";
static char __pyx_k_py_villain[] = "py_villain";
static char __pyx_k_num_options[] = "num_options";
static char __pyx_k_start_board[] = "start_board";
static char __pyx_k_eval7_equity[] = "eval7.equity";
static char __pyx_k_py_iterations[] = "py_iterations";
static char __pyx_k_complete_board[] = "complete_board";
static char __pyx_k_py_all_hands_vs_range[] = "py_all_hands_vs_range";
static char __pyx_k_py_hand_vs_range_exact[] = "py_hand_vs_range_exact";
static char __pyx_k_py_hand_vs_range_monte_carlo[] = "py_hand_vs_range_monte_carlo";
static char __pyx_k_home_julian_coding_projects_pok[] = "/home/julian/coding/projects/poker/pyeval7/eval7/equity.pyx";
static PyObject *__pyx_n_s_board;
static PyObject *__pyx_n_s_complete_board;
static PyObject *__pyx_n_s_dead;
static PyObject *__pyx_n_s_enumerate;
static PyObject *__pyx_n_s_equity;
static PyObject *__pyx_n_s_eval7_equity;
static PyObject *__pyx_n_s_hand;
static PyObject *__pyx_n_s_hands;
static PyObject *__pyx_kp_s_home_julian_coding_projects_pok;
static PyObject *__pyx_n_s_i;
static PyObject *__pyx_n_s_index;
static PyObject *__pyx_n_s_iterations;
static PyObject *__pyx_n_s_main;
static PyObject *__pyx_n_s_mask;
static PyObject *__pyx_n_s_num_board;
static PyObject *__pyx_n_s_num_hands;
static PyObject *__pyx_n_s_num_options;
static PyObject *__pyx_n_s_option;
static PyObject *__pyx_n_s_options;
static PyObject *__pyx_n_s_py_all_hands_vs_range;
static PyObject *__pyx_n_s_py_board;
static PyObject *__pyx_n_s_py_hand;
static PyObject *__pyx_n_s_py_hand_vs_range_exact;
static PyObject *__pyx_n_s_py_hand_vs_range_monte_carlo;
static PyObject *__pyx_n_s_py_hero;
static PyObject *__pyx_n_s_py_iterations;
static PyObject *__pyx_n_s_py_result;
static PyObject *__pyx_n_s_py_villain;
static PyObject *__pyx_n_s_range;
static PyObject *__pyx_n_s_result;
static PyObject *__pyx_n_s_start_board;
static PyObject *__pyx_n_s_test;
static PyObject *__pyx_n_s_weight;
static PyObject *__pyx_int_0;
static PyObject *__pyx_int_1;
static PyObject *__pyx_int_52;
static PyObject *__pyx_tuple_;
static PyObject *__pyx_tuple__2;
static PyObject *__pyx_tuple__4;
static PyObject *__pyx_tuple__6;
static PyObject *__pyx_codeobj__3;
static PyObject *__pyx_codeobj__5;
static PyObject *__pyx_codeobj__7;

/* "eval7/equity.pyx":21
 * 
 * 
 * cdef cython.uint load_card_masks():             # <<<<<<<<<<<<<<
 *     for i in range(52):
 *         card_masks_table[i] = 1 << i
 */

static unsigned int __pyx_f_5eval7_6equity_load_card_masks(void) {
  PyObject *__pyx_v_i = NULL;
  unsigned int __pyx_r;
  __Pyx_RefNannyDeclarations
  PyObject *__pyx_t_1 = NULL;
  PyObject *__pyx_t_2 = NULL;
  Py_ssize_t __pyx_t_3;
  PyObject *(*__pyx_t_4)(PyObject *);
  unsigned PY_LONG_LONG __pyx_t_5;
  Py_ssize_t __pyx_t_6;
  int __pyx_lineno = 0;
  const char *__pyx_filename = NULL;
  int __pyx_clineno = 0;
  __Pyx_RefNannySetupContext("load_card_masks", 0);

  /* "eval7/equity.pyx":22
 * 
 * cdef cython.uint load_card_masks():
 *     for i in range(52):             # <<<<<<<<<<<<<<
 *         card_masks_table[i] = 1 << i
 *     return 0
 */
  __pyx_t_1 = __Pyx_PyObject_Call(__pyx_builtin_range, __pyx_tuple_, NULL); if (unlikely(!__pyx_t_1)) {__pyx_filename = __pyx_f[0]; __pyx_lineno = 22; __pyx_clineno = __LINE__; goto __pyx_L1_error;}
  __Pyx_GOTREF(__pyx_t_1);
  if (likely(PyList_CheckExact(__pyx_t_1)) || PyTuple_CheckExact(__pyx_t_1)) {
    __pyx_t_2 = __pyx_t_1; __Pyx_INCREF(__pyx_t_2); __pyx_t_3 = 0;
    __pyx_t_4 = NULL;
  } else {
    __pyx_t_3 = -1; __pyx_t_2 = PyObject_GetIter(__pyx_t_1); if (unlikely(!__pyx_t_2)) {__pyx_filename = __pyx_f[0]; __pyx_lineno = 22; __pyx_clineno = __LINE__; goto __pyx_L1_error;}
    __Pyx_GOTREF(__pyx_t_2);
    __pyx_t_4 = Py_TYPE(__pyx_t_2)->tp_iternext; if (unlikely(!__pyx_t_4)) {__pyx_filename = __pyx_f[0]; __pyx_lineno = 22; __pyx_clineno = __LINE__; goto __pyx_L1_error;}
  }
  __Pyx_DECREF(__pyx_t_1); __pyx_t_1 = 0;
  for (;;) {
    if (likely(!__pyx_t_4)) {
      if (likely(PyList_CheckExact(__pyx_t_2))) {
        if (__pyx_t_3 >= PyList_GET_SIZE(__pyx_t_2)) break;
        #if CYTHON_COMPILING_IN_CPYTHON
        __pyx_t_1 = PyList_GET_ITEM(__pyx_t_2, __pyx_t_3); __Pyx_INCREF(__pyx_t_1); __pyx_t_3++; if (unlikely(0 < 0)) {__pyx_filename = __pyx_f[0]; __pyx_lineno = 22; __pyx_clineno = __LINE__; goto __pyx_L1_error;}
        #else
        __pyx_t_1 = PySequence_ITEM(__pyx_t_2, __pyx_t_3); __pyx_t_3++; if (unlikely(!__pyx_t_1)) {__pyx_filename = __pyx_f[0]; __pyx_lineno = 22; __pyx_clineno = __LINE__; goto __pyx_L1_error;}
        __Pyx_GOTREF(__pyx_t_1);
        #endif
      } else {
        if (__pyx_t_3 >= PyTuple_GET_SIZE(__pyx_t_2)) break;
        #if CYTHON_COMPILING_IN_CPYTHON
        __pyx_t_1 = PyTuple_GET_ITEM(__pyx_t_2, __pyx_t_3); __Pyx_INCREF(__pyx_t_1); __pyx_t_3++; if (unlikely(0 < 0)) {__pyx_filename = __pyx_f[0]; __pyx_lineno = 22; __pyx_clineno = __LINE__; goto __pyx_L1_error;}
        #else
        __pyx_t_1 = PySequence_ITEM(__pyx_t_2, __pyx_t_3); __pyx_t_3++; if (unlikely(!__pyx_t_1)) {__pyx_filename = __pyx_f[0]; __pyx_lineno = 22; __pyx_clineno = __LINE__; goto __pyx_L1_error;}
        __Pyx_GOTREF(__pyx_t_1);
        #endif
      }
    } else {
      __pyx_t_1 = __pyx_t_4(__pyx_t_2);
      if (unlikely(!__pyx_t_1)) {
        PyObject* exc_type = PyErr_Occurred();
        if (exc_type) {
          if (likely(exc_type == PyExc_StopIteration || PyErr_GivenExceptionMatches(exc_type, PyExc_StopIteration))) PyErr_Clear();
          else {__pyx_filename = __pyx_f[0]; __pyx_lineno = 22; __pyx_clineno = __LINE__; goto __pyx_L1_error;}
        }
        break;
      }
      __Pyx_GOTREF(__pyx_t_1);
    }
    __Pyx_XDECREF_SET(__pyx_v_i, __pyx_t_1);
    __pyx_t_1 = 0;

    /* "eval7/equity.pyx":23
 * cdef cython.uint load_card_masks():
 *     for i in range(52):
 *         card_masks_table[i] = 1 << i             # <<<<<<<<<<<<<<
 *     return 0
 * 
 */
    __pyx_t_1 = PyNumber_Lshift(__pyx_int_1, __pyx_v_i); if (unlikely(!__pyx_t_1)) {__pyx_filename = __pyx_f[0]; __pyx_lineno = 23; __pyx_clineno = __LINE__; goto __pyx_L1_error;}
    __Pyx_GOTREF(__pyx_t_1);
    __pyx_t_5 = __Pyx_PyInt_As_unsigned_PY_LONG_LONG(__pyx_t_1); if (unlikely((__pyx_t_5 == (unsigned PY_LONG_LONG)-1) && PyErr_Occurred())) {__pyx_filename = __pyx_f[0]; __pyx_lineno = 23; __pyx_clineno = __LINE__; goto __pyx_L1_error;}
    __Pyx_DECREF(__pyx_t_1); __pyx_t_1 = 0;
    __pyx_t_6 = __Pyx_PyIndex_AsSsize_t(__pyx_v_i); if (unlikely((__pyx_t_6 == (Py_ssize_t)-1) && PyErr_Occurred())) {__pyx_filename = __pyx_f[0]; __pyx_lineno = 23; __pyx_clineno = __LINE__; goto __pyx_L1_error;}
    (__pyx_v_5eval7_6equity_card_masks_table[__pyx_t_6]) = __pyx_t_5;

    /* "eval7/equity.pyx":22
 * 
 * cdef cython.uint load_card_masks():
 *     for i in range(52):             # <<<<<<<<<<<<<<
 *         card_masks_table[i] = 1 << i
 *     return 0
 */
  }
  __Pyx_DECREF(__pyx_t_2); __pyx_t_2 = 0;

  /* "eval7/equity.pyx":24
 *     for i in range(52):
 *         card_masks_table[i] = 1 << i
 *     return 0             # <<<<<<<<<<<<<<
 * 
 * 
 */
  __pyx_r = 0;
  goto __pyx_L0;

  /* "eval7/equity.pyx":21
 * 
 * 
 * cdef cython.uint load_card_masks():             # <<<<<<<<<<<<<<
 *     for i in range(52):
 *         card_masks_table[i] = 1 << i
 */

  /* function exit code */
  __pyx_L1_error:;
  __Pyx_XDECREF(__pyx_t_1);
  __Pyx_XDECREF(__pyx_t_2);
  __Pyx_WriteUnraisable("eval7.equity.load_card_masks", __pyx_clineno, __pyx_lineno, __pyx_filename, 0, 0);
  __pyx_r = 0;
  __pyx_L0:;
  __Pyx_XDECREF(__pyx_v_i);
  __Pyx_RefNannyFinishContext();
  return __pyx_r;
}

/* "eval7/equity.pyx":30
 * 
 * 
 * cdef cython.uint filter_options(cython.ulonglong *source,             # <<<<<<<<<<<<<<
 *         cython.ulonglong *target,
 *         cython.uint num_options,
 */

static unsigned int __pyx_f_5eval7_6equity_filter_options(unsigned PY_LONG_LONG *__pyx_v_source, unsigned PY_LONG_LONG *__pyx_v_target, unsigned int __pyx_v_num_options, unsigned PY_LONG_LONG __pyx_v_dead) {
  unsigned int __pyx_v_total;
  long __pyx_v_s;
  unsigned PY_LONG_LONG __pyx_v_option;
  unsigned int __pyx_r;
  __Pyx_RefNannyDeclarations
  unsigned int __pyx_t_1;
  int __pyx_t_2;
  __Pyx_RefNannySetupContext("filter_options", 0);

  /* "eval7/equity.pyx":39
 *     """
 *     cdef cython.ulonglong options
 *     cdef cython.uint total = 0             # <<<<<<<<<<<<<<
 *     for 0 <= s < num_options:
 *         option = source[s]
 */
  __pyx_v_total = 0;

  /* "eval7/equity.pyx":40
 *     cdef cython.ulonglong options
 *     cdef cython.uint total = 0
 *     for 0 <= s < num_options:             # <<<<<<<<<<<<<<
 *         option = source[s]
 *         if option & dead == 0:
 */
  __pyx_t_1 = __pyx_v_num_options;
  for (__pyx_v_s = 0; __pyx_v_s < __pyx_t_1; __pyx_v_s++) {

    /* "eval7/equity.pyx":41
 *     cdef cython.uint total = 0
 *     for 0 <= s < num_options:
 *         option = source[s]             # <<<<<<<<<<<<<<
 *         if option & dead == 0:
 *             target[total] = option
 */
    __pyx_v_option = (__pyx_v_source[__pyx_v_s]);

    /* "eval7/equity.pyx":42
 *     for 0 <= s < num_options:
 *         option = source[s]
 *         if option & dead == 0:             # <<<<<<<<<<<<<<
 *             target[total] = option
 *             total += 1
 */
    __pyx_t_2 = (((__pyx_v_option & __pyx_v_dead) == 0) != 0);
    if (__pyx_t_2) {

      /* "eval7/equity.pyx":43
 *         option = source[s]
 *         if option & dead == 0:
 *             target[total] = option             # <<<<<<<<<<<<<<
 *             total += 1
 *     return total
 */
      (__pyx_v_target[__pyx_v_total]) = __pyx_v_option;

      /* "eval7/equity.pyx":44
 *         if option & dead == 0:
 *             target[total] = option
 *             total += 1             # <<<<<<<<<<<<<<
 *     return total
 * 
 */
      __pyx_v_total = (__pyx_v_total + 1);
      goto __pyx_L5;
    }
    __pyx_L5:;
  }

  /* "eval7/equity.pyx":45
 *             target[total] = option
 *             total += 1
 *     return total             # <<<<<<<<<<<<<<
 * 
 * 
 */
  __pyx_r = __pyx_v_total;
  goto __pyx_L0;

  /* "eval7/equity.pyx":30
 * 
 * 
 * cdef cython.uint filter_options(cython.ulonglong *source,             # <<<<<<<<<<<<<<
 *         cython.ulonglong *target,
 *         cython.uint num_options,
 */

  /* function exit code */
  __pyx_L0:;
  __Pyx_RefNannyFinishContext();
  return __pyx_r;
}

/* "eval7/equity.pyx":48
 * 
 * 
 * cdef cython.ulonglong deal_card(cython.ulonglong dead):             # <<<<<<<<<<<<<<
 *     cdef cython.uint cardex
 *     cdef cython.ulonglong card
 */

static unsigned PY_LONG_LONG __pyx_f_5eval7_6equity_deal_card(unsigned PY_LONG_LONG __pyx_v_dead) {
  unsigned int __pyx_v_cardex;
  unsigned PY_LONG_LONG __pyx_v_card;
  unsigned PY_LONG_LONG __pyx_r;
  __Pyx_RefNannyDeclarations
  int __pyx_t_1;
  __Pyx_RefNannySetupContext("deal_card", 0);

  /* "eval7/equity.pyx":51
 *     cdef cython.uint cardex
 *     cdef cython.ulonglong card
 *     while True:             # <<<<<<<<<<<<<<
 *         cardex = wh_randint(52)
 *         card = card_masks_table[cardex]
 */
  while (1) {

    /* "eval7/equity.pyx":52
 *     cdef cython.ulonglong card
 *     while True:
 *         cardex = wh_randint(52)             # <<<<<<<<<<<<<<
 *         card = card_masks_table[cardex]
 *         if dead & card == 0:
 */
    __pyx_v_cardex = __pyx_f_5eval7_7wh_rand_wh_randint(52);

    /* "eval7/equity.pyx":53
 *     while True:
 *         cardex = wh_randint(52)
 *         card = card_masks_table[cardex]             # <<<<<<<<<<<<<<
 *         if dead & card == 0:
 *             return card
 */
    __pyx_v_card = (__pyx_v_5eval7_6equity_card_masks_table[__pyx_v_cardex]);

    /* "eval7/equity.pyx":54
 *         cardex = wh_randint(52)
 *         card = card_masks_table[cardex]
 *         if dead & card == 0:             # <<<<<<<<<<<<<<
 *             return card
 * 
 */
    __pyx_t_1 = (((__pyx_v_dead & __pyx_v_card) == 0) != 0);
    if (__pyx_t_1) {

      /* "eval7/equity.pyx":55
 *         card = card_masks_table[cardex]
 *         if dead & card == 0:
 *             return card             # <<<<<<<<<<<<<<
 * 
 * 
 */
      __pyx_r = __pyx_v_card;
      goto __pyx_L0;
    }
  }

  /* "eval7/equity.pyx":48
 * 
 * 
 * cdef cython.ulonglong deal_card(cython.ulonglong dead):             # <<<<<<<<<<<<<<
 *     cdef cython.uint cardex
 *     cdef cython.ulonglong card
 */

  /* function exit code */
  __pyx_r = 0;
  __pyx_L0:;
  __Pyx_RefNannyFinishContext();
  return __pyx_r;
}

/* "eval7/equity.pyx":58
 * 
 * 
 * cdef cython.float hand_vs_range_monte_carlo(cython.ulonglong hand,             # <<<<<<<<<<<<<<
 *         cython.ulonglong *options,
 *         cython.int num_options,
 */

static float __pyx_f_5eval7_6equity_hand_vs_range_monte_carlo(unsigned PY_LONG_LONG __pyx_v_hand, unsigned PY_LONG_LONG *__pyx_v_options, int __pyx_v_num_options, unsigned PY_LONG_LONG __pyx_v_start_board, int __pyx_v_num_board, int __pyx_v_iterations) {
  unsigned int __pyx_v_count;
  unsigned int __pyx_v_option_index;
  unsigned PY_LONG_LONG __pyx_v_option;
  unsigned PY_LONG_LONG __pyx_v_dealt;
  unsigned int __pyx_v_hero;
  unsigned int __pyx_v_villain;
  unsigned PY_LONG_LONG __pyx_v_board;
  CYTHON_UNUSED long __pyx_v_i;
  CYTHON_UNUSED long __pyx_v_j;
  float __pyx_r;
  __Pyx_RefNannyDeclarations
  int __pyx_t_1;
  int __pyx_t_2;
  long __pyx_t_3;
  long __pyx_t_4;
  double __pyx_t_5;
  int __pyx_lineno = 0;
  const char *__pyx_filename = NULL;
  int __pyx_clineno = 0;
  __Pyx_RefNannySetupContext("hand_vs_range_monte_carlo", 0);

  /* "eval7/equity.pyx":73
 *     board is a hand mask of the board; num_board says how many cards are in it
 *     """
 *     cdef cython.uint count = 0             # <<<<<<<<<<<<<<
 *     cdef cython.uint option_index = 0
 *     cdef cython.ulonglong option
 */
  __pyx_v_count = 0;

  /* "eval7/equity.pyx":74
 *     """
 *     cdef cython.uint count = 0
 *     cdef cython.uint option_index = 0             # <<<<<<<<<<<<<<
 *     cdef cython.ulonglong option
 *     cdef cython.ulonglong dealt
 */
  __pyx_v_option_index = 0;

  /* "eval7/equity.pyx":80
 *     cdef cython.uint villain
 *     cdef cython.ulonglong board
 *     for 0 <= i < iterations:             # <<<<<<<<<<<<<<
 *         # choose an option for opponent's hand
 *         option = options[option_index]
 */
  __pyx_t_1 = __pyx_v_iterations;
  for (__pyx_v_i = 0; __pyx_v_i < __pyx_t_1; __pyx_v_i++) {

    /* "eval7/equity.pyx":82
 *     for 0 <= i < iterations:
 *         # choose an option for opponent's hand
 *         option = options[option_index]             # <<<<<<<<<<<<<<
 *         option_index += 1
 *         if option_index >= num_options:
 */
    __pyx_v_option = (__pyx_v_options[__pyx_v_option_index]);

    /* "eval7/equity.pyx":83
 *         # choose an option for opponent's hand
 *         option = options[option_index]
 *         option_index += 1             # <<<<<<<<<<<<<<
 *         if option_index >= num_options:
 *             option_index = 0
 */
    __pyx_v_option_index = (__pyx_v_option_index + 1);

    /* "eval7/equity.pyx":84
 *         option = options[option_index]
 *         option_index += 1
 *         if option_index >= num_options:             # <<<<<<<<<<<<<<
 *             option_index = 0
 *         # deal the rest of the board
 */
    __pyx_t_2 = ((__pyx_v_option_index >= __pyx_v_num_options) != 0);
    if (__pyx_t_2) {

      /* "eval7/equity.pyx":85
 *         option_index += 1
 *         if option_index >= num_options:
 *             option_index = 0             # <<<<<<<<<<<<<<
 *         # deal the rest of the board
 *         dealt = hand | option
 */
      __pyx_v_option_index = 0;
      goto __pyx_L5;
    }
    __pyx_L5:;

    /* "eval7/equity.pyx":87
 *             option_index = 0
 *         # deal the rest of the board
 *         dealt = hand | option             # <<<<<<<<<<<<<<
 *         board = start_board
 *         for j in range(5 - num_board):
 */
    __pyx_v_dealt = (__pyx_v_hand | __pyx_v_option);

    /* "eval7/equity.pyx":88
 *         # deal the rest of the board
 *         dealt = hand | option
 *         board = start_board             # <<<<<<<<<<<<<<
 *         for j in range(5 - num_board):
 *             board |= deal_card(board | dealt)
 */
    __pyx_v_board = __pyx_v_start_board;

    /* "eval7/equity.pyx":89
 *         dealt = hand | option
 *         board = start_board
 *         for j in range(5 - num_board):             # <<<<<<<<<<<<<<
 *             board |= deal_card(board | dealt)
 *         hero = cy_evaluate(board | hand, 7)
 */
    __pyx_t_3 = (5 - __pyx_v_num_board);
    for (__pyx_t_4 = 0; __pyx_t_4 < __pyx_t_3; __pyx_t_4+=1) {
      __pyx_v_j = __pyx_t_4;

      /* "eval7/equity.pyx":90
 *         board = start_board
 *         for j in range(5 - num_board):
 *             board |= deal_card(board | dealt)             # <<<<<<<<<<<<<<
 *         hero = cy_evaluate(board | hand, 7)
 *         villain = cy_evaluate(board | option, 7)
 */
      __pyx_v_board = (__pyx_v_board | __pyx_f_5eval7_6equity_deal_card((__pyx_v_board | __pyx_v_dealt)));
    }

    /* "eval7/equity.pyx":91
 *         for j in range(5 - num_board):
 *             board |= deal_card(board | dealt)
 *         hero = cy_evaluate(board | hand, 7)             # <<<<<<<<<<<<<<
 *         villain = cy_evaluate(board | option, 7)
 *         if hero > villain:
 */
    __pyx_v_hero = __pyx_f_5eval7_5eval7_cy_evaluate((__pyx_v_board | __pyx_v_hand), 7);

    /* "eval7/equity.pyx":92
 *             board |= deal_card(board | dealt)
 *         hero = cy_evaluate(board | hand, 7)
 *         villain = cy_evaluate(board | option, 7)             # <<<<<<<<<<<<<<
 *         if hero > villain:
 *             count += 2
 */
    __pyx_v_villain = __pyx_f_5eval7_5eval7_cy_evaluate((__pyx_v_board | __pyx_v_option), 7);

    /* "eval7/equity.pyx":93
 *         hero = cy_evaluate(board | hand, 7)
 *         villain = cy_evaluate(board | option, 7)
 *         if hero > villain:             # <<<<<<<<<<<<<<
 *             count += 2
 *         elif hero == villain:
 */
    __pyx_t_2 = ((__pyx_v_hero > __pyx_v_villain) != 0);
    if (__pyx_t_2) {

      /* "eval7/equity.pyx":94
 *         villain = cy_evaluate(board | option, 7)
 *         if hero > villain:
 *             count += 2             # <<<<<<<<<<<<<<
 *         elif hero == villain:
 *             count += 1
 */
      __pyx_v_count = (__pyx_v_count + 2);
      goto __pyx_L8;
    }

    /* "eval7/equity.pyx":95
 *         if hero > villain:
 *             count += 2
 *         elif hero == villain:             # <<<<<<<<<<<<<<
 *             count += 1
 *     return 0.5 * <cython.double>count / <cython.double>iterations
 */
    __pyx_t_2 = ((__pyx_v_hero == __pyx_v_villain) != 0);
    if (__pyx_t_2) {

      /* "eval7/equity.pyx":96
 *             count += 2
 *         elif hero == villain:
 *             count += 1             # <<<<<<<<<<<<<<
 *     return 0.5 * <cython.double>count / <cython.double>iterations
 * 
 */
      __pyx_v_count = (__pyx_v_count + 1);
      goto __pyx_L8;
    }
    __pyx_L8:;
  }

  /* "eval7/equity.pyx":97
 *         elif hero == villain:
 *             count += 1
 *     return 0.5 * <cython.double>count / <cython.double>iterations             # <<<<<<<<<<<<<<
 * 
 * 
 */
  __pyx_t_5 = (0.5 * ((double)__pyx_v_count));
  if (unlikely(((double)__pyx_v_iterations) == 0)) {
    #ifdef WITH_THREAD
    PyGILState_STATE __pyx_gilstate_save = PyGILState_Ensure();
    #endif
    PyErr_SetString(PyExc_ZeroDivisionError, "float division");
    #ifdef WITH_THREAD
    PyGILState_Release(__pyx_gilstate_save);
    #endif
    {__pyx_filename = __pyx_f[0]; __pyx_lineno = 97; __pyx_clineno = __LINE__; goto __pyx_L1_error;}
  }
  __pyx_r = (__pyx_t_5 / ((double)__pyx_v_iterations));
  goto __pyx_L0;

  /* "eval7/equity.pyx":58
 * 
 * 
 * cdef cython.float hand_vs_range_monte_carlo(cython.ulonglong hand,             # <<<<<<<<<<<<<<
 *         cython.ulonglong *options,
 *         cython.int num_options,
 */

  /* function exit code */
  __pyx_L1_error:;
  __Pyx_WriteUnraisable("eval7.equity.hand_vs_range_monte_carlo", __pyx_clineno, __pyx_lineno, __pyx_filename, 0, 0);
  __pyx_r = 0;
  __pyx_L0:;
  __Pyx_RefNannyFinishContext();
  return __pyx_r;
}

/* "eval7/equity.pyx":100
 * 
 * 
 * def py_hand_vs_range_monte_carlo(py_hand, py_villain, py_board,             # <<<<<<<<<<<<<<
 *         py_iterations):
 *     cdef cython.ulonglong hand = cards_to_mask(py_hand)
 */

/* Python wrapper */
static PyObject *__pyx_pw_5eval7_6equity_1py_hand_vs_range_monte_carlo(PyObject *__pyx_self, PyObject *__pyx_args, PyObject *__pyx_kwds); /*proto*/
static PyMethodDef __pyx_mdef_5eval7_6equity_1py_hand_vs_range_monte_carlo = {"py_hand_vs_range_monte_carlo", (PyCFunction)__pyx_pw_5eval7_6equity_1py_hand_vs_range_monte_carlo, METH_VARARGS|METH_KEYWORDS, 0};
static PyObject *__pyx_pw_5eval7_6equity_1py_hand_vs_range_monte_carlo(PyObject *__pyx_self, PyObject *__pyx_args, PyObject *__pyx_kwds) {
  PyObject *__pyx_v_py_hand = 0;
  PyObject *__pyx_v_py_villain = 0;
  PyObject *__pyx_v_py_board = 0;
  PyObject *__pyx_v_py_iterations = 0;
  int __pyx_lineno = 0;
  const char *__pyx_filename = NULL;
  int __pyx_clineno = 0;
  PyObject *__pyx_r = 0;
  __Pyx_RefNannyDeclarations
  __Pyx_RefNannySetupContext("py_hand_vs_range_monte_carlo (wrapper)", 0);
  {
    static PyObject **__pyx_pyargnames[] = {&__pyx_n_s_py_hand,&__pyx_n_s_py_villain,&__pyx_n_s_py_board,&__pyx_n_s_py_iterations,0};
    PyObject* values[4] = {0,0,0,0};
    if (unlikely(__pyx_kwds)) {
      Py_ssize_t kw_args;
      const Py_ssize_t pos_args = PyTuple_GET_SIZE(__pyx_args);
      switch (pos_args) {
        case  4: values[3] = PyTuple_GET_ITEM(__pyx_args, 3);
        case  3: values[2] = PyTuple_GET_ITEM(__pyx_args, 2);
        case  2: values[1] = PyTuple_GET_ITEM(__pyx_args, 1);
        case  1: values[0] = PyTuple_GET_ITEM(__pyx_args, 0);
        case  0: break;
        default: goto __pyx_L5_argtuple_error;
      }
      kw_args = PyDict_Size(__pyx_kwds);
      switch (pos_args) {
        case  0:
        if (likely((values[0] = PyDict_GetItem(__pyx_kwds, __pyx_n_s_py_hand)) != 0)) kw_args--;
        else goto __pyx_L5_argtuple_error;
        case  1:
        if (likely((values[1] = PyDict_GetItem(__pyx_kwds, __pyx_n_s_py_villain)) != 0)) kw_args--;
        else {
          __Pyx_RaiseArgtupleInvalid("py_hand_vs_range_monte_carlo", 1, 4, 4, 1); {__pyx_filename = __pyx_f[0]; __pyx_lineno = 100; __pyx_clineno = __LINE__; goto __pyx_L3_error;}
        }
        case  2:
        if (likely((values[2] = PyDict_GetItem(__pyx_kwds, __pyx_n_s_py_board)) != 0)) kw_args--;
        else {
          __Pyx_RaiseArgtupleInvalid("py_hand_vs_range_monte_carlo", 1, 4, 4, 2); {__pyx_filename = __pyx_f[0]; __pyx_lineno = 100; __pyx_clineno = __LINE__; goto __pyx_L3_error;}
        }
        case  3:
        if (likely((values[3] = PyDict_GetItem(__pyx_kwds, __pyx_n_s_py_iterations)) != 0)) kw_args--;
        else {
          __Pyx_RaiseArgtupleInvalid("py_hand_vs_range_monte_carlo", 1, 4, 4, 3); {__pyx_filename = __pyx_f[0]; __pyx_lineno = 100; __pyx_clineno = __LINE__; goto __pyx_L3_error;}
        }
      }
      if (unlikely(kw_args > 0)) {
        if (unlikely(__Pyx_ParseOptionalKeywords(__pyx_kwds, __pyx_pyargnames, 0, values, pos_args, "py_hand_vs_range_monte_carlo") < 0)) {__pyx_filename = __pyx_f[0]; __pyx_lineno = 100; __pyx_clineno = __LINE__; goto __pyx_L3_error;}
      }
    } else if (PyTuple_GET_SIZE(__pyx_args) != 4) {
      goto __pyx_L5_argtuple_error;
    } else {
      values[0] = PyTuple_GET_ITEM(__pyx_args, 0);
      values[1] = PyTuple_GET_ITEM(__pyx_args, 1);
      values[2] = PyTuple_GET_ITEM(__pyx_args, 2);
      values[3] = PyTuple_GET_ITEM(__pyx_args, 3);
    }
    __pyx_v_py_hand = values[0];
    __pyx_v_py_villain = values[1];
    __pyx_v_py_board = values[2];
    __pyx_v_py_iterations = values[3];
  }
  goto __pyx_L4_argument_unpacking_done;
  __pyx_L5_argtuple_error:;
  __Pyx_RaiseArgtupleInvalid("py_hand_vs_range_monte_carlo", 1, 4, 4, PyTuple_GET_SIZE(__pyx_args)); {__pyx_filename = __pyx_f[0]; __pyx_lineno = 100; __pyx_clineno = __LINE__; goto __pyx_L3_error;}
  __pyx_L3_error:;
  __Pyx_AddTraceback("eval7.equity.py_hand_vs_range_monte_carlo", __pyx_clineno, __pyx_lineno, __pyx_filename);
  __Pyx_RefNannyFinishContext();
  return NULL;
  __pyx_L4_argument_unpacking_done:;
  __pyx_r = __pyx_pf_5eval7_6equity_py_hand_vs_range_monte_carlo(__pyx_self, __pyx_v_py_hand, __pyx_v_py_villain, __pyx_v_py_board, __pyx_v_py_iterations);

  /* function exit code */
  __Pyx_RefNannyFinishContext();
  return __pyx_r;
}

static PyObject *__pyx_pf_5eval7_6equity_py_hand_vs_range_monte_carlo(CYTHON_UNUSED PyObject *__pyx_self, PyObject *__pyx_v_py_hand, PyObject *__pyx_v_py_villain, PyObject *__pyx_v_py_board, PyObject *__pyx_v_py_iterations) {
  unsigned PY_LONG_LONG __pyx_v_hand;
  int __pyx_v_num_options;
  unsigned PY_LONG_LONG *__pyx_v_options;
  unsigned PY_LONG_LONG __pyx_v_start_board;
  int __pyx_v_num_board;
  int __pyx_v_iterations;
  float __pyx_v_equity;
  PyObject *__pyx_v_index = NULL;
  PyObject *__pyx_v_option = NULL;
  PyObject *__pyx_r = NULL;
  __Pyx_RefNannyDeclarations
  Py_ssize_t __pyx_t_1;
  int __pyx_t_2;
  PyObject *__pyx_t_3 = NULL;
  PyObject *__pyx_t_4 = NULL;
  PyObject *(*__pyx_t_5)(PyObject *);
  PyObject *__pyx_t_6 = NULL;
  Py_ssize_t __pyx_t_7;
  int __pyx_lineno = 0;
  const char *__pyx_filename = NULL;
  int __pyx_clineno = 0;
  __Pyx_RefNannySetupContext("py_hand_vs_range_monte_carlo", 0);

  /* "eval7/equity.pyx":102
 * def py_hand_vs_range_monte_carlo(py_hand, py_villain, py_board,
 *         py_iterations):
 *     cdef cython.ulonglong hand = cards_to_mask(py_hand)             # <<<<<<<<<<<<<<
 *     cdef cython.int num_options = len(py_villain)
 *     cdef cython.ulonglong *options = <cython.ulonglong*>malloc(
 */
  __pyx_v_hand = __pyx_f_5eval7_5cards_cards_to_mask(__pyx_v_py_hand);

  /* "eval7/equity.pyx":103
 *         py_iterations):
 *     cdef cython.ulonglong hand = cards_to_mask(py_hand)
 *     cdef cython.int num_options = len(py_villain)             # <<<<<<<<<<<<<<
 *     cdef cython.ulonglong *options = <cython.ulonglong*>malloc(
 *             sizeof(cython.ulonglong) * num_options)
 */
  __pyx_t_1 = PyObject_Length(__pyx_v_py_villain); if (unlikely(__pyx_t_1 == -1)) {__pyx_filename = __pyx_f[0]; __pyx_lineno = 103; __pyx_clineno = __LINE__; goto __pyx_L1_error;}
  __pyx_v_num_options = __pyx_t_1;

  /* "eval7/equity.pyx":104
 *     cdef cython.ulonglong hand = cards_to_mask(py_hand)
 *     cdef cython.int num_options = len(py_villain)
 *     cdef cython.ulonglong *options = <cython.ulonglong*>malloc(             # <<<<<<<<<<<<<<
 *             sizeof(cython.ulonglong) * num_options)
 *     cdef cython.ulonglong start_board = cards_to_mask(py_board)
 */
  __pyx_v_options = ((unsigned PY_LONG_LONG *)malloc(((sizeof(unsigned PY_LONG_LONG)) * __pyx_v_num_options)));

  /* "eval7/equity.pyx":106
 *     cdef cython.ulonglong *options = <cython.ulonglong*>malloc(
 *             sizeof(cython.ulonglong) * num_options)
 *     cdef cython.ulonglong start_board = cards_to_mask(py_board)             # <<<<<<<<<<<<<<
 *     cdef cython.int num_board = len(py_board)
 *     cdef cython.int iterations = py_iterations
 */
  __pyx_v_start_board = __pyx_f_5eval7_5cards_cards_to_mask(__pyx_v_py_board);

  /* "eval7/equity.pyx":107
 *             sizeof(cython.ulonglong) * num_options)
 *     cdef cython.ulonglong start_board = cards_to_mask(py_board)
 *     cdef cython.int num_board = len(py_board)             # <<<<<<<<<<<<<<
 *     cdef cython.int iterations = py_iterations
 *     cdef cython.float equity  # DuplicatedSignature
 */
  __pyx_t_1 = PyObject_Length(__pyx_v_py_board); if (unlikely(__pyx_t_1 == -1)) {__pyx_filename = __pyx_f[0]; __pyx_lineno = 107; __pyx_clineno = __LINE__; goto __pyx_L1_error;}
  __pyx_v_num_board = __pyx_t_1;

  /* "eval7/equity.pyx":108
 *     cdef cython.ulonglong start_board = cards_to_mask(py_board)
 *     cdef cython.int num_board = len(py_board)
 *     cdef cython.int iterations = py_iterations             # <<<<<<<<<<<<<<
 *     cdef cython.float equity  # DuplicatedSignature
 *     cdef cython.ulonglong mask
 */
  __pyx_t_2 = __Pyx_PyInt_As_int(__pyx_v_py_iterations); if (unlikely((__pyx_t_2 == (int)-1) && PyErr_Occurred())) {__pyx_filename = __pyx_f[0]; __pyx_lineno = 108; __pyx_clineno = __LINE__; goto __pyx_L1_error;}
  __pyx_v_iterations = __pyx_t_2;

  /* "eval7/equity.pyx":111
 *     cdef cython.float equity  # DuplicatedSignature
 *     cdef cython.ulonglong mask
 *     for index, option in enumerate(py_villain):             # <<<<<<<<<<<<<<
 *         options[index] = cards_to_mask(option[0])
 *         # This strips and ignores the weight.
 */
  __Pyx_INCREF(__pyx_int_0);
  __pyx_t_3 = __pyx_int_0;
  if (likely(PyList_CheckExact(__pyx_v_py_villain)) || PyTuple_CheckExact(__pyx_v_py_villain)) {
    __pyx_t_4 = __pyx_v_py_villain; __Pyx_INCREF(__pyx_t_4); __pyx_t_1 = 0;
    __pyx_t_5 = NULL;
  } else {
    __pyx_t_1 = -1; __pyx_t_4 = PyObject_GetIter(__pyx_v_py_villain); if (unlikely(!__pyx_t_4)) {__pyx_filename = __pyx_f[0]; __pyx_lineno = 111; __pyx_clineno = __LINE__; goto __pyx_L1_error;}
    __Pyx_GOTREF(__pyx_t_4);
    __pyx_t_5 = Py_TYPE(__pyx_t_4)->tp_iternext; if (unlikely(!__pyx_t_5)) {__pyx_filename = __pyx_f[0]; __pyx_lineno = 111; __pyx_clineno = __LINE__; goto __pyx_L1_error;}
  }
  for (;;) {
    if (likely(!__pyx_t_5)) {
      if (likely(PyList_CheckExact(__pyx_t_4))) {
        if (__pyx_t_1 >= PyList_GET_SIZE(__pyx_t_4)) break;
        #if CYTHON_COMPILING_IN_CPYTHON
        __pyx_t_6 = PyList_GET_ITEM(__pyx_t_4, __pyx_t_1); __Pyx_INCREF(__pyx_t_6); __pyx_t_1++; if (unlikely(0 < 0)) {__pyx_filename = __pyx_f[0]; __pyx_lineno = 111; __pyx_clineno = __LINE__; goto __pyx_L1_error;}
        #else
        __pyx_t_6 = PySequence_ITEM(__pyx_t_4, __pyx_t_1); __pyx_t_1++; if (unlikely(!__pyx_t_6)) {__pyx_filename = __pyx_f[0]; __pyx_lineno = 111; __pyx_clineno = __LINE__; goto __pyx_L1_error;}
        __Pyx_GOTREF(__pyx_t_6);
        #endif
      } else {
        if (__pyx_t_1 >= PyTuple_GET_SIZE(__pyx_t_4)) break;
        #if CYTHON_COMPILING_IN_CPYTHON
        __pyx_t_6 = PyTuple_GET_ITEM(__pyx_t_4, __pyx_t_1); __Pyx_INCREF(__pyx_t_6); __pyx_t_1++; if (unlikely(0 < 0)) {__pyx_filename = __pyx_f[0]; __pyx_lineno = 111; __pyx_clineno = __LINE__; goto __pyx_L1_error;}
        #else
        __pyx_t_6 = PySequence_ITEM(__pyx_t_4, __pyx_t_1); __pyx_t_1++; if (unlikely(!__pyx_t_6)) {__pyx_filename = __pyx_f[0]; __pyx_lineno = 111; __pyx_clineno = __LINE__; goto __pyx_L1_error;}
        __Pyx_GOTREF(__pyx_t_6);
        #endif
      }
    } else {
      __pyx_t_6 = __pyx_t_5(__pyx_t_4);
      if (unlikely(!__pyx_t_6)) {
        PyObject* exc_type = PyErr_Occurred();
        if (exc_type) {
          if (likely(exc_type == PyExc_StopIteration || PyErr_GivenExceptionMatches(exc_type, PyExc_StopIteration))) PyErr_Clear();
          else {__pyx_filename = __pyx_f[0]; __pyx_lineno = 111; __pyx_clineno = __LINE__; goto __pyx_L1_error;}
        }
        break;
      }
      __Pyx_GOTREF(__pyx_t_6);
    }
    __Pyx_XDECREF_SET(__pyx_v_option, __pyx_t_6);
    __pyx_t_6 = 0;
    __Pyx_INCREF(__pyx_t_3);
    __Pyx_XDECREF_SET(__pyx_v_index, __pyx_t_3);
    __pyx_t_6 = PyNumber_Add(__pyx_t_3, __pyx_int_1); if (unlikely(!__pyx_t_6)) {__pyx_filename = __pyx_f[0]; __pyx_lineno = 111; __pyx_clineno = __LINE__; goto __pyx_L1_error;}
    __Pyx_GOTREF(__pyx_t_6);
    __Pyx_DECREF(__pyx_t_3);
    __pyx_t_3 = __pyx_t_6;
    __pyx_t_6 = 0;

    /* "eval7/equity.pyx":112
 *     cdef cython.ulonglong mask
 *     for index, option in enumerate(py_villain):
 *         options[index] = cards_to_mask(option[0])             # <<<<<<<<<<<<<<
 *         # This strips and ignores the weight.
 *     num_options = filter_options(options, options, num_options,
 */
    __pyx_t_6 = __Pyx_GetItemInt(__pyx_v_option, 0, long, 1, __Pyx_PyInt_From_long, 0, 0, 1); if (unlikely(__pyx_t_6 == NULL)) {__pyx_filename = __pyx_f[0]; __pyx_lineno = 112; __pyx_clineno = __LINE__; goto __pyx_L1_error;};
    __Pyx_GOTREF(__pyx_t_6);
    __pyx_t_7 = __Pyx_PyIndex_AsSsize_t(__pyx_v_index); if (unlikely((__pyx_t_7 == (Py_ssize_t)-1) && PyErr_Occurred())) {__pyx_filename = __pyx_f[0]; __pyx_lineno = 112; __pyx_clineno = __LINE__; goto __pyx_L1_error;}
    (__pyx_v_options[__pyx_t_7]) = __pyx_f_5eval7_5cards_cards_to_mask(__pyx_t_6);
    __Pyx_DECREF(__pyx_t_6); __pyx_t_6 = 0;

    /* "eval7/equity.pyx":111
 *     cdef cython.float equity  # DuplicatedSignature
 *     cdef cython.ulonglong mask
 *     for index, option in enumerate(py_villain):             # <<<<<<<<<<<<<<
 *         options[index] = cards_to_mask(option[0])
 *         # This strips and ignores the weight.
 */
  }
  __Pyx_DECREF(__pyx_t_4); __pyx_t_4 = 0;
  __Pyx_DECREF(__pyx_t_3); __pyx_t_3 = 0;

  /* "eval7/equity.pyx":114
 *         options[index] = cards_to_mask(option[0])
 *         # This strips and ignores the weight.
 *     num_options = filter_options(options, options, num_options,             # <<<<<<<<<<<<<<
 *             start_board | hand)
 *     equity = hand_vs_range_monte_carlo(hand, options, num_options,
 */
  __pyx_v_num_options = __pyx_f_5eval7_6equity_filter_options(__pyx_v_options, __pyx_v_options, __pyx_v_num_options, (__pyx_v_start_board | __pyx_v_hand));

  /* "eval7/equity.pyx":116
 *     num_options = filter_options(options, options, num_options,
 *             start_board | hand)
 *     equity = hand_vs_range_monte_carlo(hand, options, num_options,             # <<<<<<<<<<<<<<
 *             start_board, num_board, iterations)
 *     free(options)
 */
  __pyx_v_equity = __pyx_f_5eval7_6equity_hand_vs_range_monte_carlo(__pyx_v_hand, __pyx_v_options, __pyx_v_num_options, __pyx_v_start_board, __pyx_v_num_board, __pyx_v_iterations);

  /* "eval7/equity.pyx":118
 *     equity = hand_vs_range_monte_carlo(hand, options, num_options,
 *             start_board, num_board, iterations)
 *     free(options)             # <<<<<<<<<<<<<<
 *     return equity
 * 
 */
  free(__pyx_v_options);

  /* "eval7/equity.pyx":119
 *             start_board, num_board, iterations)
 *     free(options)
 *     return equity             # <<<<<<<<<<<<<<
 * 
 * 
 */
  __Pyx_XDECREF(__pyx_r);
  __pyx_t_3 = PyFloat_FromDouble(__pyx_v_equity); if (unlikely(!__pyx_t_3)) {__pyx_filename = __pyx_f[0]; __pyx_lineno = 119; __pyx_clineno = __LINE__; goto __pyx_L1_error;}
  __Pyx_GOTREF(__pyx_t_3);
  __pyx_r = __pyx_t_3;
  __pyx_t_3 = 0;
  goto __pyx_L0;

  /* "eval7/equity.pyx":100
 * 
 * 
 * def py_hand_vs_range_monte_carlo(py_hand, py_villain, py_board,             # <<<<<<<<<<<<<<
 *         py_iterations):
 *     cdef cython.ulonglong hand = cards_to_mask(py_hand)
 */

  /* function exit code */
  __pyx_L1_error:;
  __Pyx_XDECREF(__pyx_t_3);
  __Pyx_XDECREF(__pyx_t_4);
  __Pyx_XDECREF(__pyx_t_6);
  __Pyx_AddTraceback("eval7.equity.py_hand_vs_range_monte_carlo", __pyx_clineno, __pyx_lineno, __pyx_filename);
  __pyx_r = NULL;
  __pyx_L0:;
  __Pyx_XDECREF(__pyx_v_index);
  __Pyx_XDECREF(__pyx_v_option);
  __Pyx_XGIVEREF(__pyx_r);
  __Pyx_RefNannyFinishContext();
  return __pyx_r;
}

/* "eval7/equity.pyx":122
 * 
 * 
 * cdef cython.float hand_vs_range_exact(cython.ulonglong hand,             # <<<<<<<<<<<<<<
 *         cython.ulonglong *options,
 *         cython.int num_options,
 */

static float __pyx_f_5eval7_6equity_hand_vs_range_exact(unsigned PY_LONG_LONG __pyx_v_hand, unsigned PY_LONG_LONG *__pyx_v_options, int __pyx_v_num_options, unsigned PY_LONG_LONG __pyx_v_complete_board) {
  unsigned int __pyx_v_wins;
  unsigned int __pyx_v_ties;
  unsigned PY_LONG_LONG __pyx_v_option;
  unsigned int __pyx_v_hero;
  unsigned int __pyx_v_villain;
  int __pyx_v_i;
  float __pyx_r;
  __Pyx_RefNannyDeclarations
  int __pyx_t_1;
  int __pyx_t_2;
  int __pyx_t_3;
  double __pyx_t_4;
  int __pyx_lineno = 0;
  const char *__pyx_filename = NULL;
  int __pyx_clineno = 0;
  __Pyx_RefNannySetupContext("hand_vs_range_exact", 0);

  /* "eval7/equity.pyx":131
 *     # because we know that every option is equally likely (unlike, for example,
 *     # range vs. range equity calculation).
 *     cdef cython.uint wins = 0             # <<<<<<<<<<<<<<
 *     cdef cython.uint ties = 0
 *     cdef cython.ulonglong option  # @DuplicatedSignature
 */
  __pyx_v_wins = 0;

  /* "eval7/equity.pyx":132
 *     # range vs. range equity calculation).
 *     cdef cython.uint wins = 0
 *     cdef cython.uint ties = 0             # <<<<<<<<<<<<<<
 *     cdef cython.ulonglong option  # @DuplicatedSignature
 *     cdef cython.uint hero = cy_evaluate(complete_board | hand, 7)
 */
  __pyx_v_ties = 0;

  /* "eval7/equity.pyx":134
 *     cdef cython.uint ties = 0
 *     cdef cython.ulonglong option  # @DuplicatedSignature
 *     cdef cython.uint hero = cy_evaluate(complete_board | hand, 7)             # <<<<<<<<<<<<<<
 *     cdef cython.uint villain  # @DuplicatedSignature
 *     for i in range(num_options):
 */
  __pyx_v_hero = __pyx_f_5eval7_5eval7_cy_evaluate((__pyx_v_complete_board | __pyx_v_hand), 7);

  /* "eval7/equity.pyx":136
 *     cdef cython.uint hero = cy_evaluate(complete_board | hand, 7)
 *     cdef cython.uint villain  # @DuplicatedSignature
 *     for i in range(num_options):             # <<<<<<<<<<<<<<
 *         # choose an option for opponent's hand
 *         option = options[i]
 */
  __pyx_t_1 = __pyx_v_num_options;
  for (__pyx_t_2 = 0; __pyx_t_2 < __pyx_t_1; __pyx_t_2+=1) {
    __pyx_v_i = __pyx_t_2;

    /* "eval7/equity.pyx":138
 *     for i in range(num_options):
 *         # choose an option for opponent's hand
 *         option = options[i]             # <<<<<<<<<<<<<<
 *         villain = cy_evaluate(complete_board | option, 7)
 *         if hero > villain:
 */
    __pyx_v_option = (__pyx_v_options[__pyx_v_i]);

    /* "eval7/equity.pyx":139
 *         # choose an option for opponent's hand
 *         option = options[i]
 *         villain = cy_evaluate(complete_board | option, 7)             # <<<<<<<<<<<<<<
 *         if hero > villain:
 *             wins += 1
 */
    __pyx_v_villain = __pyx_f_5eval7_5eval7_cy_evaluate((__pyx_v_complete_board | __pyx_v_option), 7);

    /* "eval7/equity.pyx":140
 *         option = options[i]
 *         villain = cy_evaluate(complete_board | option, 7)
 *         if hero > villain:             # <<<<<<<<<<<<<<
 *             wins += 1
 *         elif hero == villain:
 */
    __pyx_t_3 = ((__pyx_v_hero > __pyx_v_villain) != 0);
    if (__pyx_t_3) {

      /* "eval7/equity.pyx":141
 *         villain = cy_evaluate(complete_board | option, 7)
 *         if hero > villain:
 *             wins += 1             # <<<<<<<<<<<<<<
 *         elif hero == villain:
 *             ties += 1
 */
      __pyx_v_wins = (__pyx_v_wins + 1);
      goto __pyx_L5;
    }

    /* "eval7/equity.pyx":142
 *         if hero > villain:
 *             wins += 1
 *         elif hero == villain:             # <<<<<<<<<<<<<<
 *             ties += 1
 *     return (wins + 0.5 * ties) / <cython.double>num_options
 */
    __pyx_t_3 = ((__pyx_v_hero == __pyx_v_villain) != 0);
    if (__pyx_t_3) {

      /* "eval7/equity.pyx":143
 *             wins += 1
 *         elif hero == villain:
 *             ties += 1             # <<<<<<<<<<<<<<
 *     return (wins + 0.5 * ties) / <cython.double>num_options
 * 
 */
      __pyx_v_ties = (__pyx_v_ties + 1);
      goto __pyx_L5;
    }
    __pyx_L5:;
  }

  /* "eval7/equity.pyx":144
 *         elif hero == villain:
 *             ties += 1
 *     return (wins + 0.5 * ties) / <cython.double>num_options             # <<<<<<<<<<<<<<
 * 
 * 
 */
  __pyx_t_4 = (__pyx_v_wins + (0.5 * __pyx_v_ties));
  if (unlikely(((double)__pyx_v_num_options) == 0)) {
    #ifdef WITH_THREAD
    PyGILState_STATE __pyx_gilstate_save = PyGILState_Ensure();
    #endif
    PyErr_SetString(PyExc_ZeroDivisionError, "float division");
    #ifdef WITH_THREAD
    PyGILState_Release(__pyx_gilstate_save);
    #endif
    {__pyx_filename = __pyx_f[0]; __pyx_lineno = 144; __pyx_clineno = __LINE__; goto __pyx_L1_error;}
  }
  __pyx_r = (__pyx_t_4 / ((double)__pyx_v_num_options));
  goto __pyx_L0;

  /* "eval7/equity.pyx":122
 * 
 * 
 * cdef cython.float hand_vs_range_exact(cython.ulonglong hand,             # <<<<<<<<<<<<<<
 *         cython.ulonglong *options,
 *         cython.int num_options,
 */

  /* function exit code */
  __pyx_L1_error:;
  __Pyx_WriteUnraisable("eval7.equity.hand_vs_range_exact", __pyx_clineno, __pyx_lineno, __pyx_filename, 0, 0);
  __pyx_r = 0;
  __pyx_L0:;
  __Pyx_RefNannyFinishContext();
  return __pyx_r;
}

/* "eval7/equity.pyx":147
 * 
 * 
 * def py_hand_vs_range_exact(py_hand, py_villain, py_board):             # <<<<<<<<<<<<<<
 *     cdef cython.ulonglong hand = cards_to_mask(py_hand)  # @DuplicatedSignature
 *     cdef cython.int num_options = len(py_villain)  # @DuplicatedSignature
 */

/* Python wrapper */
static PyObject *__pyx_pw_5eval7_6equity_3py_hand_vs_range_exact(PyObject *__pyx_self, PyObject *__pyx_args, PyObject *__pyx_kwds); /*proto*/
static PyMethodDef __pyx_mdef_5eval7_6equity_3py_hand_vs_range_exact = {"py_hand_vs_range_exact", (PyCFunction)__pyx_pw_5eval7_6equity_3py_hand_vs_range_exact, METH_VARARGS|METH_KEYWORDS, 0};
static PyObject *__pyx_pw_5eval7_6equity_3py_hand_vs_range_exact(PyObject *__pyx_self, PyObject *__pyx_args, PyObject *__pyx_kwds) {
  PyObject *__pyx_v_py_hand = 0;
  PyObject *__pyx_v_py_villain = 0;
  PyObject *__pyx_v_py_board = 0;
  int __pyx_lineno = 0;
  const char *__pyx_filename = NULL;
  int __pyx_clineno = 0;
  PyObject *__pyx_r = 0;
  __Pyx_RefNannyDeclarations
  __Pyx_RefNannySetupContext("py_hand_vs_range_exact (wrapper)", 0);
  {
    static PyObject **__pyx_pyargnames[] = {&__pyx_n_s_py_hand,&__pyx_n_s_py_villain,&__pyx_n_s_py_board,0};
    PyObject* values[3] = {0,0,0};
    if (unlikely(__pyx_kwds)) {
      Py_ssize_t kw_args;
      const Py_ssize_t pos_args = PyTuple_GET_SIZE(__pyx_args);
      switch (pos_args) {
        case  3: values[2] = PyTuple_GET_ITEM(__pyx_args, 2);
        case  2: values[1] = PyTuple_GET_ITEM(__pyx_args, 1);
        case  1: values[0] = PyTuple_GET_ITEM(__pyx_args, 0);
        case  0: break;
        default: goto __pyx_L5_argtuple_error;
      }
      kw_args = PyDict_Size(__pyx_kwds);
      switch (pos_args) {
        case  0:
        if (likely((values[0] = PyDict_GetItem(__pyx_kwds, __pyx_n_s_py_hand)) != 0)) kw_args--;
        else goto __pyx_L5_argtuple_error;
        case  1:
        if (likely((values[1] = PyDict_GetItem(__pyx_kwds, __pyx_n_s_py_villain)) != 0)) kw_args--;
        else {
          __Pyx_RaiseArgtupleInvalid("py_hand_vs_range_exact", 1, 3, 3, 1); {__pyx_filename = __pyx_f[0]; __pyx_lineno = 147; __pyx_clineno = __LINE__; goto __pyx_L3_error;}
        }
        case  2:
        if (likely((values[2] = PyDict_GetItem(__pyx_kwds, __pyx_n_s_py_board)) != 0)) kw_args--;
        else {
          __Pyx_RaiseArgtupleInvalid("py_hand_vs_range_exact", 1, 3, 3, 2); {__pyx_filename = __pyx_f[0]; __pyx_lineno = 147; __pyx_clineno = __LINE__; goto __pyx_L3_error;}
        }
      }
      if (unlikely(kw_args > 0)) {
        if (unlikely(__Pyx_ParseOptionalKeywords(__pyx_kwds, __pyx_pyargnames, 0, values, pos_args, "py_hand_vs_range_exact") < 0)) {__pyx_filename = __pyx_f[0]; __pyx_lineno = 147; __pyx_clineno = __LINE__; goto __pyx_L3_error;}
      }
    } else if (PyTuple_GET_SIZE(__pyx_args) != 3) {
      goto __pyx_L5_argtuple_error;
    } else {
      values[0] = PyTuple_GET_ITEM(__pyx_args, 0);
      values[1] = PyTuple_GET_ITEM(__pyx_args, 1);
      values[2] = PyTuple_GET_ITEM(__pyx_args, 2);
    }
    __pyx_v_py_hand = values[0];
    __pyx_v_py_villain = values[1];
    __pyx_v_py_board = values[2];
  }
  goto __pyx_L4_argument_unpacking_done;
  __pyx_L5_argtuple_error:;
  __Pyx_RaiseArgtupleInvalid("py_hand_vs_range_exact", 1, 3, 3, PyTuple_GET_SIZE(__pyx_args)); {__pyx_filename = __pyx_f[0]; __pyx_lineno = 147; __pyx_clineno = __LINE__; goto __pyx_L3_error;}
  __pyx_L3_error:;
  __Pyx_AddTraceback("eval7.equity.py_hand_vs_range_exact", __pyx_clineno, __pyx_lineno, __pyx_filename);
  __Pyx_RefNannyFinishContext();
  return NULL;
  __pyx_L4_argument_unpacking_done:;
  __pyx_r = __pyx_pf_5eval7_6equity_2py_hand_vs_range_exact(__pyx_self, __pyx_v_py_hand, __pyx_v_py_villain, __pyx_v_py_board);

  /* function exit code */
  __Pyx_RefNannyFinishContext();
  return __pyx_r;
}

static PyObject *__pyx_pf_5eval7_6equity_2py_hand_vs_range_exact(CYTHON_UNUSED PyObject *__pyx_self, PyObject *__pyx_v_py_hand, PyObject *__pyx_v_py_villain, PyObject *__pyx_v_py_board) {
  unsigned PY_LONG_LONG __pyx_v_hand;
  int __pyx_v_num_options;
  unsigned PY_LONG_LONG *__pyx_v_options;
  unsigned PY_LONG_LONG __pyx_v_complete_board;
  float __pyx_v_equity;
  CYTHON_UNUSED unsigned PY_LONG_LONG __pyx_v_dead;
  PyObject *__pyx_v_index = NULL;
  PyObject *__pyx_v_option = NULL;
  PyObject *__pyx_r = NULL;
  __Pyx_RefNannyDeclarations
  Py_ssize_t __pyx_t_1;
  PyObject *__pyx_t_2 = NULL;
  PyObject *__pyx_t_3 = NULL;
  PyObject *(*__pyx_t_4)(PyObject *);
  PyObject *__pyx_t_5 = NULL;
  Py_ssize_t __pyx_t_6;
  int __pyx_lineno = 0;
  const char *__pyx_filename = NULL;
  int __pyx_clineno = 0;
  __Pyx_RefNannySetupContext("py_hand_vs_range_exact", 0);

  /* "eval7/equity.pyx":148
 * 
 * def py_hand_vs_range_exact(py_hand, py_villain, py_board):
 *     cdef cython.ulonglong hand = cards_to_mask(py_hand)  # @DuplicatedSignature             # <<<<<<<<<<<<<<
 *     cdef cython.int num_options = len(py_villain)  # @DuplicatedSignature
 *     cdef cython.ulonglong *options = <cython.ulonglong*>malloc(
 */
  __pyx_v_hand = __pyx_f_5eval7_5cards_cards_to_mask(__pyx_v_py_hand);

  /* "eval7/equity.pyx":149
 * def py_hand_vs_range_exact(py_hand, py_villain, py_board):
 *     cdef cython.ulonglong hand = cards_to_mask(py_hand)  # @DuplicatedSignature
 *     cdef cython.int num_options = len(py_villain)  # @DuplicatedSignature             # <<<<<<<<<<<<<<
 *     cdef cython.ulonglong *options = <cython.ulonglong*>malloc(
 *             sizeof(cython.ulonglong) * num_options)  # @DuplicatedSignature
 */
  __pyx_t_1 = PyObject_Length(__pyx_v_py_villain); if (unlikely(__pyx_t_1 == -1)) {__pyx_filename = __pyx_f[0]; __pyx_lineno = 149; __pyx_clineno = __LINE__; goto __pyx_L1_error;}
  __pyx_v_num_options = __pyx_t_1;

  /* "eval7/equity.pyx":150
 *     cdef cython.ulonglong hand = cards_to_mask(py_hand)  # @DuplicatedSignature
 *     cdef cython.int num_options = len(py_villain)  # @DuplicatedSignature
 *     cdef cython.ulonglong *options = <cython.ulonglong*>malloc(             # <<<<<<<<<<<<<<
 *             sizeof(cython.ulonglong) * num_options)  # @DuplicatedSignature
 *     cdef cython.ulonglong complete_board = cards_to_mask(py_board)
 */
  __pyx_v_options = ((unsigned PY_LONG_LONG *)malloc(((sizeof(unsigned PY_LONG_LONG)) * __pyx_v_num_options)));

  /* "eval7/equity.pyx":152
 *     cdef cython.ulonglong *options = <cython.ulonglong*>malloc(
 *             sizeof(cython.ulonglong) * num_options)  # @DuplicatedSignature
 *     cdef cython.ulonglong complete_board = cards_to_mask(py_board)             # <<<<<<<<<<<<<<
 *     cdef cython.float equity
 *     cdef cython.ulonglong mask  # @DuplicatedSignature
 */
  __pyx_v_complete_board = __pyx_f_5eval7_5cards_cards_to_mask(__pyx_v_py_board);

  /* "eval7/equity.pyx":155
 *     cdef cython.float equity
 *     cdef cython.ulonglong mask  # @DuplicatedSignature
 *     cdef cython.ulonglong dead = complete_board | hand             # <<<<<<<<<<<<<<
 *     for index, option in enumerate(py_villain):
 *         options[index] = cards_to_mask(option[0])
 */
  __pyx_v_dead = (__pyx_v_complete_board | __pyx_v_hand);

  /* "eval7/equity.pyx":156
 *     cdef cython.ulonglong mask  # @DuplicatedSignature
 *     cdef cython.ulonglong dead = complete_board | hand
 *     for index, option in enumerate(py_villain):             # <<<<<<<<<<<<<<
 *         options[index] = cards_to_mask(option[0])
 *         # This strips and ignores the weight
 */
  __Pyx_INCREF(__pyx_int_0);
  __pyx_t_2 = __pyx_int_0;
  if (likely(PyList_CheckExact(__pyx_v_py_villain)) || PyTuple_CheckExact(__pyx_v_py_villain)) {
    __pyx_t_3 = __pyx_v_py_villain; __Pyx_INCREF(__pyx_t_3); __pyx_t_1 = 0;
    __pyx_t_4 = NULL;
  } else {
    __pyx_t_1 = -1; __pyx_t_3 = PyObject_GetIter(__pyx_v_py_villain); if (unlikely(!__pyx_t_3)) {__pyx_filename = __pyx_f[0]; __pyx_lineno = 156; __pyx_clineno = __LINE__; goto __pyx_L1_error;}
    __Pyx_GOTREF(__pyx_t_3);
    __pyx_t_4 = Py_TYPE(__pyx_t_3)->tp_iternext; if (unlikely(!__pyx_t_4)) {__pyx_filename = __pyx_f[0]; __pyx_lineno = 156; __pyx_clineno = __LINE__; goto __pyx_L1_error;}
  }
  for (;;) {
    if (likely(!__pyx_t_4)) {
      if (likely(PyList_CheckExact(__pyx_t_3))) {
        if (__pyx_t_1 >= PyList_GET_SIZE(__pyx_t_3)) break;
        #if CYTHON_COMPILING_IN_CPYTHON
        __pyx_t_5 = PyList_GET_ITEM(__pyx_t_3, __pyx_t_1); __Pyx_INCREF(__pyx_t_5); __pyx_t_1++; if (unlikely(0 < 0)) {__pyx_filename = __pyx_f[0]; __pyx_lineno = 156; __pyx_clineno = __LINE__; goto __pyx_L1_error;}
        #else
        __pyx_t_5 = PySequence_ITEM(__pyx_t_3, __pyx_t_1); __pyx_t_1++; if (unlikely(!__pyx_t_5)) {__pyx_filename = __pyx_f[0]; __pyx_lineno = 156; __pyx_clineno = __LINE__; goto __pyx_L1_error;}
        __Pyx_GOTREF(__pyx_t_5);
        #endif
      } else {
        if (__pyx_t_1 >= PyTuple_GET_SIZE(__pyx_t_3)) break;
        #if CYTHON_COMPILING_IN_CPYTHON
        __pyx_t_5 = PyTuple_GET_ITEM(__pyx_t_3, __pyx_t_1); __Pyx_INCREF(__pyx_t_5); __pyx_t_1++; if (unlikely(0 < 0)) {__pyx_filename = __pyx_f[0]; __pyx_lineno = 156; __pyx_clineno = __LINE__; goto __pyx_L1_error;}
        #else
        __pyx_t_5 = PySequence_ITEM(__pyx_t_3, __pyx_t_1); __pyx_t_1++; if (unlikely(!__pyx_t_5)) {__pyx_filename = __pyx_f[0]; __pyx_lineno = 156; __pyx_clineno = __LINE__; goto __pyx_L1_error;}
        __Pyx_GOTREF(__pyx_t_5);
        #endif
      }
    } else {
      __pyx_t_5 = __pyx_t_4(__pyx_t_3);
      if (unlikely(!__pyx_t_5)) {
        PyObject* exc_type = PyErr_Occurred();
        if (exc_type) {
          if (likely(exc_type == PyExc_StopIteration || PyErr_GivenExceptionMatches(exc_type, PyExc_StopIteration))) PyErr_Clear();
          else {__pyx_filename = __pyx_f[0]; __pyx_lineno = 156; __pyx_clineno = __LINE__; goto __pyx_L1_error;}
        }
        break;
      }
      __Pyx_GOTREF(__pyx_t_5);
    }
    __Pyx_XDECREF_SET(__pyx_v_option, __pyx_t_5);
    __pyx_t_5 = 0;
    __Pyx_INCREF(__pyx_t_2);
    __Pyx_XDECREF_SET(__pyx_v_index, __pyx_t_2);
    __pyx_t_5 = PyNumber_Add(__pyx_t_2, __pyx_int_1); if (unlikely(!__pyx_t_5)) {__pyx_filename = __pyx_f[0]; __pyx_lineno = 156; __pyx_clineno = __LINE__; goto __pyx_L1_error;}
    __Pyx_GOTREF(__pyx_t_5);
    __Pyx_DECREF(__pyx_t_2);
    __pyx_t_2 = __pyx_t_5;
    __pyx_t_5 = 0;

    /* "eval7/equity.pyx":157
 *     cdef cython.ulonglong dead = complete_board | hand
 *     for index, option in enumerate(py_villain):
 *         options[index] = cards_to_mask(option[0])             # <<<<<<<<<<<<<<
 *         # This strips and ignores the weight
 *     num_options = filter_options(options, options, num_options,
 */
    __pyx_t_5 = __Pyx_GetItemInt(__pyx_v_option, 0, long, 1, __Pyx_PyInt_From_long, 0, 0, 1); if (unlikely(__pyx_t_5 == NULL)) {__pyx_filename = __pyx_f[0]; __pyx_lineno = 157; __pyx_clineno = __LINE__; goto __pyx_L1_error;};
    __Pyx_GOTREF(__pyx_t_5);
    __pyx_t_6 = __Pyx_PyIndex_AsSsize_t(__pyx_v_index); if (unlikely((__pyx_t_6 == (Py_ssize_t)-1) && PyErr_Occurred())) {__pyx_filename = __pyx_f[0]; __pyx_lineno = 157; __pyx_clineno = __LINE__; goto __pyx_L1_error;}
    (__pyx_v_options[__pyx_t_6]) = __pyx_f_5eval7_5cards_cards_to_mask(__pyx_t_5);
    __Pyx_DECREF(__pyx_t_5); __pyx_t_5 = 0;

    /* "eval7/equity.pyx":156
 *     cdef cython.ulonglong mask  # @DuplicatedSignature
 *     cdef cython.ulonglong dead = complete_board | hand
 *     for index, option in enumerate(py_villain):             # <<<<<<<<<<<<<<
 *         options[index] = cards_to_mask(option[0])
 *         # This strips and ignores the weight
 */
  }
  __Pyx_DECREF(__pyx_t_3); __pyx_t_3 = 0;
  __Pyx_DECREF(__pyx_t_2); __pyx_t_2 = 0;

  /* "eval7/equity.pyx":159
 *         options[index] = cards_to_mask(option[0])
 *         # This strips and ignores the weight
 *     num_options = filter_options(options, options, num_options,             # <<<<<<<<<<<<<<
 *             complete_board | hand)
 *     equity = hand_vs_range_exact(hand, options, num_options, complete_board)
 */
  __pyx_v_num_options = __pyx_f_5eval7_6equity_filter_options(__pyx_v_options, __pyx_v_options, __pyx_v_num_options, (__pyx_v_complete_board | __pyx_v_hand));

  /* "eval7/equity.pyx":161
 *     num_options = filter_options(options, options, num_options,
 *             complete_board | hand)
 *     equity = hand_vs_range_exact(hand, options, num_options, complete_board)             # <<<<<<<<<<<<<<
 *     free(options)
 *     return equity
 */
  __pyx_v_equity = __pyx_f_5eval7_6equity_hand_vs_range_exact(__pyx_v_hand, __pyx_v_options, __pyx_v_num_options, __pyx_v_complete_board);

  /* "eval7/equity.pyx":162
 *             complete_board | hand)
 *     equity = hand_vs_range_exact(hand, options, num_options, complete_board)
 *     free(options)             # <<<<<<<<<<<<<<
 *     return equity
 * 
 */
  free(__pyx_v_options);

  /* "eval7/equity.pyx":163
 *     equity = hand_vs_range_exact(hand, options, num_options, complete_board)
 *     free(options)
 *     return equity             # <<<<<<<<<<<<<<
 * 
 * 
 */
  __Pyx_XDECREF(__pyx_r);
  __pyx_t_2 = PyFloat_FromDouble(__pyx_v_equity); if (unlikely(!__pyx_t_2)) {__pyx_filename = __pyx_f[0]; __pyx_lineno = 163; __pyx_clineno = __LINE__; goto __pyx_L1_error;}
  __Pyx_GOTREF(__pyx_t_2);
  __pyx_r = __pyx_t_2;
  __pyx_t_2 = 0;
  goto __pyx_L0;

  /* "eval7/equity.pyx":147
 * 
 * 
 * def py_hand_vs_range_exact(py_hand, py_villain, py_board):             # <<<<<<<<<<<<<<
 *     cdef cython.ulonglong hand = cards_to_mask(py_hand)  # @DuplicatedSignature
 *     cdef cython.int num_options = len(py_villain)  # @DuplicatedSignature
 */

  /* function exit code */
  __pyx_L1_error:;
  __Pyx_XDECREF(__pyx_t_2);
  __Pyx_XDECREF(__pyx_t_3);
  __Pyx_XDECREF(__pyx_t_5);
  __Pyx_AddTraceback("eval7.equity.py_hand_vs_range_exact", __pyx_clineno, __pyx_lineno, __pyx_filename);
  __pyx_r = NULL;
  __pyx_L0:;
  __Pyx_XDECREF(__pyx_v_index);
  __Pyx_XDECREF(__pyx_v_option);
  __Pyx_XGIVEREF(__pyx_r);
  __Pyx_RefNannyFinishContext();
  return __pyx_r;
}

/* "eval7/equity.pyx":166
 * 
 * 
 * cdef void all_hands_vs_range(cython.ulonglong *hands,             # <<<<<<<<<<<<<<
 *         cython.uint num_hands,
 *         cython.ulonglong *all_options,
 */

static void __pyx_f_5eval7_6equity_all_hands_vs_range(unsigned PY_LONG_LONG *__pyx_v_hands, unsigned int __pyx_v_num_hands, unsigned PY_LONG_LONG *__pyx_v_all_options, unsigned int __pyx_v_num_options, unsigned PY_LONG_LONG __pyx_v_board, unsigned int __pyx_v_num_board, long __pyx_v_iterations, float *__pyx_v_result) {
  float __pyx_v_equity;
  unsigned PY_LONG_LONG __pyx_v_hand;
  unsigned int __pyx_v_current_num_options;
  unsigned PY_LONG_LONG *__pyx_v_options;
  long __pyx_v_i;
  __Pyx_RefNannyDeclarations
  unsigned int __pyx_t_1;
  int __pyx_t_2;
  int __pyx_t_3;
  __Pyx_RefNannySetupContext("all_hands_vs_range", 0);

  /* "eval7/equity.pyx":189
 *     cdef cython.ulonglong hand
 *     cdef cython.uint current_num_options
 *     cdef cython.ulonglong *options = <cython.ulonglong *>malloc(             # <<<<<<<<<<<<<<
 *             sizeof(cython.ulonglong) * num_options)
 *     for 0 <= i < num_hands:
 */
  __pyx_v_options = ((unsigned PY_LONG_LONG *)malloc(((sizeof(unsigned PY_LONG_LONG)) * __pyx_v_num_options)));

  /* "eval7/equity.pyx":191
 *     cdef cython.ulonglong *options = <cython.ulonglong *>malloc(
 *             sizeof(cython.ulonglong) * num_options)
 *     for 0 <= i < num_hands:             # <<<<<<<<<<<<<<
 *         hand = hands[i]
 *         # Have to do card removal effects at this point - on a hand by hand basis.
 */
  __pyx_t_1 = __pyx_v_num_hands;
  for (__pyx_v_i = 0; __pyx_v_i < __pyx_t_1; __pyx_v_i++) {

    /* "eval7/equity.pyx":192
 *             sizeof(cython.ulonglong) * num_options)
 *     for 0 <= i < num_hands:
 *         hand = hands[i]             # <<<<<<<<<<<<<<
 *         # Have to do card removal effects at this point - on a hand by hand basis.
 *         current_num_options = filter_options(all_options, options,
 */
    __pyx_v_hand = (__pyx_v_hands[__pyx_v_i]);

    /* "eval7/equity.pyx":194
 *         hand = hands[i]
 *         # Have to do card removal effects at this point - on a hand by hand basis.
 *         current_num_options = filter_options(all_options, options,             # <<<<<<<<<<<<<<
 *                 num_options, board | hand)
 *         if current_num_options == 0:
 */
    __pyx_v_current_num_options = __pyx_f_5eval7_6equity_filter_options(__pyx_v_all_options, __pyx_v_options, __pyx_v_num_options, (__pyx_v_board | __pyx_v_hand));

    /* "eval7/equity.pyx":196
 *         current_num_options = filter_options(all_options, options,
 *                 num_options, board | hand)
 *         if current_num_options == 0:             # <<<<<<<<<<<<<<
 *             result[i] = -1  # Villain's range makes this hand impossible for hero.
 *             continue
 */
    __pyx_t_2 = ((__pyx_v_current_num_options == 0) != 0);
    if (__pyx_t_2) {

      /* "eval7/equity.pyx":197
 *                 num_options, board | hand)
 *         if current_num_options == 0:
 *             result[i] = -1  # Villain's range makes this hand impossible for hero.             # <<<<<<<<<<<<<<
 *             continue
 *         if num_board == 5 and current_num_options <= iterations:
 */
      (__pyx_v_result[__pyx_v_i]) = -1.0;

      /* "eval7/equity.pyx":198
 *         if current_num_options == 0:
 *             result[i] = -1  # Villain's range makes this hand impossible for hero.
 *             continue             # <<<<<<<<<<<<<<
 *         if num_board == 5 and current_num_options <= iterations:
 *             equity = hand_vs_range_exact(hand, options, current_num_options,
 */
      goto __pyx_L3_continue;
    }

    /* "eval7/equity.pyx":199
 *             result[i] = -1  # Villain's range makes this hand impossible for hero.
 *             continue
 *         if num_board == 5 and current_num_options <= iterations:             # <<<<<<<<<<<<<<
 *             equity = hand_vs_range_exact(hand, options, current_num_options,
 *                     board)
 */
    __pyx_t_3 = ((__pyx_v_num_board == 5) != 0);
    if (__pyx_t_3) {
    } else {
      __pyx_t_2 = __pyx_t_3;
      goto __pyx_L7_bool_binop_done;
    }
    __pyx_t_3 = ((__pyx_v_current_num_options <= __pyx_v_iterations) != 0);
    __pyx_t_2 = __pyx_t_3;
    __pyx_L7_bool_binop_done:;
    if (__pyx_t_2) {

      /* "eval7/equity.pyx":200
 *             continue
 *         if num_board == 5 and current_num_options <= iterations:
 *             equity = hand_vs_range_exact(hand, options, current_num_options,             # <<<<<<<<<<<<<<
 *                     board)
 *         else:
 */
      __pyx_v_equity = __pyx_f_5eval7_6equity_hand_vs_range_exact(__pyx_v_hand, __pyx_v_options, __pyx_v_current_num_options, __pyx_v_board);
      goto __pyx_L6;
    }
    /*else*/ {

      /* "eval7/equity.pyx":203
 *                     board)
 *         else:
 *             equity = hand_vs_range_monte_carlo(hand, options,             # <<<<<<<<<<<<<<
 *                     current_num_options, board, num_board, iterations)
 *         result[i] = equity
 */
      __pyx_v_equity = __pyx_f_5eval7_6equity_hand_vs_range_monte_carlo(__pyx_v_hand, __pyx_v_options, __pyx_v_current_num_options, __pyx_v_board, __pyx_v_num_board, __pyx_v_iterations);
    }
    __pyx_L6:;

    /* "eval7/equity.pyx":205
 *             equity = hand_vs_range_monte_carlo(hand, options,
 *                     current_num_options, board, num_board, iterations)
 *         result[i] = equity             # <<<<<<<<<<<<<<
 *     free(options)
 * 
 */
    (__pyx_v_result[__pyx_v_i]) = __pyx_v_equity;
    __pyx_L3_continue:;
  }

  /* "eval7/equity.pyx":206
 *                     current_num_options, board, num_board, iterations)
 *         result[i] = equity
 *     free(options)             # <<<<<<<<<<<<<<
 * 
 * 
 */
  free(__pyx_v_options);

  /* "eval7/equity.pyx":166
 * 
 * 
 * cdef void all_hands_vs_range(cython.ulonglong *hands,             # <<<<<<<<<<<<<<
 *         cython.uint num_hands,
 *         cython.ulonglong *all_options,
 */

  /* function exit code */
  __Pyx_RefNannyFinishContext();
}

/* "eval7/equity.pyx":209
 * 
 * 
 * def py_all_hands_vs_range(py_hero, py_villain, py_board, py_iterations):             # <<<<<<<<<<<<<<
 *     """
 *     Return dict mapping hero's hand to equity against villain's range on this board.
 */

/* Python wrapper */
static PyObject *__pyx_pw_5eval7_6equity_5py_all_hands_vs_range(PyObject *__pyx_self, PyObject *__pyx_args, PyObject *__pyx_kwds); /*proto*/
static char __pyx_doc_5eval7_6equity_4py_all_hands_vs_range[] = "\n    Return dict mapping hero's hand to equity against villain's range on this board.\n    \n    hero and villain are ranges.\n    board is a list of cards.\n    \n    TODO: consider randomising the order of opponent's hands at this point\n    so that the evenly distributed sampling in hand_vs_range is unbiased.\n\n    Board pre-filtering has been disabled. This is inefficient, and will \n    be addressed by a planned refactoring.\n    ";
static PyMethodDef __pyx_mdef_5eval7_6equity_5py_all_hands_vs_range = {"py_all_hands_vs_range", (PyCFunction)__pyx_pw_5eval7_6equity_5py_all_hands_vs_range, METH_VARARGS|METH_KEYWORDS, __pyx_doc_5eval7_6equity_4py_all_hands_vs_range};
static PyObject *__pyx_pw_5eval7_6equity_5py_all_hands_vs_range(PyObject *__pyx_self, PyObject *__pyx_args, PyObject *__pyx_kwds) {
  PyObject *__pyx_v_py_hero = 0;
  PyObject *__pyx_v_py_villain = 0;
  PyObject *__pyx_v_py_board = 0;
  PyObject *__pyx_v_py_iterations = 0;
  int __pyx_lineno = 0;
  const char *__pyx_filename = NULL;
  int __pyx_clineno = 0;
  PyObject *__pyx_r = 0;
  __Pyx_RefNannyDeclarations
  __Pyx_RefNannySetupContext("py_all_hands_vs_range (wrapper)", 0);
  {
    static PyObject **__pyx_pyargnames[] = {&__pyx_n_s_py_hero,&__pyx_n_s_py_villain,&__pyx_n_s_py_board,&__pyx_n_s_py_iterations,0};
    PyObject* values[4] = {0,0,0,0};
    if (unlikely(__pyx_kwds)) {
      Py_ssize_t kw_args;
      const Py_ssize_t pos_args = PyTuple_GET_SIZE(__pyx_args);
      switch (pos_args) {
        case  4: values[3] = PyTuple_GET_ITEM(__pyx_args, 3);
        case  3: values[2] = PyTuple_GET_ITEM(__pyx_args, 2);
        case  2: values[1] = PyTuple_GET_ITEM(__pyx_args, 1);
        case  1: values[0] = PyTuple_GET_ITEM(__pyx_args, 0);
        case  0: break;
        default: goto __pyx_L5_argtuple_error;
      }
      kw_args = PyDict_Size(__pyx_kwds);
      switch (pos_args) {
        case  0:
        if (likely((values[0] = PyDict_GetItem(__pyx_kwds, __pyx_n_s_py_hero)) != 0)) kw_args--;
        else goto __pyx_L5_argtuple_error;
        case  1:
        if (likely((values[1] = PyDict_GetItem(__pyx_kwds, __pyx_n_s_py_villain)) != 0)) kw_args--;
        else {
          __Pyx_RaiseArgtupleInvalid("py_all_hands_vs_range", 1, 4, 4, 1); {__pyx_filename = __pyx_f[0]; __pyx_lineno = 209; __pyx_clineno = __LINE__; goto __pyx_L3_error;}
        }
        case  2:
        if (likely((values[2] = PyDict_GetItem(__pyx_kwds, __pyx_n_s_py_board)) != 0)) kw_args--;
        else {
          __Pyx_RaiseArgtupleInvalid("py_all_hands_vs_range", 1, 4, 4, 2); {__pyx_filename = __pyx_f[0]; __pyx_lineno = 209; __pyx_clineno = __LINE__; goto __pyx_L3_error;}
        }
        case  3:
        if (likely((values[3] = PyDict_GetItem(__pyx_kwds, __pyx_n_s_py_iterations)) != 0)) kw_args--;
        else {
          __Pyx_RaiseArgtupleInvalid("py_all_hands_vs_range", 1, 4, 4, 3); {__pyx_filename = __pyx_f[0]; __pyx_lineno = 209; __pyx_clineno = __LINE__; goto __pyx_L3_error;}
        }
      }
      if (unlikely(kw_args > 0)) {
        if (unlikely(__Pyx_ParseOptionalKeywords(__pyx_kwds, __pyx_pyargnames, 0, values, pos_args, "py_all_hands_vs_range") < 0)) {__pyx_filename = __pyx_f[0]; __pyx_lineno = 209; __pyx_clineno = __LINE__; goto __pyx_L3_error;}
      }
    } else if (PyTuple_GET_SIZE(__pyx_args) != 4) {
      goto __pyx_L5_argtuple_error;
    } else {
      values[0] = PyTuple_GET_ITEM(__pyx_args, 0);
      values[1] = PyTuple_GET_ITEM(__pyx_args, 1);
      values[2] = PyTuple_GET_ITEM(__pyx_args, 2);
      values[3] = PyTuple_GET_ITEM(__pyx_args, 3);
    }
    __pyx_v_py_hero = values[0];
    __pyx_v_py_villain = values[1];
    __pyx_v_py_board = values[2];
    __pyx_v_py_iterations = values[3];
  }
  goto __pyx_L4_argument_unpacking_done;
  __pyx_L5_argtuple_error:;
  __Pyx_RaiseArgtupleInvalid("py_all_hands_vs_range", 1, 4, 4, PyTuple_GET_SIZE(__pyx_args)); {__pyx_filename = __pyx_f[0]; __pyx_lineno = 209; __pyx_clineno = __LINE__; goto __pyx_L3_error;}
  __pyx_L3_error:;
  __Pyx_AddTraceback("eval7.equity.py_all_hands_vs_range", __pyx_clineno, __pyx_lineno, __pyx_filename);
  __Pyx_RefNannyFinishContext();
  return NULL;
  __pyx_L4_argument_unpacking_done:;
  __pyx_r = __pyx_pf_5eval7_6equity_4py_all_hands_vs_range(__pyx_self, __pyx_v_py_hero, __pyx_v_py_villain, __pyx_v_py_board, __pyx_v_py_iterations);

  /* function exit code */
  __Pyx_RefNannyFinishContext();
  return __pyx_r;
}

static PyObject *__pyx_pf_5eval7_6equity_4py_all_hands_vs_range(CYTHON_UNUSED PyObject *__pyx_self, PyObject *__pyx_v_py_hero, PyObject *__pyx_v_py_villain, PyObject *__pyx_v_py_board, PyObject *__pyx_v_py_iterations) {
  unsigned PY_LONG_LONG *__pyx_v_hands;
  unsigned int __pyx_v_num_hands;
  unsigned PY_LONG_LONG *__pyx_v_options;
  unsigned int __pyx_v_num_options;
  unsigned PY_LONG_LONG __pyx_v_board;
  unsigned int __pyx_v_num_board;
  long __pyx_v_iterations;
  float *__pyx_v_result;
  PyObject *__pyx_v_hand = NULL;
  CYTHON_UNUSED PyObject *__pyx_v_weight = NULL;
  PyObject *__pyx_v_option = NULL;
  PyObject *__pyx_v_py_result = NULL;
  PyObject *__pyx_v_i = NULL;
  PyObject *__pyx_r = NULL;
  __Pyx_RefNannyDeclarations
  Py_ssize_t __pyx_t_1;
  long __pyx_t_2;
  PyObject *__pyx_t_3 = NULL;
  PyObject *(*__pyx_t_4)(PyObject *);
  PyObject *__pyx_t_5 = NULL;
  PyObject *__pyx_t_6 = NULL;
  PyObject *__pyx_t_7 = NULL;
  PyObject *__pyx_t_8 = NULL;
  PyObject *(*__pyx_t_9)(PyObject *);
  PyObject *__pyx_t_10 = NULL;
  Py_ssize_t __pyx_t_11;
  int __pyx_t_12;
  int __pyx_lineno = 0;
  const char *__pyx_filename = NULL;
  int __pyx_clineno = 0;
  __Pyx_RefNannySetupContext("py_all_hands_vs_range", 0);

  /* "eval7/equity.pyx":223
 *     """
 *     cdef cython.ulonglong *hands = <cython.ulonglong *>malloc(
 *             sizeof(cython.ulonglong) * len(py_hero))             # <<<<<<<<<<<<<<
 *     cdef cython.uint num_hands
 *     cdef cython.ulonglong *options = <cython.ulonglong *>malloc(
 */
  __pyx_t_1 = PyObject_Length(__pyx_v_py_hero); if (unlikely(__pyx_t_1 == -1)) {__pyx_filename = __pyx_f[0]; __pyx_lineno = 223; __pyx_clineno = __LINE__; goto __pyx_L1_error;}

  /* "eval7/equity.pyx":222
 *     be addressed by a planned refactoring.
 *     """
 *     cdef cython.ulonglong *hands = <cython.ulonglong *>malloc(             # <<<<<<<<<<<<<<
 *             sizeof(cython.ulonglong) * len(py_hero))
 *     cdef cython.uint num_hands
 */
  __pyx_v_hands = ((unsigned PY_LONG_LONG *)malloc(((sizeof(unsigned PY_LONG_LONG)) * __pyx_t_1)));

  /* "eval7/equity.pyx":226
 *     cdef cython.uint num_hands
 *     cdef cython.ulonglong *options = <cython.ulonglong *>malloc(
 *             sizeof(cython.ulonglong) * len(py_villain))             # <<<<<<<<<<<<<<
 *     cdef cython.uint num_options
 *     cdef cython.ulonglong board  # @DuplicatedSignature
 */
  __pyx_t_1 = PyObject_Length(__pyx_v_py_villain); if (unlikely(__pyx_t_1 == -1)) {__pyx_filename = __pyx_f[0]; __pyx_lineno = 226; __pyx_clineno = __LINE__; goto __pyx_L1_error;}

  /* "eval7/equity.pyx":225
 *             sizeof(cython.ulonglong) * len(py_hero))
 *     cdef cython.uint num_hands
 *     cdef cython.ulonglong *options = <cython.ulonglong *>malloc(             # <<<<<<<<<<<<<<
 *             sizeof(cython.ulonglong) * len(py_villain))
 *     cdef cython.uint num_options
 */
  __pyx_v_options = ((unsigned PY_LONG_LONG *)malloc(((sizeof(unsigned PY_LONG_LONG)) * __pyx_t_1)));

  /* "eval7/equity.pyx":230
 *     cdef cython.ulonglong board  # @DuplicatedSignature
 *     cdef cython.uint num_board
 *     cdef cython.long iterations = <cython.long>py_iterations             # <<<<<<<<<<<<<<
 *     cdef cython.float *result = <cython.float *>malloc(
 *             sizeof(cython.float) * len(py_hero))
 */
  __pyx_t_2 = __Pyx_PyInt_As_long(__pyx_v_py_iterations); if (unlikely((__pyx_t_2 == (long)-1) && PyErr_Occurred())) {__pyx_filename = __pyx_f[0]; __pyx_lineno = 230; __pyx_clineno = __LINE__; goto __pyx_L1_error;}
  __pyx_v_iterations = ((long)__pyx_t_2);

  /* "eval7/equity.pyx":232
 *     cdef cython.long iterations = <cython.long>py_iterations
 *     cdef cython.float *result = <cython.float *>malloc(
 *             sizeof(cython.float) * len(py_hero))             # <<<<<<<<<<<<<<
 * 
 *     num_hands = 0
 */
  __pyx_t_1 = PyObject_Length(__pyx_v_py_hero); if (unlikely(__pyx_t_1 == -1)) {__pyx_filename = __pyx_f[0]; __pyx_lineno = 232; __pyx_clineno = __LINE__; goto __pyx_L1_error;}

  /* "eval7/equity.pyx":231
 *     cdef cython.uint num_board
 *     cdef cython.long iterations = <cython.long>py_iterations
 *     cdef cython.float *result = <cython.float *>malloc(             # <<<<<<<<<<<<<<
 *             sizeof(cython.float) * len(py_hero))
 * 
 */
  __pyx_v_result = ((float *)malloc(((sizeof(float)) * __pyx_t_1)));

  /* "eval7/equity.pyx":234
 *             sizeof(cython.float) * len(py_hero))
 * 
 *     num_hands = 0             # <<<<<<<<<<<<<<
 *     for hand, weight in py_hero:
 *         hands[num_hands] = cards_to_mask(hand)
 */
  __pyx_v_num_hands = 0;

  /* "eval7/equity.pyx":235
 * 
 *     num_hands = 0
 *     for hand, weight in py_hero:             # <<<<<<<<<<<<<<
 *         hands[num_hands] = cards_to_mask(hand)
 *         num_hands += 1
 */
  if (likely(PyList_CheckExact(__pyx_v_py_hero)) || PyTuple_CheckExact(__pyx_v_py_hero)) {
    __pyx_t_3 = __pyx_v_py_hero; __Pyx_INCREF(__pyx_t_3); __pyx_t_1 = 0;
    __pyx_t_4 = NULL;
  } else {
    __pyx_t_1 = -1; __pyx_t_3 = PyObject_GetIter(__pyx_v_py_hero); if (unlikely(!__pyx_t_3)) {__pyx_filename = __pyx_f[0]; __pyx_lineno = 235; __pyx_clineno = __LINE__; goto __pyx_L1_error;}
    __Pyx_GOTREF(__pyx_t_3);
    __pyx_t_4 = Py_TYPE(__pyx_t_3)->tp_iternext; if (unlikely(!__pyx_t_4)) {__pyx_filename = __pyx_f[0]; __pyx_lineno = 235; __pyx_clineno = __LINE__; goto __pyx_L1_error;}
  }
  for (;;) {
    if (likely(!__pyx_t_4)) {
      if (likely(PyList_CheckExact(__pyx_t_3))) {
        if (__pyx_t_1 >= PyList_GET_SIZE(__pyx_t_3)) break;
        #if CYTHON_COMPILING_IN_CPYTHON
        __pyx_t_5 = PyList_GET_ITEM(__pyx_t_3, __pyx_t_1); __Pyx_INCREF(__pyx_t_5); __pyx_t_1++; if (unlikely(0 < 0)) {__pyx_filename = __pyx_f[0]; __pyx_lineno = 235; __pyx_clineno = __LINE__; goto __pyx_L1_error;}
        #else
        __pyx_t_5 = PySequence_ITEM(__pyx_t_3, __pyx_t_1); __pyx_t_1++; if (unlikely(!__pyx_t_5)) {__pyx_filename = __pyx_f[0]; __pyx_lineno = 235; __pyx_clineno = __LINE__; goto __pyx_L1_error;}
        __Pyx_GOTREF(__pyx_t_5);
        #endif
      } else {
        if (__pyx_t_1 >= PyTuple_GET_SIZE(__pyx_t_3)) break;
        #if CYTHON_COMPILING_IN_CPYTHON
        __pyx_t_5 = PyTuple_GET_ITEM(__pyx_t_3, __pyx_t_1); __Pyx_INCREF(__pyx_t_5); __pyx_t_1++; if (unlikely(0 < 0)) {__pyx_filename = __pyx_f[0]; __pyx_lineno = 235; __pyx_clineno = __LINE__; goto __pyx_L1_error;}
        #else
        __pyx_t_5 = PySequence_ITEM(__pyx_t_3, __pyx_t_1); __pyx_t_1++; if (unlikely(!__pyx_t_5)) {__pyx_filename = __pyx_f[0]; __pyx_lineno = 235; __pyx_clineno = __LINE__; goto __pyx_L1_error;}
        __Pyx_GOTREF(__pyx_t_5);
        #endif
      }
    } else {
      __pyx_t_5 = __pyx_t_4(__pyx_t_3);
      if (unlikely(!__pyx_t_5)) {
        PyObject* exc_type = PyErr_Occurred();
        if (exc_type) {
          if (likely(exc_type == PyExc_StopIteration || PyErr_GivenExceptionMatches(exc_type, PyExc_StopIteration))) PyErr_Clear();
          else {__pyx_filename = __pyx_f[0]; __pyx_lineno = 235; __pyx_clineno = __LINE__; goto __pyx_L1_error;}
        }
        break;
      }
      __Pyx_GOTREF(__pyx_t_5);
    }
    if ((likely(PyTuple_CheckExact(__pyx_t_5))) || (PyList_CheckExact(__pyx_t_5))) {
      PyObject* sequence = __pyx_t_5;
      #if CYTHON_COMPILING_IN_CPYTHON
      Py_ssize_t size = Py_SIZE(sequence);
      #else
      Py_ssize_t size = PySequence_Size(sequence);
      #endif
      if (unlikely(size != 2)) {
        if (size > 2) __Pyx_RaiseTooManyValuesError(2);
        else if (size >= 0) __Pyx_RaiseNeedMoreValuesError(size);
        {__pyx_filename = __pyx_f[0]; __pyx_lineno = 235; __pyx_clineno = __LINE__; goto __pyx_L1_error;}
      }
      #if CYTHON_COMPILING_IN_CPYTHON
      if (likely(PyTuple_CheckExact(sequence))) {
        __pyx_t_6 = PyTuple_GET_ITEM(sequence, 0); 
        __pyx_t_7 = PyTuple_GET_ITEM(sequence, 1); 
      } else {
        __pyx_t_6 = PyList_GET_ITEM(sequence, 0); 
        __pyx_t_7 = PyList_GET_ITEM(sequence, 1); 
      }
      __Pyx_INCREF(__pyx_t_6);
      __Pyx_INCREF(__pyx_t_7);
      #else
      __pyx_t_6 = PySequence_ITEM(sequence, 0); if (unlikely(!__pyx_t_6)) {__pyx_filename = __pyx_f[0]; __pyx_lineno = 235; __pyx_clineno = __LINE__; goto __pyx_L1_error;}
      __Pyx_GOTREF(__pyx_t_6);
      __pyx_t_7 = PySequence_ITEM(sequence, 1); if (unlikely(!__pyx_t_7)) {__pyx_filename = __pyx_f[0]; __pyx_lineno = 235; __pyx_clineno = __LINE__; goto __pyx_L1_error;}
      __Pyx_GOTREF(__pyx_t_7);
      #endif
      __Pyx_DECREF(__pyx_t_5); __pyx_t_5 = 0;
    } else {
      Py_ssize_t index = -1;
      __pyx_t_8 = PyObject_GetIter(__pyx_t_5); if (unlikely(!__pyx_t_8)) {__pyx_filename = __pyx_f[0]; __pyx_lineno = 235; __pyx_clineno = __LINE__; goto __pyx_L1_error;}
      __Pyx_GOTREF(__pyx_t_8);
      __Pyx_DECREF(__pyx_t_5); __pyx_t_5 = 0;
      __pyx_t_9 = Py_TYPE(__pyx_t_8)->tp_iternext;
      index = 0; __pyx_t_6 = __pyx_t_9(__pyx_t_8); if (unlikely(!__pyx_t_6)) goto __pyx_L5_unpacking_failed;
      __Pyx_GOTREF(__pyx_t_6);
      index = 1; __pyx_t_7 = __pyx_t_9(__pyx_t_8); if (unlikely(!__pyx_t_7)) goto __pyx_L5_unpacking_failed;
      __Pyx_GOTREF(__pyx_t_7);
      if (__Pyx_IternextUnpackEndCheck(__pyx_t_9(__pyx_t_8), 2) < 0) {__pyx_filename = __pyx_f[0]; __pyx_lineno = 235; __pyx_clineno = __LINE__; goto __pyx_L1_error;}
      __pyx_t_9 = NULL;
      __Pyx_DECREF(__pyx_t_8); __pyx_t_8 = 0;
      goto __pyx_L6_unpacking_done;
      __pyx_L5_unpacking_failed:;
      __Pyx_DECREF(__pyx_t_8); __pyx_t_8 = 0;
      __pyx_t_9 = NULL;
      if (__Pyx_IterFinish() == 0) __Pyx_RaiseNeedMoreValuesError(index);
      {__pyx_filename = __pyx_f[0]; __pyx_lineno = 235; __pyx_clineno = __LINE__; goto __pyx_L1_error;}
      __pyx_L6_unpacking_done:;
    }
    __Pyx_XDECREF_SET(__pyx_v_hand, __pyx_t_6);
    __pyx_t_6 = 0;
    __Pyx_XDECREF_SET(__pyx_v_weight, __pyx_t_7);
    __pyx_t_7 = 0;

    /* "eval7/equity.pyx":236
 *     num_hands = 0
 *     for hand, weight in py_hero:
 *         hands[num_hands] = cards_to_mask(hand)             # <<<<<<<<<<<<<<
 *         num_hands += 1
 * 
 */
    (__pyx_v_hands[__pyx_v_num_hands]) = __pyx_f_5eval7_5cards_cards_to_mask(__pyx_v_hand);

    /* "eval7/equity.pyx":237
 *     for hand, weight in py_hero:
 *         hands[num_hands] = cards_to_mask(hand)
 *         num_hands += 1             # <<<<<<<<<<<<<<
 * 
 *     num_options = 0
 */
    __pyx_v_num_hands = (__pyx_v_num_hands + 1);

    /* "eval7/equity.pyx":235
 * 
 *     num_hands = 0
 *     for hand, weight in py_hero:             # <<<<<<<<<<<<<<
 *         hands[num_hands] = cards_to_mask(hand)
 *         num_hands += 1
 */
  }
  __Pyx_DECREF(__pyx_t_3); __pyx_t_3 = 0;

  /* "eval7/equity.pyx":239
 *         num_hands += 1
 * 
 *     num_options = 0             # <<<<<<<<<<<<<<
 *     for option, weight in py_villain:
 *         options[num_options] = cards_to_mask(option)
 */
  __pyx_v_num_options = 0;

  /* "eval7/equity.pyx":240
 * 
 *     num_options = 0
 *     for option, weight in py_villain:             # <<<<<<<<<<<<<<
 *         options[num_options] = cards_to_mask(option)
 *         num_options += 1
 */
  if (likely(PyList_CheckExact(__pyx_v_py_villain)) || PyTuple_CheckExact(__pyx_v_py_villain)) {
    __pyx_t_3 = __pyx_v_py_villain; __Pyx_INCREF(__pyx_t_3); __pyx_t_1 = 0;
    __pyx_t_4 = NULL;
  } else {
    __pyx_t_1 = -1; __pyx_t_3 = PyObject_GetIter(__pyx_v_py_villain); if (unlikely(!__pyx_t_3)) {__pyx_filename = __pyx_f[0]; __pyx_lineno = 240; __pyx_clineno = __LINE__; goto __pyx_L1_error;}
    __Pyx_GOTREF(__pyx_t_3);
    __pyx_t_4 = Py_TYPE(__pyx_t_3)->tp_iternext; if (unlikely(!__pyx_t_4)) {__pyx_filename = __pyx_f[0]; __pyx_lineno = 240; __pyx_clineno = __LINE__; goto __pyx_L1_error;}
  }
  for (;;) {
    if (likely(!__pyx_t_4)) {
      if (likely(PyList_CheckExact(__pyx_t_3))) {
        if (__pyx_t_1 >= PyList_GET_SIZE(__pyx_t_3)) break;
        #if CYTHON_COMPILING_IN_CPYTHON
        __pyx_t_5 = PyList_GET_ITEM(__pyx_t_3, __pyx_t_1); __Pyx_INCREF(__pyx_t_5); __pyx_t_1++; if (unlikely(0 < 0)) {__pyx_filename = __pyx_f[0]; __pyx_lineno = 240; __pyx_clineno = __LINE__; goto __pyx_L1_error;}
        #else
        __pyx_t_5 = PySequence_ITEM(__pyx_t_3, __pyx_t_1); __pyx_t_1++; if (unlikely(!__pyx_t_5)) {__pyx_filename = __pyx_f[0]; __pyx_lineno = 240; __pyx_clineno = __LINE__; goto __pyx_L1_error;}
        __Pyx_GOTREF(__pyx_t_5);
        #endif
      } else {
        if (__pyx_t_1 >= PyTuple_GET_SIZE(__pyx_t_3)) break;
        #if CYTHON_COMPILING_IN_CPYTHON
        __pyx_t_5 = PyTuple_GET_ITEM(__pyx_t_3, __pyx_t_1); __Pyx_INCREF(__pyx_t_5); __pyx_t_1++; if (unlikely(0 < 0)) {__pyx_filename = __pyx_f[0]; __pyx_lineno = 240; __pyx_clineno = __LINE__; goto __pyx_L1_error;}
        #else
        __pyx_t_5 = PySequence_ITEM(__pyx_t_3, __pyx_t_1); __pyx_t_1++; if (unlikely(!__pyx_t_5)) {__pyx_filename = __pyx_f[0]; __pyx_lineno = 240; __pyx_clineno = __LINE__; goto __pyx_L1_error;}
        __Pyx_GOTREF(__pyx_t_5);
        #endif
      }
    } else {
      __pyx_t_5 = __pyx_t_4(__pyx_t_3);
      if (unlikely(!__pyx_t_5)) {
        PyObject* exc_type = PyErr_Occurred();
        if (exc_type) {
          if (likely(exc_type == PyExc_StopIteration || PyErr_GivenExceptionMatches(exc_type, PyExc_StopIteration))) PyErr_Clear();
          else {__pyx_filename = __pyx_f[0]; __pyx_lineno = 240; __pyx_clineno = __LINE__; goto __pyx_L1_error;}
        }
        break;
      }
      __Pyx_GOTREF(__pyx_t_5);
    }
    if ((likely(PyTuple_CheckExact(__pyx_t_5))) || (PyList_CheckExact(__pyx_t_5))) {
      PyObject* sequence = __pyx_t_5;
      #if CYTHON_COMPILING_IN_CPYTHON
      Py_ssize_t size = Py_SIZE(sequence);
      #else
      Py_ssize_t size = PySequence_Size(sequence);
      #endif
      if (unlikely(size != 2)) {
        if (size > 2) __Pyx_RaiseTooManyValuesError(2);
        else if (size >= 0) __Pyx_RaiseNeedMoreValuesError(size);
        {__pyx_filename = __pyx_f[0]; __pyx_lineno = 240; __pyx_clineno = __LINE__; goto __pyx_L1_error;}
      }
      #if CYTHON_COMPILING_IN_CPYTHON
      if (likely(PyTuple_CheckExact(sequence))) {
        __pyx_t_7 = PyTuple_GET_ITEM(sequence, 0); 
        __pyx_t_6 = PyTuple_GET_ITEM(sequence, 1); 
      } else {
        __pyx_t_7 = PyList_GET_ITEM(sequence, 0); 
        __pyx_t_6 = PyList_GET_ITEM(sequence, 1); 
      }
      __Pyx_INCREF(__pyx_t_7);
      __Pyx_INCREF(__pyx_t_6);
      #else
      __pyx_t_7 = PySequence_ITEM(sequence, 0); if (unlikely(!__pyx_t_7)) {__pyx_filename = __pyx_f[0]; __pyx_lineno = 240; __pyx_clineno = __LINE__; goto __pyx_L1_error;}
      __Pyx_GOTREF(__pyx_t_7);
      __pyx_t_6 = PySequence_ITEM(sequence, 1); if (unlikely(!__pyx_t_6)) {__pyx_filename = __pyx_f[0]; __pyx_lineno = 240; __pyx_clineno = __LINE__; goto __pyx_L1_error;}
      __Pyx_GOTREF(__pyx_t_6);
      #endif
      __Pyx_DECREF(__pyx_t_5); __pyx_t_5 = 0;
    } else {
      Py_ssize_t index = -1;
      __pyx_t_8 = PyObject_GetIter(__pyx_t_5); if (unlikely(!__pyx_t_8)) {__pyx_filename = __pyx_f[0]; __pyx_lineno = 240; __pyx_clineno = __LINE__; goto __pyx_L1_error;}
      __Pyx_GOTREF(__pyx_t_8);
      __Pyx_DECREF(__pyx_t_5); __pyx_t_5 = 0;
      __pyx_t_9 = Py_TYPE(__pyx_t_8)->tp_iternext;
      index = 0; __pyx_t_7 = __pyx_t_9(__pyx_t_8); if (unlikely(!__pyx_t_7)) goto __pyx_L9_unpacking_failed;
      __Pyx_GOTREF(__pyx_t_7);
      index = 1; __pyx_t_6 = __pyx_t_9(__pyx_t_8); if (unlikely(!__pyx_t_6)) goto __pyx_L9_unpacking_failed;
      __Pyx_GOTREF(__pyx_t_6);
      if (__Pyx_IternextUnpackEndCheck(__pyx_t_9(__pyx_t_8), 2) < 0) {__pyx_filename = __pyx_f[0]; __pyx_lineno = 240; __pyx_clineno = __LINE__; goto __pyx_L1_error;}
      __pyx_t_9 = NULL;
      __Pyx_DECREF(__pyx_t_8); __pyx_t_8 = 0;
      goto __pyx_L10_unpacking_done;
      __pyx_L9_unpacking_failed:;
      __Pyx_DECREF(__pyx_t_8); __pyx_t_8 = 0;
      __pyx_t_9 = NULL;
      if (__Pyx_IterFinish() == 0) __Pyx_RaiseNeedMoreValuesError(index);
      {__pyx_filename = __pyx_f[0]; __pyx_lineno = 240; __pyx_clineno = __LINE__; goto __pyx_L1_error;}
      __pyx_L10_unpacking_done:;
    }
    __Pyx_XDECREF_SET(__pyx_v_option, __pyx_t_7);
    __pyx_t_7 = 0;
    __Pyx_XDECREF_SET(__pyx_v_weight, __pyx_t_6);
    __pyx_t_6 = 0;

    /* "eval7/equity.pyx":241
 *     num_options = 0
 *     for option, weight in py_villain:
 *         options[num_options] = cards_to_mask(option)             # <<<<<<<<<<<<<<
 *         num_options += 1
 * 
 */
    (__pyx_v_options[__pyx_v_num_options]) = __pyx_f_5eval7_5cards_cards_to_mask(__pyx_v_option);

    /* "eval7/equity.pyx":242
 *     for option, weight in py_villain:
 *         options[num_options] = cards_to_mask(option)
 *         num_options += 1             # <<<<<<<<<<<<<<
 * 
 *     board = cards_to_mask(py_board)
 */
    __pyx_v_num_options = (__pyx_v_num_options + 1);

    /* "eval7/equity.pyx":240
 * 
 *     num_options = 0
 *     for option, weight in py_villain:             # <<<<<<<<<<<<<<
 *         options[num_options] = cards_to_mask(option)
 *         num_options += 1
 */
  }
  __Pyx_DECREF(__pyx_t_3); __pyx_t_3 = 0;

  /* "eval7/equity.pyx":244
 *         num_options += 1
 * 
 *     board = cards_to_mask(py_board)             # <<<<<<<<<<<<<<
 *     num_board = len(py_board)
 * 
 */
  __pyx_v_board = __pyx_f_5eval7_5cards_cards_to_mask(__pyx_v_py_board);

  /* "eval7/equity.pyx":245
 * 
 *     board = cards_to_mask(py_board)
 *     num_board = len(py_board)             # <<<<<<<<<<<<<<
 * 
 *     all_hands_vs_range(hands, num_hands, options, num_options, board,
 */
  __pyx_t_1 = PyObject_Length(__pyx_v_py_board); if (unlikely(__pyx_t_1 == -1)) {__pyx_filename = __pyx_f[0]; __pyx_lineno = 245; __pyx_clineno = __LINE__; goto __pyx_L1_error;}
  __pyx_v_num_board = __pyx_t_1;

  /* "eval7/equity.pyx":247
 *     num_board = len(py_board)
 * 
 *     all_hands_vs_range(hands, num_hands, options, num_options, board,             # <<<<<<<<<<<<<<
 *             num_board, iterations, result)
 * 
 */
  __pyx_f_5eval7_6equity_all_hands_vs_range(__pyx_v_hands, __pyx_v_num_hands, __pyx_v_options, __pyx_v_num_options, __pyx_v_board, __pyx_v_num_board, __pyx_v_iterations, __pyx_v_result);

  /* "eval7/equity.pyx":250
 *             num_board, iterations, result)
 * 
 *     py_result = {}             # <<<<<<<<<<<<<<
 *     for i, (hand, weight) in enumerate(py_hero):
 *         if result[i] != -1:
 */
  __pyx_t_3 = PyDict_New(); if (unlikely(!__pyx_t_3)) {__pyx_filename = __pyx_f[0]; __pyx_lineno = 250; __pyx_clineno = __LINE__; goto __pyx_L1_error;}
  __Pyx_GOTREF(__pyx_t_3);
  __pyx_v_py_result = ((PyObject*)__pyx_t_3);
  __pyx_t_3 = 0;

  /* "eval7/equity.pyx":251
 * 
 *     py_result = {}
 *     for i, (hand, weight) in enumerate(py_hero):             # <<<<<<<<<<<<<<
 *         if result[i] != -1:
 *             py_result[hand] = result[i]
 */
  __Pyx_INCREF(__pyx_int_0);
  __pyx_t_3 = __pyx_int_0;
  if (likely(PyList_CheckExact(__pyx_v_py_hero)) || PyTuple_CheckExact(__pyx_v_py_hero)) {
    __pyx_t_5 = __pyx_v_py_hero; __Pyx_INCREF(__pyx_t_5); __pyx_t_1 = 0;
    __pyx_t_4 = NULL;
  } else {
    __pyx_t_1 = -1; __pyx_t_5 = PyObject_GetIter(__pyx_v_py_hero); if (unlikely(!__pyx_t_5)) {__pyx_filename = __pyx_f[0]; __pyx_lineno = 251; __pyx_clineno = __LINE__; goto __pyx_L1_error;}
    __Pyx_GOTREF(__pyx_t_5);
    __pyx_t_4 = Py_TYPE(__pyx_t_5)->tp_iternext; if (unlikely(!__pyx_t_4)) {__pyx_filename = __pyx_f[0]; __pyx_lineno = 251; __pyx_clineno = __LINE__; goto __pyx_L1_error;}
  }
  for (;;) {
    if (likely(!__pyx_t_4)) {
      if (likely(PyList_CheckExact(__pyx_t_5))) {
        if (__pyx_t_1 >= PyList_GET_SIZE(__pyx_t_5)) break;
        #if CYTHON_COMPILING_IN_CPYTHON
        __pyx_t_6 = PyList_GET_ITEM(__pyx_t_5, __pyx_t_1); __Pyx_INCREF(__pyx_t_6); __pyx_t_1++; if (unlikely(0 < 0)) {__pyx_filename = __pyx_f[0]; __pyx_lineno = 251; __pyx_clineno = __LINE__; goto __pyx_L1_error;}
        #else
        __pyx_t_6 = PySequence_ITEM(__pyx_t_5, __pyx_t_1); __pyx_t_1++; if (unlikely(!__pyx_t_6)) {__pyx_filename = __pyx_f[0]; __pyx_lineno = 251; __pyx_clineno = __LINE__; goto __pyx_L1_error;}
        __Pyx_GOTREF(__pyx_t_6);
        #endif
      } else {
        if (__pyx_t_1 >= PyTuple_GET_SIZE(__pyx_t_5)) break;
        #if CYTHON_COMPILING_IN_CPYTHON
        __pyx_t_6 = PyTuple_GET_ITEM(__pyx_t_5, __pyx_t_1); __Pyx_INCREF(__pyx_t_6); __pyx_t_1++; if (unlikely(0 < 0)) {__pyx_filename = __pyx_f[0]; __pyx_lineno = 251; __pyx_clineno = __LINE__; goto __pyx_L1_error;}
        #else
        __pyx_t_6 = PySequence_ITEM(__pyx_t_5, __pyx_t_1); __pyx_t_1++; if (unlikely(!__pyx_t_6)) {__pyx_filename = __pyx_f[0]; __pyx_lineno = 251; __pyx_clineno = __LINE__; goto __pyx_L1_error;}
        __Pyx_GOTREF(__pyx_t_6);
        #endif
      }
    } else {
      __pyx_t_6 = __pyx_t_4(__pyx_t_5);
      if (unlikely(!__pyx_t_6)) {
        PyObject* exc_type = PyErr_Occurred();
        if (exc_type) {
          if (likely(exc_type == PyExc_StopIteration || PyErr_GivenExceptionMatches(exc_type, PyExc_StopIteration))) PyErr_Clear();
          else {__pyx_filename = __pyx_f[0]; __pyx_lineno = 251; __pyx_clineno = __LINE__; goto __pyx_L1_error;}
        }
        break;
      }
      __Pyx_GOTREF(__pyx_t_6);
    }
    if ((likely(PyTuple_CheckExact(__pyx_t_6))) || (PyList_CheckExact(__pyx_t_6))) {
      PyObject* sequence = __pyx_t_6;
      #if CYTHON_COMPILING_IN_CPYTHON
      Py_ssize_t size = Py_SIZE(sequence);
      #else
      Py_ssize_t size = PySequence_Size(sequence);
      #endif
      if (unlikely(size != 2)) {
        if (size > 2) __Pyx_RaiseTooManyValuesError(2);
        else if (size >= 0) __Pyx_RaiseNeedMoreValuesError(size);
        {__pyx_filename = __pyx_f[0]; __pyx_lineno = 251; __pyx_clineno = __LINE__; goto __pyx_L1_error;}
      }
      #if CYTHON_COMPILING_IN_CPYTHON
      if (likely(PyTuple_CheckExact(sequence))) {
        __pyx_t_7 = PyTuple_GET_ITEM(sequence, 0); 
        __pyx_t_8 = PyTuple_GET_ITEM(sequence, 1); 
      } else {
        __pyx_t_7 = PyList_GET_ITEM(sequence, 0); 
        __pyx_t_8 = PyList_GET_ITEM(sequence, 1); 
      }
      __Pyx_INCREF(__pyx_t_7);
      __Pyx_INCREF(__pyx_t_8);
      #else
      __pyx_t_7 = PySequence_ITEM(sequence, 0); if (unlikely(!__pyx_t_7)) {__pyx_filename = __pyx_f[0]; __pyx_lineno = 251; __pyx_clineno = __LINE__; goto __pyx_L1_error;}
      __Pyx_GOTREF(__pyx_t_7);
      __pyx_t_8 = PySequence_ITEM(sequence, 1); if (unlikely(!__pyx_t_8)) {__pyx_filename = __pyx_f[0]; __pyx_lineno = 251; __pyx_clineno = __LINE__; goto __pyx_L1_error;}
      __Pyx_GOTREF(__pyx_t_8);
      #endif
      __Pyx_DECREF(__pyx_t_6); __pyx_t_6 = 0;
    } else {
      Py_ssize_t index = -1;
      __pyx_t_10 = PyObject_GetIter(__pyx_t_6); if (unlikely(!__pyx_t_10)) {__pyx_filename = __pyx_f[0]; __pyx_lineno = 251; __pyx_clineno = __LINE__; goto __pyx_L1_error;}
      __Pyx_GOTREF(__pyx_t_10);
      __Pyx_DECREF(__pyx_t_6); __pyx_t_6 = 0;
      __pyx_t_9 = Py_TYPE(__pyx_t_10)->tp_iternext;
      index = 0; __pyx_t_7 = __pyx_t_9(__pyx_t_10); if (unlikely(!__pyx_t_7)) goto __pyx_L13_unpacking_failed;
      __Pyx_GOTREF(__pyx_t_7);
      index = 1; __pyx_t_8 = __pyx_t_9(__pyx_t_10); if (unlikely(!__pyx_t_8)) goto __pyx_L13_unpacking_failed;
      __Pyx_GOTREF(__pyx_t_8);
      if (__Pyx_IternextUnpackEndCheck(__pyx_t_9(__pyx_t_10), 2) < 0) {__pyx_filename = __pyx_f[0]; __pyx_lineno = 251; __pyx_clineno = __LINE__; goto __pyx_L1_error;}
      __pyx_t_9 = NULL;
      __Pyx_DECREF(__pyx_t_10); __pyx_t_10 = 0;
      goto __pyx_L14_unpacking_done;
      __pyx_L13_unpacking_failed:;
      __Pyx_DECREF(__pyx_t_10); __pyx_t_10 = 0;
      __pyx_t_9 = NULL;
      if (__Pyx_IterFinish() == 0) __Pyx_RaiseNeedMoreValuesError(index);
      {__pyx_filename = __pyx_f[0]; __pyx_lineno = 251; __pyx_clineno = __LINE__; goto __pyx_L1_error;}
      __pyx_L14_unpacking_done:;
    }
    __Pyx_XDECREF_SET(__pyx_v_hand, __pyx_t_7);
    __pyx_t_7 = 0;
    __Pyx_XDECREF_SET(__pyx_v_weight, __pyx_t_8);
    __pyx_t_8 = 0;
    __Pyx_INCREF(__pyx_t_3);
    __Pyx_XDECREF_SET(__pyx_v_i, __pyx_t_3);
    __pyx_t_6 = PyNumber_Add(__pyx_t_3, __pyx_int_1); if (unlikely(!__pyx_t_6)) {__pyx_filename = __pyx_f[0]; __pyx_lineno = 251; __pyx_clineno = __LINE__; goto __pyx_L1_error;}
    __Pyx_GOTREF(__pyx_t_6);
    __Pyx_DECREF(__pyx_t_3);
    __pyx_t_3 = __pyx_t_6;
    __pyx_t_6 = 0;

    /* "eval7/equity.pyx":252
 *     py_result = {}
 *     for i, (hand, weight) in enumerate(py_hero):
 *         if result[i] != -1:             # <<<<<<<<<<<<<<
 *             py_result[hand] = result[i]
 *     free(hands)
 */
    __pyx_t_11 = __Pyx_PyIndex_AsSsize_t(__pyx_v_i); if (unlikely((__pyx_t_11 == (Py_ssize_t)-1) && PyErr_Occurred())) {__pyx_filename = __pyx_f[0]; __pyx_lineno = 252; __pyx_clineno = __LINE__; goto __pyx_L1_error;}
    __pyx_t_12 = (((__pyx_v_result[__pyx_t_11]) != -1.0) != 0);
    if (__pyx_t_12) {

      /* "eval7/equity.pyx":253
 *     for i, (hand, weight) in enumerate(py_hero):
 *         if result[i] != -1:
 *             py_result[hand] = result[i]             # <<<<<<<<<<<<<<
 *     free(hands)
 *     free(options)
 */
      __pyx_t_11 = __Pyx_PyIndex_AsSsize_t(__pyx_v_i); if (unlikely((__pyx_t_11 == (Py_ssize_t)-1) && PyErr_Occurred())) {__pyx_filename = __pyx_f[0]; __pyx_lineno = 253; __pyx_clineno = __LINE__; goto __pyx_L1_error;}
      __pyx_t_6 = PyFloat_FromDouble((__pyx_v_result[__pyx_t_11])); if (unlikely(!__pyx_t_6)) {__pyx_filename = __pyx_f[0]; __pyx_lineno = 253; __pyx_clineno = __LINE__; goto __pyx_L1_error;}
      __Pyx_GOTREF(__pyx_t_6);
      if (unlikely(PyDict_SetItem(__pyx_v_py_result, __pyx_v_hand, __pyx_t_6) < 0)) {__pyx_filename = __pyx_f[0]; __pyx_lineno = 253; __pyx_clineno = __LINE__; goto __pyx_L1_error;}
      __Pyx_DECREF(__pyx_t_6); __pyx_t_6 = 0;
      goto __pyx_L15;
    }
    __pyx_L15:;

    /* "eval7/equity.pyx":251
 * 
 *     py_result = {}
 *     for i, (hand, weight) in enumerate(py_hero):             # <<<<<<<<<<<<<<
 *         if result[i] != -1:
 *             py_result[hand] = result[i]
 */
  }
  __Pyx_DECREF(__pyx_t_5); __pyx_t_5 = 0;
  __Pyx_DECREF(__pyx_t_3); __pyx_t_3 = 0;

  /* "eval7/equity.pyx":254
 *         if result[i] != -1:
 *             py_result[hand] = result[i]
 *     free(hands)             # <<<<<<<<<<<<<<
 *     free(options)
 *     free(result)
 */
  free(__pyx_v_hands);

  /* "eval7/equity.pyx":255
 *             py_result[hand] = result[i]
 *     free(hands)
 *     free(options)             # <<<<<<<<<<<<<<
 *     free(result)
 * 
 */
  free(__pyx_v_options);

  /* "eval7/equity.pyx":256
 *     free(hands)
 *     free(options)
 *     free(result)             # <<<<<<<<<<<<<<
 * 
 *     return py_result
 */
  free(__pyx_v_result);

  /* "eval7/equity.pyx":258
 *     free(result)
 * 
 *     return py_result             # <<<<<<<<<<<<<<
 */
  __Pyx_XDECREF(__pyx_r);
  __Pyx_INCREF(__pyx_v_py_result);
  __pyx_r = __pyx_v_py_result;
  goto __pyx_L0;

  /* "eval7/equity.pyx":209
 * 
 * 
 * def py_all_hands_vs_range(py_hero, py_villain, py_board, py_iterations):             # <<<<<<<<<<<<<<
 *     """
 *     Return dict mapping hero's hand to equity against villain's range on this board.
 */

  /* function exit code */
  __pyx_L1_error:;
  __Pyx_XDECREF(__pyx_t_3);
  __Pyx_XDECREF(__pyx_t_5);
  __Pyx_XDECREF(__pyx_t_6);
  __Pyx_XDECREF(__pyx_t_7);
  __Pyx_XDECREF(__pyx_t_8);
  __Pyx_XDECREF(__pyx_t_10);
  __Pyx_AddTraceback("eval7.equity.py_all_hands_vs_range", __pyx_clineno, __pyx_lineno, __pyx_filename);
  __pyx_r = NULL;
  __pyx_L0:;
  __Pyx_XDECREF(__pyx_v_hand);
  __Pyx_XDECREF(__pyx_v_weight);
  __Pyx_XDECREF(__pyx_v_option);
  __Pyx_XDECREF(__pyx_v_py_result);
  __Pyx_XDECREF(__pyx_v_i);
  __Pyx_XGIVEREF(__pyx_r);
  __Pyx_RefNannyFinishContext();
  return __pyx_r;
}

static PyMethodDef __pyx_methods[] = {
  {0, 0, 0, 0}
};

#if PY_MAJOR_VERSION >= 3
static struct PyModuleDef __pyx_moduledef = {
  #if PY_VERSION_HEX < 0x03020000
    { PyObject_HEAD_INIT(NULL) NULL, 0, NULL },
  #else
    PyModuleDef_HEAD_INIT,
  #endif
    "equity",
    0, /* m_doc */
    -1, /* m_size */
    __pyx_methods /* m_methods */,
    NULL, /* m_reload */
    NULL, /* m_traverse */
    NULL, /* m_clear */
    NULL /* m_free */
};
#endif

static __Pyx_StringTabEntry __pyx_string_tab[] = {
  {&__pyx_n_s_board, __pyx_k_board, sizeof(__pyx_k_board), 0, 0, 1, 1},
  {&__pyx_n_s_complete_board, __pyx_k_complete_board, sizeof(__pyx_k_complete_board), 0, 0, 1, 1},
  {&__pyx_n_s_dead, __pyx_k_dead, sizeof(__pyx_k_dead), 0, 0, 1, 1},
  {&__pyx_n_s_enumerate, __pyx_k_enumerate, sizeof(__pyx_k_enumerate), 0, 0, 1, 1},
  {&__pyx_n_s_equity, __pyx_k_equity, sizeof(__pyx_k_equity), 0, 0, 1, 1},
  {&__pyx_n_s_eval7_equity, __pyx_k_eval7_equity, sizeof(__pyx_k_eval7_equity), 0, 0, 1, 1},
  {&__pyx_n_s_hand, __pyx_k_hand, sizeof(__pyx_k_hand), 0, 0, 1, 1},
  {&__pyx_n_s_hands, __pyx_k_hands, sizeof(__pyx_k_hands), 0, 0, 1, 1},
  {&__pyx_kp_s_home_julian_coding_projects_pok, __pyx_k_home_julian_coding_projects_pok, sizeof(__pyx_k_home_julian_coding_projects_pok), 0, 0, 1, 0},
  {&__pyx_n_s_i, __pyx_k_i, sizeof(__pyx_k_i), 0, 0, 1, 1},
  {&__pyx_n_s_index, __pyx_k_index, sizeof(__pyx_k_index), 0, 0, 1, 1},
  {&__pyx_n_s_iterations, __pyx_k_iterations, sizeof(__pyx_k_iterations), 0, 0, 1, 1},
  {&__pyx_n_s_main, __pyx_k_main, sizeof(__pyx_k_main), 0, 0, 1, 1},
  {&__pyx_n_s_mask, __pyx_k_mask, sizeof(__pyx_k_mask), 0, 0, 1, 1},
  {&__pyx_n_s_num_board, __pyx_k_num_board, sizeof(__pyx_k_num_board), 0, 0, 1, 1},
  {&__pyx_n_s_num_hands, __pyx_k_num_hands, sizeof(__pyx_k_num_hands), 0, 0, 1, 1},
  {&__pyx_n_s_num_options, __pyx_k_num_options, sizeof(__pyx_k_num_options), 0, 0, 1, 1},
  {&__pyx_n_s_option, __pyx_k_option, sizeof(__pyx_k_option), 0, 0, 1, 1},
  {&__pyx_n_s_options, __pyx_k_options, sizeof(__pyx_k_options), 0, 0, 1, 1},
  {&__pyx_n_s_py_all_hands_vs_range, __pyx_k_py_all_hands_vs_range, sizeof(__pyx_k_py_all_hands_vs_range), 0, 0, 1, 1},
  {&__pyx_n_s_py_board, __pyx_k_py_board, sizeof(__pyx_k_py_board), 0, 0, 1, 1},
  {&__pyx_n_s_py_hand, __pyx_k_py_hand, sizeof(__pyx_k_py_hand), 0, 0, 1, 1},
  {&__pyx_n_s_py_hand_vs_range_exact, __pyx_k_py_hand_vs_range_exact, sizeof(__pyx_k_py_hand_vs_range_exact), 0, 0, 1, 1},
  {&__pyx_n_s_py_hand_vs_range_monte_carlo, __pyx_k_py_hand_vs_range_monte_carlo, sizeof(__pyx_k_py_hand_vs_range_monte_carlo), 0, 0, 1, 1},
  {&__pyx_n_s_py_hero, __pyx_k_py_hero, sizeof(__pyx_k_py_hero), 0, 0, 1, 1},
  {&__pyx_n_s_py_iterations, __pyx_k_py_iterations, sizeof(__pyx_k_py_iterations), 0, 0, 1, 1},
  {&__pyx_n_s_py_result, __pyx_k_py_result, sizeof(__pyx_k_py_result), 0, 0, 1, 1},
  {&__pyx_n_s_py_villain, __pyx_k_py_villain, sizeof(__pyx_k_py_villain), 0, 0, 1, 1},
  {&__pyx_n_s_range, __pyx_k_range, sizeof(__pyx_k_range), 0, 0, 1, 1},
  {&__pyx_n_s_result, __pyx_k_result, sizeof(__pyx_k_result), 0, 0, 1, 1},
  {&__pyx_n_s_start_board, __pyx_k_start_board, sizeof(__pyx_k_start_board), 0, 0, 1, 1},
  {&__pyx_n_s_test, __pyx_k_test, sizeof(__pyx_k_test), 0, 0, 1, 1},
  {&__pyx_n_s_weight, __pyx_k_weight, sizeof(__pyx_k_weight), 0, 0, 1, 1},
  {0, 0, 0, 0, 0, 0, 0}
};
static int __Pyx_InitCachedBuiltins(void) {
  __pyx_builtin_range = __Pyx_GetBuiltinName(__pyx_n_s_range); if (!__pyx_builtin_range) {__pyx_filename = __pyx_f[0]; __pyx_lineno = 22; __pyx_clineno = __LINE__; goto __pyx_L1_error;}
  __pyx_builtin_enumerate = __Pyx_GetBuiltinName(__pyx_n_s_enumerate); if (!__pyx_builtin_enumerate) {__pyx_filename = __pyx_f[0]; __pyx_lineno = 111; __pyx_clineno = __LINE__; goto __pyx_L1_error;}
  return 0;
  __pyx_L1_error:;
  return -1;
}

static int __Pyx_InitCachedConstants(void) {
  __Pyx_RefNannyDeclarations
  __Pyx_RefNannySetupContext("__Pyx_InitCachedConstants", 0);

  /* "eval7/equity.pyx":22
 * 
 * cdef cython.uint load_card_masks():
 *     for i in range(52):             # <<<<<<<<<<<<<<
 *         card_masks_table[i] = 1 << i
 *     return 0
 */
  __pyx_tuple_ = PyTuple_Pack(1, __pyx_int_52); if (unlikely(!__pyx_tuple_)) {__pyx_filename = __pyx_f[0]; __pyx_lineno = 22; __pyx_clineno = __LINE__; goto __pyx_L1_error;}
  __Pyx_GOTREF(__pyx_tuple_);
  __Pyx_GIVEREF(__pyx_tuple_);

  /* "eval7/equity.pyx":100
 * 
 * 
 * def py_hand_vs_range_monte_carlo(py_hand, py_villain, py_board,             # <<<<<<<<<<<<<<
 *         py_iterations):
 *     cdef cython.ulonglong hand = cards_to_mask(py_hand)
 */
  __pyx_tuple__2 = PyTuple_Pack(14, __pyx_n_s_py_hand, __pyx_n_s_py_villain, __pyx_n_s_py_board, __pyx_n_s_py_iterations, __pyx_n_s_hand, __pyx_n_s_num_options, __pyx_n_s_options, __pyx_n_s_start_board, __pyx_n_s_num_board, __pyx_n_s_iterations, __pyx_n_s_equity, __pyx_n_s_mask, __pyx_n_s_index, __pyx_n_s_option); if (unlikely(!__pyx_tuple__2)) {__pyx_filename = __pyx_f[0]; __pyx_lineno = 100; __pyx_clineno = __LINE__; goto __pyx_L1_error;}
  __Pyx_GOTREF(__pyx_tuple__2);
  __Pyx_GIVEREF(__pyx_tuple__2);
  __pyx_codeobj__3 = (PyObject*)__Pyx_PyCode_New(4, 0, 14, 0, 0, __pyx_empty_bytes, __pyx_empty_tuple, __pyx_empty_tuple, __pyx_tuple__2, __pyx_empty_tuple, __pyx_empty_tuple, __pyx_kp_s_home_julian_coding_projects_pok, __pyx_n_s_py_hand_vs_range_monte_carlo, 100, __pyx_empty_bytes); if (unlikely(!__pyx_codeobj__3)) {__pyx_filename = __pyx_f[0]; __pyx_lineno = 100; __pyx_clineno = __LINE__; goto __pyx_L1_error;}

  /* "eval7/equity.pyx":147
 * 
 * 
 * def py_hand_vs_range_exact(py_hand, py_villain, py_board):             # <<<<<<<<<<<<<<
 *     cdef cython.ulonglong hand = cards_to_mask(py_hand)  # @DuplicatedSignature
 *     cdef cython.int num_options = len(py_villain)  # @DuplicatedSignature
 */
  __pyx_tuple__4 = PyTuple_Pack(12, __pyx_n_s_py_hand, __pyx_n_s_py_villain, __pyx_n_s_py_board, __pyx_n_s_hand, __pyx_n_s_num_options, __pyx_n_s_options, __pyx_n_s_complete_board, __pyx_n_s_equity, __pyx_n_s_mask, __pyx_n_s_dead, __pyx_n_s_index, __pyx_n_s_option); if (unlikely(!__pyx_tuple__4)) {__pyx_filename = __pyx_f[0]; __pyx_lineno = 147; __pyx_clineno = __LINE__; goto __pyx_L1_error;}
  __Pyx_GOTREF(__pyx_tuple__4);
  __Pyx_GIVEREF(__pyx_tuple__4);
  __pyx_codeobj__5 = (PyObject*)__Pyx_PyCode_New(3, 0, 12, 0, 0, __pyx_empty_bytes, __pyx_empty_tuple, __pyx_empty_tuple, __pyx_tuple__4, __pyx_empty_tuple, __pyx_empty_tuple, __pyx_kp_s_home_julian_coding_projects_pok, __pyx_n_s_py_hand_vs_range_exact, 147, __pyx_empty_bytes); if (unlikely(!__pyx_codeobj__5)) {__pyx_filename = __pyx_f[0]; __pyx_lineno = 147; __pyx_clineno = __LINE__; goto __pyx_L1_error;}

  /* "eval7/equity.pyx":209
 * 
 * 
 * def py_all_hands_vs_range(py_hero, py_villain, py_board, py_iterations):             # <<<<<<<<<<<<<<
 *     """
 *     Return dict mapping hero's hand to equity against villain's range on this board.
 */
  __pyx_tuple__6 = PyTuple_Pack(17, __pyx_n_s_py_hero, __pyx_n_s_py_villain, __pyx_n_s_py_board, __pyx_n_s_py_iterations, __pyx_n_s_hands, __pyx_n_s_num_hands, __pyx_n_s_options, __pyx_n_s_num_options, __pyx_n_s_board, __pyx_n_s_num_board, __pyx_n_s_iterations, __pyx_n_s_result, __pyx_n_s_hand, __pyx_n_s_weight, __pyx_n_s_option, __pyx_n_s_py_result, __pyx_n_s_i); if (unlikely(!__pyx_tuple__6)) {__pyx_filename = __pyx_f[0]; __pyx_lineno = 209; __pyx_clineno = __LINE__; goto __pyx_L1_error;}
  __Pyx_GOTREF(__pyx_tuple__6);
  __Pyx_GIVEREF(__pyx_tuple__6);
  __pyx_codeobj__7 = (PyObject*)__Pyx_PyCode_New(4, 0, 17, 0, 0, __pyx_empty_bytes, __pyx_empty_tuple, __pyx_empty_tuple, __pyx_tuple__6, __pyx_empty_tuple, __pyx_empty_tuple, __pyx_kp_s_home_julian_coding_projects_pok, __pyx_n_s_py_all_hands_vs_range, 209, __pyx_empty_bytes); if (unlikely(!__pyx_codeobj__7)) {__pyx_filename = __pyx_f[0]; __pyx_lineno = 209; __pyx_clineno = __LINE__; goto __pyx_L1_error;}
  __Pyx_RefNannyFinishContext();
  return 0;
  __pyx_L1_error:;
  __Pyx_RefNannyFinishContext();
  return -1;
}

static int __Pyx_InitGlobals(void) {
  if (__Pyx_InitStrings(__pyx_string_tab) < 0) {__pyx_filename = __pyx_f[0]; __pyx_lineno = 1; __pyx_clineno = __LINE__; goto __pyx_L1_error;};
  __pyx_int_0 = PyInt_FromLong(0); if (unlikely(!__pyx_int_0)) {__pyx_filename = __pyx_f[0]; __pyx_lineno = 1; __pyx_clineno = __LINE__; goto __pyx_L1_error;}
  __pyx_int_1 = PyInt_FromLong(1); if (unlikely(!__pyx_int_1)) {__pyx_filename = __pyx_f[0]; __pyx_lineno = 1; __pyx_clineno = __LINE__; goto __pyx_L1_error;}
  __pyx_int_52 = PyInt_FromLong(52); if (unlikely(!__pyx_int_52)) {__pyx_filename = __pyx_f[0]; __pyx_lineno = 1; __pyx_clineno = __LINE__; goto __pyx_L1_error;}
  return 0;
  __pyx_L1_error:;
  return -1;
}

#if PY_MAJOR_VERSION < 3
PyMODINIT_FUNC initequity(void); /*proto*/
PyMODINIT_FUNC initequity(void)
#else
PyMODINIT_FUNC PyInit_equity(void); /*proto*/
PyMODINIT_FUNC PyInit_equity(void)
#endif
{
  PyObject *__pyx_t_1 = NULL;
  PyObject *__pyx_t_2 = NULL;
  PyObject *__pyx_t_3 = NULL;
  PyObject *__pyx_t_4 = NULL;
  int __pyx_lineno = 0;
  const char *__pyx_filename = NULL;
  int __pyx_clineno = 0;
  __Pyx_RefNannyDeclarations
  #if CYTHON_REFNANNY
  __Pyx_RefNanny = __Pyx_RefNannyImportAPI("refnanny");
  if (!__Pyx_RefNanny) {
      PyErr_Clear();
      __Pyx_RefNanny = __Pyx_RefNannyImportAPI("Cython.Runtime.refnanny");
      if (!__Pyx_RefNanny)
          Py_FatalError("failed to import 'refnanny' module");
  }
  #endif
  __Pyx_RefNannySetupContext("PyMODINIT_FUNC PyInit_equity(void)", 0);
  if ( __Pyx_check_binary_version() < 0) {__pyx_filename = __pyx_f[0]; __pyx_lineno = 1; __pyx_clineno = __LINE__; goto __pyx_L1_error;}
  __pyx_empty_tuple = PyTuple_New(0); if (unlikely(!__pyx_empty_tuple)) {__pyx_filename = __pyx_f[0]; __pyx_lineno = 1; __pyx_clineno = __LINE__; goto __pyx_L1_error;}
  __pyx_empty_bytes = PyBytes_FromStringAndSize("", 0); if (unlikely(!__pyx_empty_bytes)) {__pyx_filename = __pyx_f[0]; __pyx_lineno = 1; __pyx_clineno = __LINE__; goto __pyx_L1_error;}
  #ifdef __Pyx_CyFunction_USED
  if (__Pyx_CyFunction_init() < 0) {__pyx_filename = __pyx_f[0]; __pyx_lineno = 1; __pyx_clineno = __LINE__; goto __pyx_L1_error;}
  #endif
  #ifdef __Pyx_FusedFunction_USED
  if (__pyx_FusedFunction_init() < 0) {__pyx_filename = __pyx_f[0]; __pyx_lineno = 1; __pyx_clineno = __LINE__; goto __pyx_L1_error;}
  #endif
  #ifdef __Pyx_Generator_USED
  if (__pyx_Generator_init() < 0) {__pyx_filename = __pyx_f[0]; __pyx_lineno = 1; __pyx_clineno = __LINE__; goto __pyx_L1_error;}
  #endif
  /*--- Library function declarations ---*/
  /*--- Threads initialization code ---*/
  #if defined(__PYX_FORCE_INIT_THREADS) && __PYX_FORCE_INIT_THREADS
  #ifdef WITH_THREAD /* Python build with threading support? */
  PyEval_InitThreads();
  #endif
  #endif
  /*--- Module creation code ---*/
  #if PY_MAJOR_VERSION < 3
  __pyx_m = Py_InitModule4("equity", __pyx_methods, 0, 0, PYTHON_API_VERSION); Py_XINCREF(__pyx_m);
  #else
  __pyx_m = PyModule_Create(&__pyx_moduledef);
  #endif
  if (unlikely(!__pyx_m)) {__pyx_filename = __pyx_f[0]; __pyx_lineno = 1; __pyx_clineno = __LINE__; goto __pyx_L1_error;}
  __pyx_d = PyModule_GetDict(__pyx_m); if (unlikely(!__pyx_d)) {__pyx_filename = __pyx_f[0]; __pyx_lineno = 1; __pyx_clineno = __LINE__; goto __pyx_L1_error;}
  Py_INCREF(__pyx_d);
  __pyx_b = PyImport_AddModule(__Pyx_BUILTIN_MODULE_NAME); if (unlikely(!__pyx_b)) {__pyx_filename = __pyx_f[0]; __pyx_lineno = 1; __pyx_clineno = __LINE__; goto __pyx_L1_error;}
  #if CYTHON_COMPILING_IN_PYPY
  Py_INCREF(__pyx_b);
  #endif
  if (PyObject_SetAttrString(__pyx_m, "__builtins__", __pyx_b) < 0) {__pyx_filename = __pyx_f[0]; __pyx_lineno = 1; __pyx_clineno = __LINE__; goto __pyx_L1_error;};
  /*--- Initialize various global constants etc. ---*/
  if (unlikely(__Pyx_InitGlobals() < 0)) {__pyx_filename = __pyx_f[0]; __pyx_lineno = 1; __pyx_clineno = __LINE__; goto __pyx_L1_error;}
  #if PY_MAJOR_VERSION < 3 && (__PYX_DEFAULT_STRING_ENCODING_IS_ASCII || __PYX_DEFAULT_STRING_ENCODING_IS_DEFAULT)
  if (__Pyx_init_sys_getdefaultencoding_params() < 0) {__pyx_filename = __pyx_f[0]; __pyx_lineno = 1; __pyx_clineno = __LINE__; goto __pyx_L1_error;}
  #endif
  if (__pyx_module_is_main_eval7__equity) {
    if (PyObject_SetAttrString(__pyx_m, "__name__", __pyx_n_s_main) < 0) {__pyx_filename = __pyx_f[0]; __pyx_lineno = 1; __pyx_clineno = __LINE__; goto __pyx_L1_error;};
  }
  #if PY_MAJOR_VERSION >= 3
  {
    PyObject *modules = PyImport_GetModuleDict(); if (unlikely(!modules)) {__pyx_filename = __pyx_f[0]; __pyx_lineno = 1; __pyx_clineno = __LINE__; goto __pyx_L1_error;}
    if (!PyDict_GetItemString(modules, "eval7.equity")) {
      if (unlikely(PyDict_SetItemString(modules, "eval7.equity", __pyx_m) < 0)) {__pyx_filename = __pyx_f[0]; __pyx_lineno = 1; __pyx_clineno = __LINE__; goto __pyx_L1_error;}
    }
  }
  #endif
  /*--- Builtin init code ---*/
  if (unlikely(__Pyx_InitCachedBuiltins() < 0)) {__pyx_filename = __pyx_f[0]; __pyx_lineno = 1; __pyx_clineno = __LINE__; goto __pyx_L1_error;}
  /*--- Constants init code ---*/
  if (unlikely(__Pyx_InitCachedConstants() < 0)) {__pyx_filename = __pyx_f[0]; __pyx_lineno = 1; __pyx_clineno = __LINE__; goto __pyx_L1_error;}
  /*--- Global init code ---*/
  /*--- Variable export code ---*/
  /*--- Function export code ---*/
  /*--- Type init code ---*/
  /*--- Type import code ---*/
  __pyx_ptype_5eval7_5cards_Card = __Pyx_ImportType("eval7.cards", "Card", sizeof(struct __pyx_obj_5eval7_5cards_Card), 1); if (unlikely(!__pyx_ptype_5eval7_5cards_Card)) {__pyx_filename = __pyx_f[1]; __pyx_lineno = 8; __pyx_clineno = __LINE__; goto __pyx_L1_error;}
  /*--- Variable import code ---*/
  /*--- Function import code ---*/
  __pyx_t_1 = __Pyx_ImportModule("eval7.wh_rand"); if (!__pyx_t_1) {__pyx_filename = __pyx_f[0]; __pyx_lineno = 1; __pyx_clineno = __LINE__; goto __pyx_L1_error;}
  if (__Pyx_ImportFunction(__pyx_t_1, "wh_randint", (void (**)(void))&__pyx_f_5eval7_7wh_rand_wh_randint, "int (int)") < 0) {__pyx_filename = __pyx_f[0]; __pyx_lineno = 1; __pyx_clineno = __LINE__; goto __pyx_L1_error;}
  Py_DECREF(__pyx_t_1); __pyx_t_1 = 0;
  __pyx_t_2 = __Pyx_ImportModule("eval7.eval7"); if (!__pyx_t_2) {__pyx_filename = __pyx_f[0]; __pyx_lineno = 1; __pyx_clineno = __LINE__; goto __pyx_L1_error;}
  if (__Pyx_ImportFunction(__pyx_t_2, "cy_evaluate", (void (**)(void))&__pyx_f_5eval7_5eval7_cy_evaluate, "unsigned int (unsigned PY_LONG_LONG, unsigned int)") < 0) {__pyx_filename = __pyx_f[0]; __pyx_lineno = 1; __pyx_clineno = __LINE__; goto __pyx_L1_error;}
  Py_DECREF(__pyx_t_2); __pyx_t_2 = 0;
  __pyx_t_3 = __Pyx_ImportModule("eval7.cards"); if (!__pyx_t_3) {__pyx_filename = __pyx_f[0]; __pyx_lineno = 1; __pyx_clineno = __LINE__; goto __pyx_L1_error;}
  if (__Pyx_ImportFunction(__pyx_t_3, "cards_to_mask", (void (**)(void))&__pyx_f_5eval7_5cards_cards_to_mask, "unsigned PY_LONG_LONG (PyObject *)") < 0) {__pyx_filename = __pyx_f[0]; __pyx_lineno = 1; __pyx_clineno = __LINE__; goto __pyx_L1_error;}
  Py_DECREF(__pyx_t_3); __pyx_t_3 = 0;
  /*--- Execution code ---*/

  /* "eval7/equity.pyx":27
 * 
 * 
 * load_card_masks()             # <<<<<<<<<<<<<<
 * 
 * 
 */
  __pyx_f_5eval7_6equity_load_card_masks();

  /* "eval7/equity.pyx":100
 * 
 * 
 * def py_hand_vs_range_monte_carlo(py_hand, py_villain, py_board,             # <<<<<<<<<<<<<<
 *         py_iterations):
 *     cdef cython.ulonglong hand = cards_to_mask(py_hand)
 */
  __pyx_t_4 = PyCFunction_NewEx(&__pyx_mdef_5eval7_6equity_1py_hand_vs_range_monte_carlo, NULL, __pyx_n_s_eval7_equity); if (unlikely(!__pyx_t_4)) {__pyx_filename = __pyx_f[0]; __pyx_lineno = 100; __pyx_clineno = __LINE__; goto __pyx_L1_error;}
  __Pyx_GOTREF(__pyx_t_4);
  if (PyDict_SetItem(__pyx_d, __pyx_n_s_py_hand_vs_range_monte_carlo, __pyx_t_4) < 0) {__pyx_filename = __pyx_f[0]; __pyx_lineno = 100; __pyx_clineno = __LINE__; goto __pyx_L1_error;}
  __Pyx_DECREF(__pyx_t_4); __pyx_t_4 = 0;

  /* "eval7/equity.pyx":147
 * 
 * 
 * def py_hand_vs_range_exact(py_hand, py_villain, py_board):             # <<<<<<<<<<<<<<
 *     cdef cython.ulonglong hand = cards_to_mask(py_hand)  # @DuplicatedSignature
 *     cdef cython.int num_options = len(py_villain)  # @DuplicatedSignature
 */
  __pyx_t_4 = PyCFunction_NewEx(&__pyx_mdef_5eval7_6equity_3py_hand_vs_range_exact, NULL, __pyx_n_s_eval7_equity); if (unlikely(!__pyx_t_4)) {__pyx_filename = __pyx_f[0]; __pyx_lineno = 147; __pyx_clineno = __LINE__; goto __pyx_L1_error;}
  __Pyx_GOTREF(__pyx_t_4);
  if (PyDict_SetItem(__pyx_d, __pyx_n_s_py_hand_vs_range_exact, __pyx_t_4) < 0) {__pyx_filename = __pyx_f[0]; __pyx_lineno = 147; __pyx_clineno = __LINE__; goto __pyx_L1_error;}
  __Pyx_DECREF(__pyx_t_4); __pyx_t_4 = 0;

  /* "eval7/equity.pyx":209
 * 
 * 
 * def py_all_hands_vs_range(py_hero, py_villain, py_board, py_iterations):             # <<<<<<<<<<<<<<
 *     """
 *     Return dict mapping hero's hand to equity against villain's range on this board.
 */
  __pyx_t_4 = PyCFunction_NewEx(&__pyx_mdef_5eval7_6equity_5py_all_hands_vs_range, NULL, __pyx_n_s_eval7_equity); if (unlikely(!__pyx_t_4)) {__pyx_filename = __pyx_f[0]; __pyx_lineno = 209; __pyx_clineno = __LINE__; goto __pyx_L1_error;}
  __Pyx_GOTREF(__pyx_t_4);
  if (PyDict_SetItem(__pyx_d, __pyx_n_s_py_all_hands_vs_range, __pyx_t_4) < 0) {__pyx_filename = __pyx_f[0]; __pyx_lineno = 209; __pyx_clineno = __LINE__; goto __pyx_L1_error;}
  __Pyx_DECREF(__pyx_t_4); __pyx_t_4 = 0;

  /* "eval7/equity.pyx":1
 * # Copyright 2014 Anonymous7 from Reddit, Julian Andrews             # <<<<<<<<<<<<<<
 * #
 * # This software may be modified and distributed under the terms
 */
  __pyx_t_4 = PyDict_New(); if (unlikely(!__pyx_t_4)) {__pyx_filename = __pyx_f[0]; __pyx_lineno = 1; __pyx_clineno = __LINE__; goto __pyx_L1_error;}
  __Pyx_GOTREF(__pyx_t_4);
  if (PyDict_SetItem(__pyx_d, __pyx_n_s_test, __pyx_t_4) < 0) {__pyx_filename = __pyx_f[0]; __pyx_lineno = 1; __pyx_clineno = __LINE__; goto __pyx_L1_error;}
  __Pyx_DECREF(__pyx_t_4); __pyx_t_4 = 0;

  /*--- Wrapped vars code ---*/

  goto __pyx_L0;
  __pyx_L1_error:;
  __Pyx_XDECREF(__pyx_t_1);
  __Pyx_XDECREF(__pyx_t_2);
  __Pyx_XDECREF(__pyx_t_3);
  __Pyx_XDECREF(__pyx_t_4);
  if (__pyx_m) {
    if (__pyx_d) {
      __Pyx_AddTraceback("init eval7.equity", __pyx_clineno, __pyx_lineno, __pyx_filename);
    }
    Py_DECREF(__pyx_m); __pyx_m = 0;
  } else if (!PyErr_Occurred()) {
    PyErr_SetString(PyExc_ImportError, "init eval7.equity");
  }
  __pyx_L0:;
  __Pyx_RefNannyFinishContext();
  #if PY_MAJOR_VERSION < 3
  return;
  #else
  return __pyx_m;
  #endif
}

/* --- Runtime support code --- */
#if CYTHON_REFNANNY
static __Pyx_RefNannyAPIStruct *__Pyx_RefNannyImportAPI(const char *modname) {
    PyObject *m = NULL, *p = NULL;
    void *r = NULL;
    m = PyImport_ImportModule((char *)modname);
    if (!m) goto end;
    p = PyObject_GetAttrString(m, (char *)"RefNannyAPI");
    if (!p) goto end;
    r = PyLong_AsVoidPtr(p);
end:
    Py_XDECREF(p);
    Py_XDECREF(m);
    return (__Pyx_RefNannyAPIStruct *)r;
}
#endif

static PyObject *__Pyx_GetBuiltinName(PyObject *name) {
    PyObject* result = __Pyx_PyObject_GetAttrStr(__pyx_b, name);
    if (unlikely(!result)) {
        PyErr_Format(PyExc_NameError,
#if PY_MAJOR_VERSION >= 3
            "name '%U' is not defined", name);
#else
            "name '%.200s' is not defined", PyString_AS_STRING(name));
#endif
    }
    return result;
}

#if CYTHON_COMPILING_IN_CPYTHON
static CYTHON_INLINE PyObject* __Pyx_PyObject_Call(PyObject *func, PyObject *arg, PyObject *kw) {
    PyObject *result;
    ternaryfunc call = func->ob_type->tp_call;
    if (unlikely(!call))
        return PyObject_Call(func, arg, kw);
    if (unlikely(Py_EnterRecursiveCall((char*)" while calling a Python object")))
        return NULL;
    result = (*call)(func, arg, kw);
    Py_LeaveRecursiveCall();
    if (unlikely(!result) && unlikely(!PyErr_Occurred())) {
        PyErr_SetString(
            PyExc_SystemError,
            "NULL result without error in PyObject_Call");
    }
    return result;
}
#endif

static CYTHON_INLINE void __Pyx_ErrRestore(PyObject *type, PyObject *value, PyObject *tb) {
#if CYTHON_COMPILING_IN_CPYTHON
    PyObject *tmp_type, *tmp_value, *tmp_tb;
    PyThreadState *tstate = PyThreadState_GET();
    tmp_type = tstate->curexc_type;
    tmp_value = tstate->curexc_value;
    tmp_tb = tstate->curexc_traceback;
    tstate->curexc_type = type;
    tstate->curexc_value = value;
    tstate->curexc_traceback = tb;
    Py_XDECREF(tmp_type);
    Py_XDECREF(tmp_value);
    Py_XDECREF(tmp_tb);
#else
    PyErr_Restore(type, value, tb);
#endif
}
static CYTHON_INLINE void __Pyx_ErrFetch(PyObject **type, PyObject **value, PyObject **tb) {
#if CYTHON_COMPILING_IN_CPYTHON
    PyThreadState *tstate = PyThreadState_GET();
    *type = tstate->curexc_type;
    *value = tstate->curexc_value;
    *tb = tstate->curexc_traceback;
    tstate->curexc_type = 0;
    tstate->curexc_value = 0;
    tstate->curexc_traceback = 0;
#else
    PyErr_Fetch(type, value, tb);
#endif
}

static void __Pyx_WriteUnraisable(const char *name, CYTHON_UNUSED int clineno,
                                  CYTHON_UNUSED int lineno, CYTHON_UNUSED const char *filename,
                                  int full_traceback, CYTHON_UNUSED int nogil) {
    PyObject *old_exc, *old_val, *old_tb;
    PyObject *ctx;
#ifdef WITH_THREAD
    PyGILState_STATE state;
    if (nogil)
        state = PyGILState_Ensure();
#endif
    __Pyx_ErrFetch(&old_exc, &old_val, &old_tb);
    if (full_traceback) {
        Py_XINCREF(old_exc);
        Py_XINCREF(old_val);
        Py_XINCREF(old_tb);
        __Pyx_ErrRestore(old_exc, old_val, old_tb);
        PyErr_PrintEx(1);
    }
    #if PY_MAJOR_VERSION < 3
    ctx = PyString_FromString(name);
    #else
    ctx = PyUnicode_FromString(name);
    #endif
    __Pyx_ErrRestore(old_exc, old_val, old_tb);
    if (!ctx) {
        PyErr_WriteUnraisable(Py_None);
    } else {
        PyErr_WriteUnraisable(ctx);
        Py_DECREF(ctx);
    }
#ifdef WITH_THREAD
    if (nogil)
        PyGILState_Release(state);
#endif
}

static void __Pyx_RaiseArgtupleInvalid(
    const char* func_name,
    int exact,
    Py_ssize_t num_min,
    Py_ssize_t num_max,
    Py_ssize_t num_found)
{
    Py_ssize_t num_expected;
    const char *more_or_less;
    if (num_found < num_min) {
        num_expected = num_min;
        more_or_less = "at least";
    } else {
        num_expected = num_max;
        more_or_less = "at most";
    }
    if (exact) {
        more_or_less = "exactly";
    }
    PyErr_Format(PyExc_TypeError,
                 "%.200s() takes %.8s %" CYTHON_FORMAT_SSIZE_T "d positional argument%.1s (%" CYTHON_FORMAT_SSIZE_T "d given)",
                 func_name, more_or_less, num_expected,
                 (num_expected == 1) ? "" : "s", num_found);
}

static void __Pyx_RaiseDoubleKeywordsError(
    const char* func_name,
    PyObject* kw_name)
{
    PyErr_Format(PyExc_TypeError,
        #if PY_MAJOR_VERSION >= 3
        "%s() got multiple values for keyword argument '%U'", func_name, kw_name);
        #else
        "%s() got multiple values for keyword argument '%s'", func_name,
        PyString_AsString(kw_name));
        #endif
}

static int __Pyx_ParseOptionalKeywords(
    PyObject *kwds,
    PyObject **argnames[],
    PyObject *kwds2,
    PyObject *values[],
    Py_ssize_t num_pos_args,
    const char* function_name)
{
    PyObject *key = 0, *value = 0;
    Py_ssize_t pos = 0;
    PyObject*** name;
    PyObject*** first_kw_arg = argnames + num_pos_args;
    while (PyDict_Next(kwds, &pos, &key, &value)) {
        name = first_kw_arg;
        while (*name && (**name != key)) name++;
        if (*name) {
            values[name-argnames] = value;
            continue;
        }
        name = first_kw_arg;
        #if PY_MAJOR_VERSION < 3
        if (likely(PyString_CheckExact(key)) || likely(PyString_Check(key))) {
            while (*name) {
                if ((CYTHON_COMPILING_IN_PYPY || PyString_GET_SIZE(**name) == PyString_GET_SIZE(key))
                        && _PyString_Eq(**name, key)) {
                    values[name-argnames] = value;
                    break;
                }
                name++;
            }
            if (*name) continue;
            else {
                PyObject*** argname = argnames;
                while (argname != first_kw_arg) {
                    if ((**argname == key) || (
                            (CYTHON_COMPILING_IN_PYPY || PyString_GET_SIZE(**argname) == PyString_GET_SIZE(key))
                             && _PyString_Eq(**argname, key))) {
                        goto arg_passed_twice;
                    }
                    argname++;
                }
            }
        } else
        #endif
        if (likely(PyUnicode_Check(key))) {
            while (*name) {
                int cmp = (**name == key) ? 0 :
                #if !CYTHON_COMPILING_IN_PYPY && PY_MAJOR_VERSION >= 3
                    (PyUnicode_GET_SIZE(**name) != PyUnicode_GET_SIZE(key)) ? 1 :
                #endif
                    PyUnicode_Compare(**name, key);
                if (cmp < 0 && unlikely(PyErr_Occurred())) goto bad;
                if (cmp == 0) {
                    values[name-argnames] = value;
                    break;
                }
                name++;
            }
            if (*name) continue;
            else {
                PyObject*** argname = argnames;
                while (argname != first_kw_arg) {
                    int cmp = (**argname == key) ? 0 :
                    #if !CYTHON_COMPILING_IN_PYPY && PY_MAJOR_VERSION >= 3
                        (PyUnicode_GET_SIZE(**argname) != PyUnicode_GET_SIZE(key)) ? 1 :
                    #endif
                        PyUnicode_Compare(**argname, key);
                    if (cmp < 0 && unlikely(PyErr_Occurred())) goto bad;
                    if (cmp == 0) goto arg_passed_twice;
                    argname++;
                }
            }
        } else
            goto invalid_keyword_type;
        if (kwds2) {
            if (unlikely(PyDict_SetItem(kwds2, key, value))) goto bad;
        } else {
            goto invalid_keyword;
        }
    }
    return 0;
arg_passed_twice:
    __Pyx_RaiseDoubleKeywordsError(function_name, key);
    goto bad;
invalid_keyword_type:
    PyErr_Format(PyExc_TypeError,
        "%.200s() keywords must be strings", function_name);
    goto bad;
invalid_keyword:
    PyErr_Format(PyExc_TypeError,
    #if PY_MAJOR_VERSION < 3
        "%.200s() got an unexpected keyword argument '%.200s'",
        function_name, PyString_AsString(key));
    #else
        "%s() got an unexpected keyword argument '%U'",
        function_name, key);
    #endif
bad:
    return -1;
}

static CYTHON_INLINE PyObject *__Pyx_GetItemInt_Generic(PyObject *o, PyObject* j) {
    PyObject *r;
    if (!j) return NULL;
    r = PyObject_GetItem(o, j);
    Py_DECREF(j);
    return r;
}
static CYTHON_INLINE PyObject *__Pyx_GetItemInt_List_Fast(PyObject *o, Py_ssize_t i,
                                                              CYTHON_NCP_UNUSED int wraparound,
                                                              CYTHON_NCP_UNUSED int boundscheck) {
#if CYTHON_COMPILING_IN_CPYTHON
    if (wraparound & unlikely(i < 0)) i += PyList_GET_SIZE(o);
    if ((!boundscheck) || likely((0 <= i) & (i < PyList_GET_SIZE(o)))) {
        PyObject *r = PyList_GET_ITEM(o, i);
        Py_INCREF(r);
        return r;
    }
    return __Pyx_GetItemInt_Generic(o, PyInt_FromSsize_t(i));
#else
    return PySequence_GetItem(o, i);
#endif
}
static CYTHON_INLINE PyObject *__Pyx_GetItemInt_Tuple_Fast(PyObject *o, Py_ssize_t i,
                                                              CYTHON_NCP_UNUSED int wraparound,
                                                              CYTHON_NCP_UNUSED int boundscheck) {
#if CYTHON_COMPILING_IN_CPYTHON
    if (wraparound & unlikely(i < 0)) i += PyTuple_GET_SIZE(o);
    if ((!boundscheck) || likely((0 <= i) & (i < PyTuple_GET_SIZE(o)))) {
        PyObject *r = PyTuple_GET_ITEM(o, i);
        Py_INCREF(r);
        return r;
    }
    return __Pyx_GetItemInt_Generic(o, PyInt_FromSsize_t(i));
#else
    return PySequence_GetItem(o, i);
#endif
}
static CYTHON_INLINE PyObject *__Pyx_GetItemInt_Fast(PyObject *o, Py_ssize_t i, int is_list,
                                                     CYTHON_NCP_UNUSED int wraparound,
                                                     CYTHON_NCP_UNUSED int boundscheck) {
#if CYTHON_COMPILING_IN_CPYTHON
    if (is_list || PyList_CheckExact(o)) {
        Py_ssize_t n = ((!wraparound) | likely(i >= 0)) ? i : i + PyList_GET_SIZE(o);
        if ((!boundscheck) || (likely((n >= 0) & (n < PyList_GET_SIZE(o))))) {
            PyObject *r = PyList_GET_ITEM(o, n);
            Py_INCREF(r);
            return r;
        }
    }
    else if (PyTuple_CheckExact(o)) {
        Py_ssize_t n = ((!wraparound) | likely(i >= 0)) ? i : i + PyTuple_GET_SIZE(o);
        if ((!boundscheck) || likely((n >= 0) & (n < PyTuple_GET_SIZE(o)))) {
            PyObject *r = PyTuple_GET_ITEM(o, n);
            Py_INCREF(r);
            return r;
        }
    } else {
        PySequenceMethods *m = Py_TYPE(o)->tp_as_sequence;
        if (likely(m && m->sq_item)) {
            if (wraparound && unlikely(i < 0) && likely(m->sq_length)) {
                Py_ssize_t l = m->sq_length(o);
                if (likely(l >= 0)) {
                    i += l;
                } else {
                    if (PyErr_ExceptionMatches(PyExc_OverflowError))
                        PyErr_Clear();
                    else
                        return NULL;
                }
            }
            return m->sq_item(o, i);
        }
    }
#else
    if (is_list || PySequence_Check(o)) {
        return PySequence_GetItem(o, i);
    }
#endif
    return __Pyx_GetItemInt_Generic(o, PyInt_FromSsize_t(i));
}

static CYTHON_INLINE void __Pyx_RaiseTooManyValuesError(Py_ssize_t expected) {
    PyErr_Format(PyExc_ValueError,
                 "too many values to unpack (expected %" CYTHON_FORMAT_SSIZE_T "d)", expected);
}

static CYTHON_INLINE void __Pyx_RaiseNeedMoreValuesError(Py_ssize_t index) {
    PyErr_Format(PyExc_ValueError,
                 "need more than %" CYTHON_FORMAT_SSIZE_T "d value%.1s to unpack",
                 index, (index == 1) ? "" : "s");
}

static CYTHON_INLINE int __Pyx_IterFinish(void) {
#if CYTHON_COMPILING_IN_CPYTHON
    PyThreadState *tstate = PyThreadState_GET();
    PyObject* exc_type = tstate->curexc_type;
    if (unlikely(exc_type)) {
        if (likely(exc_type == PyExc_StopIteration) || PyErr_GivenExceptionMatches(exc_type, PyExc_StopIteration)) {
            PyObject *exc_value, *exc_tb;
            exc_value = tstate->curexc_value;
            exc_tb = tstate->curexc_traceback;
            tstate->curexc_type = 0;
            tstate->curexc_value = 0;
            tstate->curexc_traceback = 0;
            Py_DECREF(exc_type);
            Py_XDECREF(exc_value);
            Py_XDECREF(exc_tb);
            return 0;
        } else {
            return -1;
        }
    }
    return 0;
#else
    if (unlikely(PyErr_Occurred())) {
        if (likely(PyErr_ExceptionMatches(PyExc_StopIteration))) {
            PyErr_Clear();
            return 0;
        } else {
            return -1;
        }
    }
    return 0;
#endif
}

static int __Pyx_IternextUnpackEndCheck(PyObject *retval, Py_ssize_t expected) {
    if (unlikely(retval)) {
        Py_DECREF(retval);
        __Pyx_RaiseTooManyValuesError(expected);
        return -1;
    } else {
        return __Pyx_IterFinish();
    }
    return 0;
}

static int __pyx_bisect_code_objects(__Pyx_CodeObjectCacheEntry* entries, int count, int code_line) {
    int start = 0, mid = 0, end = count - 1;
    if (end >= 0 && code_line > entries[end].code_line) {
        return count;
    }
    while (start < end) {
        mid = (start + end) / 2;
        if (code_line < entries[mid].code_line) {
            end = mid;
        } else if (code_line > entries[mid].code_line) {
             start = mid + 1;
        } else {
            return mid;
        }
    }
    if (code_line <= entries[mid].code_line) {
        return mid;
    } else {
        return mid + 1;
    }
}
static PyCodeObject *__pyx_find_code_object(int code_line) {
    PyCodeObject* code_object;
    int pos;
    if (unlikely(!code_line) || unlikely(!__pyx_code_cache.entries)) {
        return NULL;
    }
    pos = __pyx_bisect_code_objects(__pyx_code_cache.entries, __pyx_code_cache.count, code_line);
    if (unlikely(pos >= __pyx_code_cache.count) || unlikely(__pyx_code_cache.entries[pos].code_line != code_line)) {
        return NULL;
    }
    code_object = __pyx_code_cache.entries[pos].code_object;
    Py_INCREF(code_object);
    return code_object;
}
static void __pyx_insert_code_object(int code_line, PyCodeObject* code_object) {
    int pos, i;
    __Pyx_CodeObjectCacheEntry* entries = __pyx_code_cache.entries;
    if (unlikely(!code_line)) {
        return;
    }
    if (unlikely(!entries)) {
        entries = (__Pyx_CodeObjectCacheEntry*)PyMem_Malloc(64*sizeof(__Pyx_CodeObjectCacheEntry));
        if (likely(entries)) {
            __pyx_code_cache.entries = entries;
            __pyx_code_cache.max_count = 64;
            __pyx_code_cache.count = 1;
            entries[0].code_line = code_line;
            entries[0].code_object = code_object;
            Py_INCREF(code_object);
        }
        return;
    }
    pos = __pyx_bisect_code_objects(__pyx_code_cache.entries, __pyx_code_cache.count, code_line);
    if ((pos < __pyx_code_cache.count) && unlikely(__pyx_code_cache.entries[pos].code_line == code_line)) {
        PyCodeObject* tmp = entries[pos].code_object;
        entries[pos].code_object = code_object;
        Py_DECREF(tmp);
        return;
    }
    if (__pyx_code_cache.count == __pyx_code_cache.max_count) {
        int new_max = __pyx_code_cache.max_count + 64;
        entries = (__Pyx_CodeObjectCacheEntry*)PyMem_Realloc(
            __pyx_code_cache.entries, (size_t)new_max*sizeof(__Pyx_CodeObjectCacheEntry));
        if (unlikely(!entries)) {
            return;
        }
        __pyx_code_cache.entries = entries;
        __pyx_code_cache.max_count = new_max;
    }
    for (i=__pyx_code_cache.count; i>pos; i--) {
        entries[i] = entries[i-1];
    }
    entries[pos].code_line = code_line;
    entries[pos].code_object = code_object;
    __pyx_code_cache.count++;
    Py_INCREF(code_object);
}

#include "compile.h"
#include "frameobject.h"
#include "traceback.h"
static PyCodeObject* __Pyx_CreateCodeObjectForTraceback(
            const char *funcname, int c_line,
            int py_line, const char *filename) {
    PyCodeObject *py_code = 0;
    PyObject *py_srcfile = 0;
    PyObject *py_funcname = 0;
    #if PY_MAJOR_VERSION < 3
    py_srcfile = PyString_FromString(filename);
    #else
    py_srcfile = PyUnicode_FromString(filename);
    #endif
    if (!py_srcfile) goto bad;
    if (c_line) {
        #if PY_MAJOR_VERSION < 3
        py_funcname = PyString_FromFormat( "%s (%s:%d)", funcname, __pyx_cfilenm, c_line);
        #else
        py_funcname = PyUnicode_FromFormat( "%s (%s:%d)", funcname, __pyx_cfilenm, c_line);
        #endif
    }
    else {
        #if PY_MAJOR_VERSION < 3
        py_funcname = PyString_FromString(funcname);
        #else
        py_funcname = PyUnicode_FromString(funcname);
        #endif
    }
    if (!py_funcname) goto bad;
    py_code = __Pyx_PyCode_New(
        0,
        0,
        0,
        0,
        0,
        __pyx_empty_bytes, /*PyObject *code,*/
        __pyx_empty_tuple, /*PyObject *consts,*/
        __pyx_empty_tuple, /*PyObject *names,*/
        __pyx_empty_tuple, /*PyObject *varnames,*/
        __pyx_empty_tuple, /*PyObject *freevars,*/
        __pyx_empty_tuple, /*PyObject *cellvars,*/
        py_srcfile,   /*PyObject *filename,*/
        py_funcname,  /*PyObject *name,*/
        py_line,
        __pyx_empty_bytes  /*PyObject *lnotab*/
    );
    Py_DECREF(py_srcfile);
    Py_DECREF(py_funcname);
    return py_code;
bad:
    Py_XDECREF(py_srcfile);
    Py_XDECREF(py_funcname);
    return NULL;
}
static void __Pyx_AddTraceback(const char *funcname, int c_line,
                               int py_line, const char *filename) {
    PyCodeObject *py_code = 0;
    PyFrameObject *py_frame = 0;
    py_code = __pyx_find_code_object(c_line ? c_line : py_line);
    if (!py_code) {
        py_code = __Pyx_CreateCodeObjectForTraceback(
            funcname, c_line, py_line, filename);
        if (!py_code) goto bad;
        __pyx_insert_code_object(c_line ? c_line : py_line, py_code);
    }
    py_frame = PyFrame_New(
        PyThreadState_GET(), /*PyThreadState *tstate,*/
        py_code,             /*PyCodeObject *code,*/
        __pyx_d,      /*PyObject *globals,*/
        0                    /*PyObject *locals*/
    );
    if (!py_frame) goto bad;
    py_frame->f_lineno = py_line;
    PyTraceBack_Here(py_frame);
bad:
    Py_XDECREF(py_code);
    Py_XDECREF(py_frame);
}

#define __PYX_VERIFY_RETURN_INT(target_type, func_type, func_value)       \
    {                                                                     \
        func_type value = func_value;                                     \
        if (sizeof(target_type) < sizeof(func_type)) {                    \
            if (unlikely(value != (func_type) (target_type) value)) {     \
                func_type zero = 0;                                       \
                if (is_unsigned && unlikely(value < zero))                \
                    goto raise_neg_overflow;                              \
                else                                                      \
                    goto raise_overflow;                                  \
            }                                                             \
        }                                                                 \
        return (target_type) value;                                       \
    }

#if CYTHON_COMPILING_IN_CPYTHON && PY_MAJOR_VERSION >= 3
 #if CYTHON_USE_PYLONG_INTERNALS
  #include "longintrepr.h"
 #endif
#endif

static CYTHON_INLINE unsigned PY_LONG_LONG __Pyx_PyInt_As_unsigned_PY_LONG_LONG(PyObject *x) {
    const unsigned PY_LONG_LONG neg_one = (unsigned PY_LONG_LONG) -1, const_zero = 0;
    const int is_unsigned = neg_one > const_zero;
#if PY_MAJOR_VERSION < 3
    if (likely(PyInt_Check(x))) {
        if (sizeof(unsigned PY_LONG_LONG) < sizeof(long)) {
            __PYX_VERIFY_RETURN_INT(unsigned PY_LONG_LONG, long, PyInt_AS_LONG(x))
        } else {
            long val = PyInt_AS_LONG(x);
            if (is_unsigned && unlikely(val < 0)) {
                goto raise_neg_overflow;
            }
            return (unsigned PY_LONG_LONG) val;
        }
    } else
#endif
    if (likely(PyLong_Check(x))) {
        if (is_unsigned) {
#if CYTHON_COMPILING_IN_CPYTHON && PY_MAJOR_VERSION >= 3
 #if CYTHON_USE_PYLONG_INTERNALS
            switch (Py_SIZE(x)) {
                case  0: return 0;
                case  1: __PYX_VERIFY_RETURN_INT(unsigned PY_LONG_LONG, digit, ((PyLongObject*)x)->ob_digit[0]);
            }
 #endif
#endif
#if CYTHON_COMPILING_IN_CPYTHON
            if (unlikely(Py_SIZE(x) < 0)) {
                goto raise_neg_overflow;
            }
#else
            {
                int result = PyObject_RichCompareBool(x, Py_False, Py_LT);
                if (unlikely(result < 0))
                    return (unsigned PY_LONG_LONG) -1;
                if (unlikely(result == 1))
                    goto raise_neg_overflow;
            }
#endif
            if (sizeof(unsigned PY_LONG_LONG) <= sizeof(unsigned long)) {
                __PYX_VERIFY_RETURN_INT(unsigned PY_LONG_LONG, unsigned long, PyLong_AsUnsignedLong(x))
            } else if (sizeof(unsigned PY_LONG_LONG) <= sizeof(unsigned PY_LONG_LONG)) {
                __PYX_VERIFY_RETURN_INT(unsigned PY_LONG_LONG, unsigned PY_LONG_LONG, PyLong_AsUnsignedLongLong(x))
            }
        } else {
#if CYTHON_COMPILING_IN_CPYTHON && PY_MAJOR_VERSION >= 3
 #if CYTHON_USE_PYLONG_INTERNALS
            switch (Py_SIZE(x)) {
                case  0: return 0;
                case  1: __PYX_VERIFY_RETURN_INT(unsigned PY_LONG_LONG,  digit, +(((PyLongObject*)x)->ob_digit[0]));
                case -1: __PYX_VERIFY_RETURN_INT(unsigned PY_LONG_LONG, sdigit, -(sdigit) ((PyLongObject*)x)->ob_digit[0]);
            }
 #endif
#endif
            if (sizeof(unsigned PY_LONG_LONG) <= sizeof(long)) {
                __PYX_VERIFY_RETURN_INT(unsigned PY_LONG_LONG, long, PyLong_AsLong(x))
            } else if (sizeof(unsigned PY_LONG_LONG) <= sizeof(PY_LONG_LONG)) {
                __PYX_VERIFY_RETURN_INT(unsigned PY_LONG_LONG, PY_LONG_LONG, PyLong_AsLongLong(x))
            }
        }
        {
#if CYTHON_COMPILING_IN_PYPY && !defined(_PyLong_AsByteArray)
            PyErr_SetString(PyExc_RuntimeError,
                            "_PyLong_AsByteArray() not available in PyPy, cannot convert large numbers");
#else
            unsigned PY_LONG_LONG val;
            PyObject *v = __Pyx_PyNumber_Int(x);
 #if PY_MAJOR_VERSION < 3
            if (likely(v) && !PyLong_Check(v)) {
                PyObject *tmp = v;
                v = PyNumber_Long(tmp);
                Py_DECREF(tmp);
            }
 #endif
            if (likely(v)) {
                int one = 1; int is_little = (int)*(unsigned char *)&one;
                unsigned char *bytes = (unsigned char *)&val;
                int ret = _PyLong_AsByteArray((PyLongObject *)v,
                                              bytes, sizeof(val),
                                              is_little, !is_unsigned);
                Py_DECREF(v);
                if (likely(!ret))
                    return val;
            }
#endif
            return (unsigned PY_LONG_LONG) -1;
        }
    } else {
        unsigned PY_LONG_LONG val;
        PyObject *tmp = __Pyx_PyNumber_Int(x);
        if (!tmp) return (unsigned PY_LONG_LONG) -1;
        val = __Pyx_PyInt_As_unsigned_PY_LONG_LONG(tmp);
        Py_DECREF(tmp);
        return val;
    }
raise_overflow:
    PyErr_SetString(PyExc_OverflowError,
        "value too large to convert to unsigned PY_LONG_LONG");
    return (unsigned PY_LONG_LONG) -1;
raise_neg_overflow:
    PyErr_SetString(PyExc_OverflowError,
        "can't convert negative value to unsigned PY_LONG_LONG");
    return (unsigned PY_LONG_LONG) -1;
}

static CYTHON_INLINE PyObject* __Pyx_PyInt_From_long(long value) {
    const long neg_one = (long) -1, const_zero = 0;
    const int is_unsigned = neg_one > const_zero;
    if (is_unsigned) {
        if (sizeof(long) < sizeof(long)) {
            return PyInt_FromLong((long) value);
        } else if (sizeof(long) <= sizeof(unsigned long)) {
            return PyLong_FromUnsignedLong((unsigned long) value);
        } else if (sizeof(long) <= sizeof(unsigned PY_LONG_LONG)) {
            return PyLong_FromUnsignedLongLong((unsigned PY_LONG_LONG) value);
        }
    } else {
        if (sizeof(long) <= sizeof(long)) {
            return PyInt_FromLong((long) value);
        } else if (sizeof(long) <= sizeof(PY_LONG_LONG)) {
            return PyLong_FromLongLong((PY_LONG_LONG) value);
        }
    }
    {
        int one = 1; int little = (int)*(unsigned char *)&one;
        unsigned char *bytes = (unsigned char *)&value;
        return _PyLong_FromByteArray(bytes, sizeof(long),
                                     little, !is_unsigned);
    }
}

static CYTHON_INLINE long __Pyx_PyInt_As_long(PyObject *x) {
    const long neg_one = (long) -1, const_zero = 0;
    const int is_unsigned = neg_one > const_zero;
#if PY_MAJOR_VERSION < 3
    if (likely(PyInt_Check(x))) {
        if (sizeof(long) < sizeof(long)) {
            __PYX_VERIFY_RETURN_INT(long, long, PyInt_AS_LONG(x))
        } else {
            long val = PyInt_AS_LONG(x);
            if (is_unsigned && unlikely(val < 0)) {
                goto raise_neg_overflow;
            }
            return (long) val;
        }
    } else
#endif
    if (likely(PyLong_Check(x))) {
        if (is_unsigned) {
#if CYTHON_COMPILING_IN_CPYTHON && PY_MAJOR_VERSION >= 3
 #if CYTHON_USE_PYLONG_INTERNALS
            switch (Py_SIZE(x)) {
                case  0: return 0;
                case  1: __PYX_VERIFY_RETURN_INT(long, digit, ((PyLongObject*)x)->ob_digit[0]);
            }
 #endif
#endif
#if CYTHON_COMPILING_IN_CPYTHON
            if (unlikely(Py_SIZE(x) < 0)) {
                goto raise_neg_overflow;
            }
#else
            {
                int result = PyObject_RichCompareBool(x, Py_False, Py_LT);
                if (unlikely(result < 0))
                    return (long) -1;
                if (unlikely(result == 1))
                    goto raise_neg_overflow;
            }
#endif
            if (sizeof(long) <= sizeof(unsigned long)) {
                __PYX_VERIFY_RETURN_INT(long, unsigned long, PyLong_AsUnsignedLong(x))
            } else if (sizeof(long) <= sizeof(unsigned PY_LONG_LONG)) {
                __PYX_VERIFY_RETURN_INT(long, unsigned PY_LONG_LONG, PyLong_AsUnsignedLongLong(x))
            }
        } else {
#if CYTHON_COMPILING_IN_CPYTHON && PY_MAJOR_VERSION >= 3
 #if CYTHON_USE_PYLONG_INTERNALS
            switch (Py_SIZE(x)) {
                case  0: return 0;
                case  1: __PYX_VERIFY_RETURN_INT(long,  digit, +(((PyLongObject*)x)->ob_digit[0]));
                case -1: __PYX_VERIFY_RETURN_INT(long, sdigit, -(sdigit) ((PyLongObject*)x)->ob_digit[0]);
            }
 #endif
#endif
            if (sizeof(long) <= sizeof(long)) {
                __PYX_VERIFY_RETURN_INT(long, long, PyLong_AsLong(x))
            } else if (sizeof(long) <= sizeof(PY_LONG_LONG)) {
                __PYX_VERIFY_RETURN_INT(long, PY_LONG_LONG, PyLong_AsLongLong(x))
            }
        }
        {
#if CYTHON_COMPILING_IN_PYPY && !defined(_PyLong_AsByteArray)
            PyErr_SetString(PyExc_RuntimeError,
                            "_PyLong_AsByteArray() not available in PyPy, cannot convert large numbers");
#else
            long val;
            PyObject *v = __Pyx_PyNumber_Int(x);
 #if PY_MAJOR_VERSION < 3
            if (likely(v) && !PyLong_Check(v)) {
                PyObject *tmp = v;
                v = PyNumber_Long(tmp);
                Py_DECREF(tmp);
            }
 #endif
            if (likely(v)) {
                int one = 1; int is_little = (int)*(unsigned char *)&one;
                unsigned char *bytes = (unsigned char *)&val;
                int ret = _PyLong_AsByteArray((PyLongObject *)v,
                                              bytes, sizeof(val),
                                              is_little, !is_unsigned);
                Py_DECREF(v);
                if (likely(!ret))
                    return val;
            }
#endif
            return (long) -1;
        }
    } else {
        long val;
        PyObject *tmp = __Pyx_PyNumber_Int(x);
        if (!tmp) return (long) -1;
        val = __Pyx_PyInt_As_long(tmp);
        Py_DECREF(tmp);
        return val;
    }
raise_overflow:
    PyErr_SetString(PyExc_OverflowError,
        "value too large to convert to long");
    return (long) -1;
raise_neg_overflow:
    PyErr_SetString(PyExc_OverflowError,
        "can't convert negative value to long");
    return (long) -1;
}

static CYTHON_INLINE int __Pyx_PyInt_As_int(PyObject *x) {
    const int neg_one = (int) -1, const_zero = 0;
    const int is_unsigned = neg_one > const_zero;
#if PY_MAJOR_VERSION < 3
    if (likely(PyInt_Check(x))) {
        if (sizeof(int) < sizeof(long)) {
            __PYX_VERIFY_RETURN_INT(int, long, PyInt_AS_LONG(x))
        } else {
            long val = PyInt_AS_LONG(x);
            if (is_unsigned && unlikely(val < 0)) {
                goto raise_neg_overflow;
            }
            return (int) val;
        }
    } else
#endif
    if (likely(PyLong_Check(x))) {
        if (is_unsigned) {
#if CYTHON_COMPILING_IN_CPYTHON && PY_MAJOR_VERSION >= 3
 #if CYTHON_USE_PYLONG_INTERNALS
            switch (Py_SIZE(x)) {
                case  0: return 0;
                case  1: __PYX_VERIFY_RETURN_INT(int, digit, ((PyLongObject*)x)->ob_digit[0]);
            }
 #endif
#endif
#if CYTHON_COMPILING_IN_CPYTHON
            if (unlikely(Py_SIZE(x) < 0)) {
                goto raise_neg_overflow;
            }
#else
            {
                int result = PyObject_RichCompareBool(x, Py_False, Py_LT);
                if (unlikely(result < 0))
                    return (int) -1;
                if (unlikely(result == 1))
                    goto raise_neg_overflow;
            }
#endif
            if (sizeof(int) <= sizeof(unsigned long)) {
                __PYX_VERIFY_RETURN_INT(int, unsigned long, PyLong_AsUnsignedLong(x))
            } else if (sizeof(int) <= sizeof(unsigned PY_LONG_LONG)) {
                __PYX_VERIFY_RETURN_INT(int, unsigned PY_LONG_LONG, PyLong_AsUnsignedLongLong(x))
            }
        } else {
#if CYTHON_COMPILING_IN_CPYTHON && PY_MAJOR_VERSION >= 3
 #if CYTHON_USE_PYLONG_INTERNALS
            switch (Py_SIZE(x)) {
                case  0: return 0;
                case  1: __PYX_VERIFY_RETURN_INT(int,  digit, +(((PyLongObject*)x)->ob_digit[0]));
                case -1: __PYX_VERIFY_RETURN_INT(int, sdigit, -(sdigit) ((PyLongObject*)x)->ob_digit[0]);
            }
 #endif
#endif
            if (sizeof(int) <= sizeof(long)) {
                __PYX_VERIFY_RETURN_INT(int, long, PyLong_AsLong(x))
            } else if (sizeof(int) <= sizeof(PY_LONG_LONG)) {
                __PYX_VERIFY_RETURN_INT(int, PY_LONG_LONG, PyLong_AsLongLong(x))
            }
        }
        {
#if CYTHON_COMPILING_IN_PYPY && !defined(_PyLong_AsByteArray)
            PyErr_SetString(PyExc_RuntimeError,
                            "_PyLong_AsByteArray() not available in PyPy, cannot convert large numbers");
#else
            int val;
            PyObject *v = __Pyx_PyNumber_Int(x);
 #if PY_MAJOR_VERSION < 3
            if (likely(v) && !PyLong_Check(v)) {
                PyObject *tmp = v;
                v = PyNumber_Long(tmp);
                Py_DECREF(tmp);
            }
 #endif
            if (likely(v)) {
                int one = 1; int is_little = (int)*(unsigned char *)&one;
                unsigned char *bytes = (unsigned char *)&val;
                int ret = _PyLong_AsByteArray((PyLongObject *)v,
                                              bytes, sizeof(val),
                                              is_little, !is_unsigned);
                Py_DECREF(v);
                if (likely(!ret))
                    return val;
            }
#endif
            return (int) -1;
        }
    } else {
        int val;
        PyObject *tmp = __Pyx_PyNumber_Int(x);
        if (!tmp) return (int) -1;
        val = __Pyx_PyInt_As_int(tmp);
        Py_DECREF(tmp);
        return val;
    }
raise_overflow:
    PyErr_SetString(PyExc_OverflowError,
        "value too large to convert to int");
    return (int) -1;
raise_neg_overflow:
    PyErr_SetString(PyExc_OverflowError,
        "can't convert negative value to int");
    return (int) -1;
}

static CYTHON_INLINE PyObject* __Pyx_PyInt_From_int(int value) {
    const int neg_one = (int) -1, const_zero = 0;
    const int is_unsigned = neg_one > const_zero;
    if (is_unsigned) {
        if (sizeof(int) < sizeof(long)) {
            return PyInt_FromLong((long) value);
        } else if (sizeof(int) <= sizeof(unsigned long)) {
            return PyLong_FromUnsignedLong((unsigned long) value);
        } else if (sizeof(int) <= sizeof(unsigned PY_LONG_LONG)) {
            return PyLong_FromUnsignedLongLong((unsigned PY_LONG_LONG) value);
        }
    } else {
        if (sizeof(int) <= sizeof(long)) {
            return PyInt_FromLong((long) value);
        } else if (sizeof(int) <= sizeof(PY_LONG_LONG)) {
            return PyLong_FromLongLong((PY_LONG_LONG) value);
        }
    }
    {
        int one = 1; int little = (int)*(unsigned char *)&one;
        unsigned char *bytes = (unsigned char *)&value;
        return _PyLong_FromByteArray(bytes, sizeof(int),
                                     little, !is_unsigned);
    }
}

static int __Pyx_check_binary_version(void) {
    char ctversion[4], rtversion[4];
    PyOS_snprintf(ctversion, 4, "%d.%d", PY_MAJOR_VERSION, PY_MINOR_VERSION);
    PyOS_snprintf(rtversion, 4, "%s", Py_GetVersion());
    if (ctversion[0] != rtversion[0] || ctversion[2] != rtversion[2]) {
        char message[200];
        PyOS_snprintf(message, sizeof(message),
                      "compiletime version %s of module '%.100s' "
                      "does not match runtime version %s",
                      ctversion, __Pyx_MODULE_NAME, rtversion);
        return PyErr_WarnEx(NULL, message, 1);
    }
    return 0;
}

#ifndef __PYX_HAVE_RT_ImportModule
#define __PYX_HAVE_RT_ImportModule
static PyObject *__Pyx_ImportModule(const char *name) {
    PyObject *py_name = 0;
    PyObject *py_module = 0;
    py_name = __Pyx_PyIdentifier_FromString(name);
    if (!py_name)
        goto bad;
    py_module = PyImport_Import(py_name);
    Py_DECREF(py_name);
    return py_module;
bad:
    Py_XDECREF(py_name);
    return 0;
}
#endif

#ifndef __PYX_HAVE_RT_ImportType
#define __PYX_HAVE_RT_ImportType
static PyTypeObject *__Pyx_ImportType(const char *module_name, const char *class_name,
    size_t size, int strict)
{
    PyObject *py_module = 0;
    PyObject *result = 0;
    PyObject *py_name = 0;
    char warning[200];
    Py_ssize_t basicsize;
#ifdef Py_LIMITED_API
    PyObject *py_basicsize;
#endif
    py_module = __Pyx_ImportModule(module_name);
    if (!py_module)
        goto bad;
    py_name = __Pyx_PyIdentifier_FromString(class_name);
    if (!py_name)
        goto bad;
    result = PyObject_GetAttr(py_module, py_name);
    Py_DECREF(py_name);
    py_name = 0;
    Py_DECREF(py_module);
    py_module = 0;
    if (!result)
        goto bad;
    if (!PyType_Check(result)) {
        PyErr_Format(PyExc_TypeError,
            "%.200s.%.200s is not a type object",
            module_name, class_name);
        goto bad;
    }
#ifndef Py_LIMITED_API
    basicsize = ((PyTypeObject *)result)->tp_basicsize;
#else
    py_basicsize = PyObject_GetAttrString(result, "__basicsize__");
    if (!py_basicsize)
        goto bad;
    basicsize = PyLong_AsSsize_t(py_basicsize);
    Py_DECREF(py_basicsize);
    py_basicsize = 0;
    if (basicsize == (Py_ssize_t)-1 && PyErr_Occurred())
        goto bad;
#endif
    if (!strict && (size_t)basicsize > size) {
        PyOS_snprintf(warning, sizeof(warning),
            "%s.%s size changed, may indicate binary incompatibility",
            module_name, class_name);
        if (PyErr_WarnEx(NULL, warning, 0) < 0) goto bad;
    }
    else if ((size_t)basicsize != size) {
        PyErr_Format(PyExc_ValueError,
            "%.200s.%.200s has the wrong size, try recompiling",
            module_name, class_name);
        goto bad;
    }
    return (PyTypeObject *)result;
bad:
    Py_XDECREF(py_module);
    Py_XDECREF(result);
    return NULL;
}
#endif

#ifndef __PYX_HAVE_RT_ImportFunction
#define __PYX_HAVE_RT_ImportFunction
static int __Pyx_ImportFunction(PyObject *module, const char *funcname, void (**f)(void), const char *sig) {
    PyObject *d = 0;
    PyObject *cobj = 0;
    union {
        void (*fp)(void);
        void *p;
    } tmp;
    d = PyObject_GetAttrString(module, (char *)"__pyx_capi__");
    if (!d)
        goto bad;
    cobj = PyDict_GetItemString(d, funcname);
    if (!cobj) {
        PyErr_Format(PyExc_ImportError,
            "%.200s does not export expected C function %.200s",
                PyModule_GetName(module), funcname);
        goto bad;
    }
#if PY_VERSION_HEX >= 0x02070000
    if (!PyCapsule_IsValid(cobj, sig)) {
        PyErr_Format(PyExc_TypeError,
            "C function %.200s.%.200s has wrong signature (expected %.500s, got %.500s)",
             PyModule_GetName(module), funcname, sig, PyCapsule_GetName(cobj));
        goto bad;
    }
    tmp.p = PyCapsule_GetPointer(cobj, sig);
#else
    {const char *desc, *s1, *s2;
    desc = (const char *)PyCObject_GetDesc(cobj);
    if (!desc)
        goto bad;
    s1 = desc; s2 = sig;
    while (*s1 != '\0' && *s1 == *s2) { s1++; s2++; }
    if (*s1 != *s2) {
        PyErr_Format(PyExc_TypeError,
            "C function %.200s.%.200s has wrong signature (expected %.500s, got %.500s)",
             PyModule_GetName(module), funcname, sig, desc);
        goto bad;
    }
    tmp.p = PyCObject_AsVoidPtr(cobj);}
#endif
    *f = tmp.fp;
    if (!(*f))
        goto bad;
    Py_DECREF(d);
    return 0;
bad:
    Py_XDECREF(d);
    return -1;
}
#endif

static int __Pyx_InitStrings(__Pyx_StringTabEntry *t) {
    while (t->p) {
        #if PY_MAJOR_VERSION < 3
        if (t->is_unicode) {
            *t->p = PyUnicode_DecodeUTF8(t->s, t->n - 1, NULL);
        } else if (t->intern) {
            *t->p = PyString_InternFromString(t->s);
        } else {
            *t->p = PyString_FromStringAndSize(t->s, t->n - 1);
        }
        #else
        if (t->is_unicode | t->is_str) {
            if (t->intern) {
                *t->p = PyUnicode_InternFromString(t->s);
            } else if (t->encoding) {
                *t->p = PyUnicode_Decode(t->s, t->n - 1, t->encoding, NULL);
            } else {
                *t->p = PyUnicode_FromStringAndSize(t->s, t->n - 1);
            }
        } else {
            *t->p = PyBytes_FromStringAndSize(t->s, t->n - 1);
        }
        #endif
        if (!*t->p)
            return -1;
        ++t;
    }
    return 0;
}

static CYTHON_INLINE PyObject* __Pyx_PyUnicode_FromString(const char* c_str) {
    return __Pyx_PyUnicode_FromStringAndSize(c_str, (Py_ssize_t)strlen(c_str));
}
static CYTHON_INLINE char* __Pyx_PyObject_AsString(PyObject* o) {
    Py_ssize_t ignore;
    return __Pyx_PyObject_AsStringAndSize(o, &ignore);
}
static CYTHON_INLINE char* __Pyx_PyObject_AsStringAndSize(PyObject* o, Py_ssize_t *length) {
#if __PYX_DEFAULT_STRING_ENCODING_IS_ASCII || __PYX_DEFAULT_STRING_ENCODING_IS_DEFAULT
    if (
#if PY_MAJOR_VERSION < 3 && __PYX_DEFAULT_STRING_ENCODING_IS_ASCII
            __Pyx_sys_getdefaultencoding_not_ascii &&
#endif
            PyUnicode_Check(o)) {
#if PY_VERSION_HEX < 0x03030000
        char* defenc_c;
        PyObject* defenc = _PyUnicode_AsDefaultEncodedString(o, NULL);
        if (!defenc) return NULL;
        defenc_c = PyBytes_AS_STRING(defenc);
#if __PYX_DEFAULT_STRING_ENCODING_IS_ASCII
        {
            char* end = defenc_c + PyBytes_GET_SIZE(defenc);
            char* c;
            for (c = defenc_c; c < end; c++) {
                if ((unsigned char) (*c) >= 128) {
                    PyUnicode_AsASCIIString(o);
                    return NULL;
                }
            }
        }
#endif
        *length = PyBytes_GET_SIZE(defenc);
        return defenc_c;
#else
        if (__Pyx_PyUnicode_READY(o) == -1) return NULL;
#if __PYX_DEFAULT_STRING_ENCODING_IS_ASCII
        if (PyUnicode_IS_ASCII(o)) {
            *length = PyUnicode_GET_LENGTH(o);
            return PyUnicode_AsUTF8(o);
        } else {
            PyUnicode_AsASCIIString(o);
            return NULL;
        }
#else
        return PyUnicode_AsUTF8AndSize(o, length);
#endif
#endif
    } else
#endif
#if !CYTHON_COMPILING_IN_PYPY
    if (PyByteArray_Check(o)) {
        *length = PyByteArray_GET_SIZE(o);
        return PyByteArray_AS_STRING(o);
    } else
#endif
    {
        char* result;
        int r = PyBytes_AsStringAndSize(o, &result, length);
        if (unlikely(r < 0)) {
            return NULL;
        } else {
            return result;
        }
    }
}
static CYTHON_INLINE int __Pyx_PyObject_IsTrue(PyObject* x) {
   int is_true = x == Py_True;
   if (is_true | (x == Py_False) | (x == Py_None)) return is_true;
   else return PyObject_IsTrue(x);
}
static CYTHON_INLINE PyObject* __Pyx_PyNumber_Int(PyObject* x) {
  PyNumberMethods *m;
  const char *name = NULL;
  PyObject *res = NULL;
#if PY_MAJOR_VERSION < 3
  if (PyInt_Check(x) || PyLong_Check(x))
#else
  if (PyLong_Check(x))
#endif
    return Py_INCREF(x), x;
  m = Py_TYPE(x)->tp_as_number;
#if PY_MAJOR_VERSION < 3
  if (m && m->nb_int) {
    name = "int";
    res = PyNumber_Int(x);
  }
  else if (m && m->nb_long) {
    name = "long";
    res = PyNumber_Long(x);
  }
#else
  if (m && m->nb_int) {
    name = "int";
    res = PyNumber_Long(x);
  }
#endif
  if (res) {
#if PY_MAJOR_VERSION < 3
    if (!PyInt_Check(res) && !PyLong_Check(res)) {
#else
    if (!PyLong_Check(res)) {
#endif
      PyErr_Format(PyExc_TypeError,
                   "__%.4s__ returned non-%.4s (type %.200s)",
                   name, name, Py_TYPE(res)->tp_name);
      Py_DECREF(res);
      return NULL;
    }
  }
  else if (!PyErr_Occurred()) {
    PyErr_SetString(PyExc_TypeError,
                    "an integer is required");
  }
  return res;
}
static CYTHON_INLINE Py_ssize_t __Pyx_PyIndex_AsSsize_t(PyObject* b) {
  Py_ssize_t ival;
  PyObject *x;
#if PY_MAJOR_VERSION < 3
  if (likely(PyInt_CheckExact(b)))
      return PyInt_AS_LONG(b);
#endif
  if (likely(PyLong_CheckExact(b))) {
    #if CYTHON_COMPILING_IN_CPYTHON && PY_MAJOR_VERSION >= 3
     #if CYTHON_USE_PYLONG_INTERNALS
       switch (Py_SIZE(b)) {
       case -1: return -(sdigit)((PyLongObject*)b)->ob_digit[0];
       case  0: return 0;
       case  1: return ((PyLongObject*)b)->ob_digit[0];
       }
     #endif
    #endif
    return PyLong_AsSsize_t(b);
  }
  x = PyNumber_Index(b);
  if (!x) return -1;
  ival = PyInt_AsSsize_t(x);
  Py_DECREF(x);
  return ival;
}
static CYTHON_INLINE PyObject * __Pyx_PyInt_FromSize_t(size_t ival) {
    return PyInt_FromSize_t(ival);
}


#endif /* Py_PYTHON_H */
