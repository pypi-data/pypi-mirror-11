.. |icon:icon-warning| image:: /../pootle/static/images/sprite/icon-warning.png
                      :alt: icon warning icon

.. |icon:icon-vcs-commit| image:: /../pootle/static/images/sprite/icon-vcs-commit.png
                      :alt: icon vcs commit icon

.. |icon:icon-delete-path| image:: /../pootle/static/images/sprite/icon-delete-path.png
                      :alt: icon delete path icon

.. |icon:icon-tick| image:: /../pootle/static/images/sprite/icon-tick.png
                      :alt: icon tick icon

.. |icon:icon-ascdesc| image:: /../pootle/static/images/sprite/icon-ascdesc.gif
                      :alt: icon ascdesc icon

.. |icon:icon-comment-add| image:: /../pootle/static/images/sprite/icon-comment-add.png
                      :alt: icon comment add icon

.. |icon:icon-external-link| image:: /../pootle/static/images/sprite/icon-external-link.png
                      :alt: icon external link icon

.. |icon:icon-tag-remove| image:: /../pootle/static/images/sprite/icon-tag-remove.png
                      :alt: icon tag remove icon

.. |icon:icon-vote-inactive| image:: /../pootle/static/images/sprite/icon-vote-inactive.png
                      :alt: icon vote inactive icon

.. |icon:icon-wikipedia| image:: /../pootle/static/images/sprite/icon-wikipedia.png
                      :alt: icon wikipedia icon

.. |icon:icon-accept| image:: /../pootle/static/images/sprite/icon-accept.png
                      :alt: icon accept icon

.. |icon:icon-web-translate| image:: /../pootle/static/images/sprite/icon-web-translate.png
                      :alt: icon web translate icon

.. |icon:icon-upload| image:: /../pootle/static/images/sprite/icon-upload.png
                      :alt: icon upload icon

.. |icon:icon-collapse-stats| image:: /../pootle/static/images/sprite/icon-collapse-stats.png
                      :alt: icon collapse stats icon

.. |icon:icon-folder-parent| image:: /../pootle/static/images/sprite/icon-folder-parent.png
                      :alt: icon folder parent icon

.. |icon:icon-block| image:: /../pootle/static/images/sprite/icon-block.png
                      :alt: icon block icon

.. |icon:icon-google-translate| image:: /../pootle/static/images/sprite/icon-google-translate.png
                      :alt: icon google translate icon

.. |icon:logo_0-10| image:: /../pootle/static/images/sprite/logo_0-10.png
                      :alt: logo 0 10 icon

.. |icon:icon-expand-stats| image:: /../pootle/static/images/sprite/icon-expand-stats.png
                      :alt: icon expand stats icon

.. |icon:icon-project| image:: /../pootle/static/images/sprite/icon-project.png
                      :alt: icon project icon

.. |icon:icon-back| image:: /../pootle/static/images/sprite/icon-back.png
                      :alt: icon back icon

.. |icon:icon-copy| image:: /../pootle/static/images/sprite/icon-copy.png
                      :alt: icon copy icon

.. |icon:icon-vcs-update| image:: /../pootle/static/images/sprite/icon-vcs-update.png
                      :alt: icon vcs update icon

.. |icon:icon-folder| image:: /../pootle/static/images/sprite/icon-folder.png
                      :alt: icon folder icon

.. |icon:icon-file| image:: /../pootle/static/images/sprite/icon-file.png
                      :alt: icon file icon

.. |icon:icon-tag-add| image:: /../pootle/static/images/sprite/icon-tag-add.png
                      :alt: icon tag add icon

.. |icon:icon-tag| image:: /../pootle/static/images/sprite/icon-tag.png
                      :alt: icon tag icon

.. |icon:icon-reject| image:: /../pootle/static/images/sprite/icon-reject.png
                      :alt: icon reject icon

.. |icon:icon-update-templates| image:: /../pootle/static/images/sprite/icon-update-templates.png
                      :alt: icon update templates icon

.. |icon:icon-search| image:: /../pootle/static/images/sprite/icon-search.png
                      :alt: icon search icon

.. |icon:icon-download| image:: /../pootle/static/images/sprite/icon-download.png
                      :alt: icon download icon

.. |icon:icon-asc| image:: /../pootle/static/images/sprite/icon-asc.gif
                      :alt: icon asc icon

.. |icon:icon-rescan-files| image:: /../pootle/static/images/sprite/icon-rescan-files.png
                      :alt: icon rescan files icon

.. |icon:icon-desc| image:: /../pootle/static/images/sprite/icon-desc.gif
                      :alt: icon desc icon

.. |icon:icon-keyboard| image:: /../pootle/static/images/sprite/icon-keyboard.png
                      :alt: icon keyboard icon

.. |icon:icon-block-muted| image:: /../pootle/static/images/sprite/icon-block-muted.png
                      :alt: icon block muted icon

.. |icon:icon-apertium| image:: /../pootle/static/images/sprite/icon-apertium.png
                      :alt: icon apertium icon

.. |icon:icon-filter| image:: /../pootle/static/images/sprite/icon-filter.png
                      :alt: icon filter icon

.. |icon:icon-error| image:: /../pootle/static/images/sprite/icon-error.png
                      :alt: icon error icon

.. |icon:icon-language| image:: /../pootle/static/images/sprite/icon-language.png
                      :alt: icon language icon

.. |icon:icon-feed| image:: /../pootle/static/images/sprite/icon-feed.png
                      :alt: icon feed icon

.. |icon:icon-information| image:: /../pootle/static/images/sprite/icon-information.png
                      :alt: icon information icon

.. |icon:icon-vote-active| image:: /../pootle/static/images/sprite/icon-vote-active.png
                      :alt: icon vote active icon

.. |icon:icon-comment-user| image:: /../pootle/static/images/sprite/icon-comment-user.png
                      :alt: icon comment user icon

