.. |icon:icon-warning| image:: /../pootle/static/images/sprite/icon-warning.png
                      :alt: icon warning icon

.. |icon:icon-arrow-down| image:: /../pootle/static/images/sprite/icon-arrow-down.png
                      :alt: icon arrow down icon

.. |icon:icon-tick| image:: /../pootle/static/images/sprite/icon-tick.png
                      :alt: icon tick icon

.. |icon:icon-ascdesc| image:: /../pootle/static/images/sprite/icon-ascdesc.gif
                      :alt: icon ascdesc icon

.. |icon:icon-comment-add| image:: /../pootle/static/images/sprite/icon-comment-add.png
                      :alt: icon comment add icon

.. |icon:icon-external-link| image:: /../pootle/static/images/sprite/icon-external-link.png
                      :alt: icon external link icon

.. |icon:icon-timeline| image:: /../pootle/static/images/sprite/icon-timeline.png
                      :alt: icon timeline icon

.. |icon:icon-accept| image:: /../pootle/static/images/sprite/icon-accept.png
                      :alt: icon accept icon

.. |icon:icon-web-translate| image:: /../pootle/static/images/sprite/icon-web-translate.png
                      :alt: icon web translate icon

.. |icon:icon-upload| image:: /../pootle/static/images/sprite/icon-upload.png
                      :alt: icon upload icon

.. |icon:icon-collapse-stats| image:: /../pootle/static/images/sprite/icon-collapse-stats.png
                      :alt: icon collapse stats icon

.. |icon:icon-folder-parent| image:: /../pootle/static/images/sprite/icon-folder-parent.png
                      :alt: icon folder parent icon

.. |icon:icon-block| image:: /../pootle/static/images/sprite/icon-block.png
                      :alt: icon block icon

.. |icon:icon-google-translate| image:: /../pootle/static/images/sprite/icon-google-translate.png
                      :alt: icon google translate icon

.. |icon:icon-expand-stats| image:: /../pootle/static/images/sprite/icon-expand-stats.png
                      :alt: icon expand stats icon

.. |icon:icon-project| image:: /../pootle/static/images/sprite/icon-project.png
                      :alt: icon project icon

.. |icon:icon-arrow-up| image:: /../pootle/static/images/sprite/icon-arrow-up.png
                      :alt: icon arrow up icon

.. |icon:icon-back| image:: /../pootle/static/images/sprite/icon-back.png
                      :alt: icon back icon

.. |icon:icon-copy| image:: /../pootle/static/images/sprite/icon-copy.png
                      :alt: icon copy icon

.. |icon:icon-folder| image:: /../pootle/static/images/sprite/icon-folder.png
                      :alt: icon folder icon

.. |icon:icon-file| image:: /../pootle/static/images/sprite/icon-file.png
                      :alt: icon file icon

.. |icon:icon-user-linkedin| image:: /../pootle/static/images/sprite/icon-user-linkedin.png
                      :alt: icon user linkedin icon

.. |icon:icon-logo| image:: /../pootle/static/images/sprite/icon-logo.png
                      :alt: icon logo icon

.. |icon:icon-reject| image:: /../pootle/static/images/sprite/icon-reject.png
                      :alt: icon reject icon

.. |icon:icon-search| image:: /../pootle/static/images/sprite/icon-search.png
                      :alt: icon search icon

.. |icon:icon-download| image:: /../pootle/static/images/sprite/icon-download.png
                      :alt: icon download icon

.. |icon:icon-yandex-translate| image:: /../pootle/static/images/sprite/icon-yandex-translate.png
                      :alt: icon yandex translate icon

.. |icon:icon-asc| image:: /../pootle/static/images/sprite/icon-asc.gif
                      :alt: icon asc icon

.. |icon:icon-desc| image:: /../pootle/static/images/sprite/icon-desc.gif
                      :alt: icon desc icon

.. |icon:icon-user-website| image:: /../pootle/static/images/sprite/icon-user-website.png
                      :alt: icon user website icon

.. |icon:icon-block-muted| image:: /../pootle/static/images/sprite/icon-block-muted.png
                      :alt: icon block muted icon

.. |icon:icon-apertium| image:: /../pootle/static/images/sprite/icon-apertium.png
                      :alt: icon apertium icon

.. |icon:icon-error| image:: /../pootle/static/images/sprite/icon-error.png
                      :alt: icon error icon

.. |icon:icon-user-twitter| image:: /../pootle/static/images/sprite/icon-user-twitter.png
                      :alt: icon user twitter icon

.. |icon:icon-language| image:: /../pootle/static/images/sprite/icon-language.png
                      :alt: icon language icon

.. |icon:icon-information| image:: /../pootle/static/images/sprite/icon-information.png
                      :alt: icon information icon

.. |icon:icon-raw-mode| image:: /../pootle/static/images/sprite/icon-raw-mode.png
                      :alt: icon raw mode icon

.. |icon:icon-comment-user| image:: /../pootle/static/images/sprite/icon-comment-user.png
                      :alt: icon comment user icon

